## arch/arm/configs/hisi_3630emulator_defconfig
```kconfig
CONFIG_GENERIC_GPIO=y
CONFIG_ARM=y
CONFIG_NO_HZ=y
CONFIG_HIGH_RES_TIMERS=y
CONFIG_RCU_FAST_NO_HZ=y
CONFIG_NO_HZ_FULL=y
CONFIG_NO_HZ_FULL_ALL=y
CONFIG_IKCONFIG=y
CONFIG_IKCONFIG_PROC=y
CONFIG_LOG_BUF_SHIFT=14

CONFIG_ARCH_HISI=y
CONFIG_ARCH_HI3630EMULATOR=y

CONFIG_CPUSETS=y
# CONFIG_SMP is not set
CONFIG_PREEMPT=y
CONFIG_LOCAL_TIMERS=y
CONFIG_ARM_ARCH_TIMER=y
CONFIG_HAVE_ARM_ARCH_TIMER=y
CONFIG_NR_CPUS=1
CONFIG_ARCH_NR_GPIO=0
CONFIG_AEABI=y
CONFIG_FRAME_POINTER=y
# CONFIG_ARM_UNWIND is not set

CONFIG_HIGHMEM=y
CONFIG_HIGHPTE=y
CONFIG_ZBOOT_ROM_TEXT=0x0
CONFIG_ZBOOT_ROM_BSS=0x0


CONFIG_VFP=y
CONFIG_VFPv3=y
CONFIG_NEON=y

CONFIG_SYSVIPC=y
CONFIG_BLK_DEV_INITRD=y

CONFIG_MODULES=y
CONFIG_MODULE_UNLOAD=y


#
# Character devices
#
# CONFIG_LEGACY_PTYS is not set


CONFIG_DTC=y
CONFIG_OF=y
CONFIG_OF_FLATTREE=y
CONFIG_OF_EARLY_FLATTREE=y
CONFIG_OF_ADDRESS=y
CONFIG_OF_IRQ=y
CONFIG_OF_DEVICE=y

#
CONFIG_SERIAL_CORE=y
CONFIG_SERIAL_CORE_CONSOLE=y
CONFIG_SERIAL_AMBA_PL011=y
CONFIG_SERIAL_AMBA_PL011_CONSOLE=y


#
# Pin controllers
#
CONFIG_PINMUX=y
CONFIG_PINCTRL=y
CONFIG_PINCONF=y
CONFIG_GENERIC_PINCONF=y
# CONFIG_DEBUG_PINCTRL is not set
CONFIG_PINCTRL_SINGLE=y
CONFIG_ARCH_HAVE_CUSTOM_GPIO_H=y
CONFIG_ARCH_WANT_OPTIONAL_GPIOLIB=y
CONFIG_ARCH_REQUIRE_GPIOLIB=y
CONFIG_GPIOLIB=y
CONFIG_OF_GPIO=y
# CONFIG_DEBUG_GPIO is not set
CONFIG_GPIO_SYSFS=y
CONFIG_GPIO_PL061=y
CONFIG_DEBUG_FS=y

CONFIG_NLS_CODEPAGE_437=y
CONFIG_NLS_ISO8859_1=y
CONFIG_PRINTK_TIME=y
CONFIG_MAGIC_SYSRQ=y


CONFIG_DEBUG_HI3630_UART0_SUPPORT=y
# CONFIG_DEBUG_HI3630_UART6_SUPPORT is not set
CONFIG_DEBUG_LL=y
CONFIG_EARLY_PRINTK=y
CONFIG_PRINTK_EXTENSION=y

#
# clk
#
CONFIG_HI3630_CLK=y
CONFIG_COMMON_CLK_DEBUG=y
CONFIG_HI3630_CLK_DEBUG=y
# CONFIG_HI3630_CLK_ALWAYS_ON is not set


# CONFIG_HID is not set

# CONFIG_IMG_ENC is not set
# CONFIG_IMG_DEC is not set
# CONFIG_HDMI_K3 is not set
# CONFIG_HIK3_VPP is not set
# CONFIG_HIFI_MAILBOX is not set
# CONFIG_HIFI_IPC is not set
# CONFIG_SND_HIFI_LPP is not set
# CONFIG_JPEG_CODEC is not set
```
