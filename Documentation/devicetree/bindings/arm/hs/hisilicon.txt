## arch/arm/configs/hisi_3630fpga_defconfig
```kconfig
CONFIG_GENERIC_GPIO=y
CONFIG_ARM=y
CONFIG_NO_HZ=y
CONFIG_HIGH_RES_TIMERS=y
CONFIG_RCU_FAST_NO_HZ=y
CONFIG_NO_HZ_FULL=y
# CONFIG_NO_HZ_FULL_ALL is not set
CONFIG_IKCONFIG=y
CONFIG_IKCONFIG_PROC=y
CONFIG_LOG_BUF_SHIFT=17
CONFIG_KERNEL_LOG_FILE_LEN=21
CONFIG_K3_LOG=y

CONFIG_ARCH_HISI=y
CONFIG_ARCH_HI3630FPGA=y

CONFIG_CPUSETS=y
CONFIG_SMP=y
CONFIG_PREEMPT=y
CONFIG_LOCAL_TIMERS=y
CONFIG_ARM_ARCH_TIMER=y
CONFIG_HAVE_ARM_ARCH_TIMER=y
CONFIG_NR_CPUS=1
CONFIG_ARCH_NR_GPIO=0
CONFIG_AEABI=y
CONFIG_FRAME_POINTER=y
# CONFIG_ARM_UNWIND is not set
CONFIG_HISI_AXI=y

CONFIG_HIGHMEM=y
CONFIG_HIGHPTE=y
CONFIG_ZBOOT_ROM_TEXT=0x0
CONFIG_ZBOOT_ROM_BSS=0x0

#
#psci
#
CONFIG_MCPM=y
CONFIG_ARM_PSCI=y

#
#HPM
#
CONFIG_CGROUPS=y
CONFIG_CGROUP_SCHED=y
CONFIG_FAIR_GROUP_SCHED=y
CONFIG_SCHED_MC=y
CONFIG_DISABLE_CPU_SCHED_DOMAIN_BALANCE=y
CONFIG_SCHED_HMP=y
CONFIG_HMP_FAST_CPU_MASK=""
CONFIG_HMP_SLOW_CPU_MASK=""
CONFIG_HMP_VARIABLE_SCALE=y
CONFIG_HMP_FREQUENCY_INVARIANT_SCALE=y


CONFIG_VFP=y
CONFIG_VFPv3=y
CONFIG_NEON=y

CONFIG_SYSVIPC=y
#
# performance monitor unit
#
CONFIG_PERF_EVENTS=y
CONFIG_DEBUG_PERF_USE_VMALLOC=y
CONFIG_HAVE_HW_BREAKPOINT=y
CONFIG_HW_PERF_EVENTS=y
CONFIG_EVENT_PROFILE=y
CONFIG_PROFILING=y
CONFIG_TRACEPOINTS=y
CONFIG_BLK_DEV_INITRD=y

CONFIG_KALLSYMS_ALL=y
CONFIG_MODULES=y
CONFIG_MODULE_UNLOAD=y

#
# watchdog support
#
CONFIG_WATCHDOG=y
CONFIG_ARM_SP805_WATCHDOG=y

#
# Character devices
#
# CONFIG_LEGACY_PTYS is not set


#
# Networking options
#
CONFIG_NET=y
CONFIG_PACKET=y
CONFIG_UNIX=y
CONFIG_NET_KEY=y
CONFIG_INET=y
CONFIG_IP_PNP=y
CONFIG_IP_PNP_DHCP=y
CONFIG_IP_MULTIPLE_TABLES=y
CONFIG_IP_ADVANCED_ROUTER=y
CONFIG_IP_ROUTE_VERBOSE=y
CONFIG_IP_ROUTE_MULTIPATH=y
CONFIG_IP_ROUTE_MULTIPATH_CACHED=y
CONFIG_PM_DEBUG=y
CONFIG_IPV6=y
CONFIG_IPV6_PRIVACY=y
CONFIG_IPV6_ROUTER_PREF=y
CONFIG_IPV6_ROUTE_INFO=y
CONFIG_IPV6_OPTIMISTIC_DAD=y
CONFIG_INET6_AH=y
CONFIG_INET6_ESP=y
CONFIG_INET6_IPCOMP=y
CONFIG_IPV6_MIP6=y
CONFIG_IPV6_MULTIPLE_TABLES=y
CONFIG_IPV6_SUBTREES=y
CONFIG_NETFILTER=y
CONFIG_NETFILTER_ADVANCED=y
#
# Core Netfilter Configuration
#
CONFIG_NETFILTER_NETLINK=y
# CONFIG_NETFILTER_NETLINK_ACCT is not set
CONFIG_NETFILTER_NETLINK_QUEUE=y
CONFIG_NETFILTER_NETLINK_LOG=y
CONFIG_NF_CONNTRACK=y
CONFIG_NF_CONNTRACK_MARK=y
CONFIG_NF_CONNTRACK_PROCFS=y
CONFIG_NF_CONNTRACK_EVENTS=y
CONFIG_NF_CT_PROTO_DCCP=y
CONFIG_NF_CT_PROTO_GRE=y
CONFIG_NF_CT_PROTO_SCTP=y
CONFIG_NF_CT_PROTO_UDPLITE=y
CONFIG_NF_CONNTRACK_AMANDA=y
CONFIG_NF_CONNTRACK_FTP=y
CONFIG_NF_CONNTRACK_H323=y
CONFIG_NF_CONNTRACK_IRC=y
CONFIG_NF_CONNTRACK_BROADCAST=y
CONFIG_NF_CONNTRACK_NETBIOS_NS=y
CONFIG_NF_CONNTRACK_PPTP=y
CONFIG_NF_CONNTRACK_SANE=y
CONFIG_NF_CONNTRACK_SIP=y
CONFIG_NF_CONNTRACK_TFTP=y
CONFIG_NF_CT_NETLINK=y
CONFIG_NF_NAT=y
CONFIG_NF_NAT_NEEDED=y
CONFIG_NF_NAT_PROTO_DCCP=y
CONFIG_NF_NAT_PROTO_UDPLITE=y
CONFIG_NF_NAT_PROTO_SCTP=y
CONFIG_NF_NAT_AMANDA=y
CONFIG_NF_NAT_FTP=y
CONFIG_NF_NAT_IRC=y
CONFIG_NF_NAT_SIP=y
CONFIG_NF_NAT_TFTP=y
CONFIG_NETFILTER_TPROXY=y
CONFIG_NETFILTER_XTABLES=y

#
# Xtables combined modules
#
CONFIG_NETFILTER_XT_MARK=y
CONFIG_NETFILTER_XT_CONNMARK=y
CONFIG_NETFILTER_XT_TARGET_CLASSIFY=y
CONFIG_NETFILTER_XT_TARGET_CONNMARK=y
CONFIG_NETFILTER_XT_TARGET_MARK=y
CONFIG_NETFILTER_XT_TARGET_NFQUEUE=y
CONFIG_NETFILTER_XT_TARGET_REDIRECT=y
CONFIG_NETFILTER_XT_MATCH_COMMENT=y
CONFIG_NETFILTER_XT_MATCH_CONNBYTES=y
CONFIG_NETFILTER_XT_MATCH_CONNLIMIT=y
CONFIG_NETFILTER_XT_MATCH_CONNMARK=y
CONFIG_NETFILTER_XT_MATCH_CONNTRACK=y
CONFIG_NETFILTER_XT_MATCH_HASHLIMIT=y
CONFIG_NETFILTER_XT_MATCH_HELPER=y
CONFIG_NETFILTER_XT_MATCH_IPRANGE=y
CONFIG_NETFILTER_XT_MATCH_LENGTH=y
CONFIG_NETFILTER_XT_MATCH_LIMIT=y
CONFIG_NETFILTER_XT_MATCH_MAC=y
CONFIG_NETFILTER_XT_MATCH_MARK=y
CONFIG_NETFILTER_XT_MATCH_MULTIPORT=y
CONFIG_NETFILTER_XT_MATCH_POLICY=y
CONFIG_NETFILTER_XT_MATCH_PKTTYPE=y
CONFIG_NETFILTER_XT_MATCH_QUOTA=y
CONFIG_NETFILTER_XT_MATCH_QUOTA2=y
CONFIG_NETFILTER_XT_MATCH_QUOTA2_LOG=y
CONFIG_NETFILTER_XT_MATCH_SOCKET=y
CONFIG_NETFILTER_XT_MATCH_STATE=y
CONFIG_NETFILTER_XT_MATCH_STATISTIC=y
CONFIG_NETFILTER_XT_MATCH_STRING=y
CONFIG_NETFILTER_XT_MATCH_TIME=y
CONFIG_NETFILTER_XT_MATCH_U32=y
CONFIG_NF_DEFRAG_IPV4=y
CONFIG_NF_CONNTRACK_IPV4=y
CONFIG_NF_CONNTRACK_PROC_COMPAT=y
CONFIG_IP_NF_IPTABLES=y
CONFIG_IP_NF_MATCH_AH=y
CONFIG_IP_NF_MATCH_ECN=y
CONFIG_IP_NF_MATCH_TTL=y
CONFIG_IP_NF_FILTER=y
CONFIG_IP_NF_TARGET_REJECT=y
CONFIG_IP_NF_TARGET_LOG=y
CONFIG_NF_NAT=y
CONFIG_NF_NAT_IPV4=y
CONFIG_IP_NF_TARGET_MASQUERADE=y
CONFIG_IP_NF_TARGET_NETMAP=y
CONFIG_IP_NF_TARGET_REDIRECT=y
CONFIG_IP_NF_TARGET_ULOG=y
CONFIG_NF_NAT_PROTO_GRE=y
CONFIG_NF_NAT_PPTP=y
CONFIG_NF_NAT_H323=y
CONFIG_IP_NF_MANGLE=y
CONFIG_IP_NF_RAW=y
CONFIG_IP_NF_ARPTABLES=y
CONFIG_IP_NF_ARPFILTER=y
CONFIG_IP_NF_ARP_MANGLE=y
CONFIG_NF_DEFRAG_IPV6=y
CONFIG_IP6_NF_IPTABLES=y
CONFIG_IP6_NF_FILTER=y
CONFIG_IP6_NF_TARGET_REJECT=y
CONFIG_IP6_NF_MANGLE=y
CONFIG_IP6_NF_RAW=y
CONFIG_NET_SCHED=y
CONFIG_NET_SCH_HTB=y
CONFIG_NET_CLS_U32=y
CONFIG_NET_EMATCH=y
CONFIG_NET_EMATCH_U32=y
CONFIG_NET_CLS_ACT=y
CONFIG_NET_ACT_POLICE=y
CONFIG_NET_ACT_GACT=y
CONFIG_NET_ACT_MIRRED=y
CONFIG_HAVE_NET_DSA=y
CONFIG_RPS=y
CONFIG_RFS_ACCEL=y
CONFIG_XPS=y
CONFIG_BQL=y
CONFIG_DMA_SHARED_BUFFER=y
CONFIG_CMA=y
CONFIG_CMA_DEBUG=y

#
# Default contiguous memory area size:
#
CONFIG_CMA_SIZE_MBYTES=64
CONFIG_CMA_SIZE_SEL_MBYTES=y
# CONFIG_CMA_SIZE_SEL_PERCENTAGE is not set

CONFIG_BT=y
CONFIG_BT_L2CAP=y
CONFIG_BT_SCO=y
CONFIG_BT_RFCOMM=y
CONFIG_BT_RFCOMM_TTY=y
CONFIG_BT_BNEP=y
# CONFIG_BT_BNEP_MC_FILTER is not set
# CONFIG_BT_BNEP_PROTO_FILTER is not set
CONFIG_BT_HIDP=y

#
# Bluetooth device drivers
#
# CONFIG_BT_HCIBTUSB is not set
# CONFIG_BT_HCIBTSDIO is not set
CONFIG_BT_HCIUART=y
CONFIG_BT_HCIUART_H4=y
# CONFIG_BT_HCIUART_BCSP is not set
# CONFIG_BT_HCIUART_ATH3K is not set
CONFIG_BT_HCIUART_LL=y
# CONFIG_BT_HCIBCM203X is not set
# CONFIG_BT_HCIBPA10X is not set
CONFIG_BT_POWER=y
#CONFIG_BT_SLEEP=y
# CONFIG_BT_HCIBFUSB is not set
# CONFIG_BT_HCIVHCI is not set
# CONFIG_BT_MRVL is not set
# CONFIG_AF_RXRPC is not set
CONFIG_RFKILL=y
CONFIG_RFKILL_PM=y
CONFIG_RFKILL_LEDS=y
#CONFIG_BT_SLEEP=y

# CONFIG_CMA_SIZE_SEL_MIN is not set
# CONFIG_CMA_SIZE_SEL_MAX is not set
CONFIG_CMA_ALIGNMENT=8
CONFIG_CMA_AREAS=7

CONFIG_SYNC=y
CONFIG_SW_SYNC=y
CONFIG_SW_SYNC_USER=y


CONFIG_DTC=y
CONFIG_OF=y
CONFIG_OF_FLATTREE=y
CONFIG_OF_EARLY_FLATTREE=y
CONFIG_OF_ADDRESS=y
CONFIG_OF_IRQ=y
CONFIG_OF_DEVICE=y
CONFIG_OF_I2C=y
CONFIG_OF_NET=y
CONFIG_OF_MDIO=y
CONFIG_BLK_DEV=y
CONFIG_BLK_DEV_LOOP=y
CONFIG_BLK_DEV_LOOP_MIN_COUNT=8
CONFIG_BLK_DEV_CRYPTOLOOP=y


#
# DRBD disabled because PROC_FS or INET not selected
#
CONFIG_BLK_DEV_RAM=y
CONFIG_BLK_DEV_RAM_COUNT=4
CONFIG_BLK_DEV_RAM_SIZE=8192
CONFIG_BLK_DEV_XIP=y
CONFIG_CDROM_PKTCDVD=y
CONFIG_CDROM_PKTCDVD_BUFFERS=8
CONFIG_APANIC=y
CONFIG_APANIC_PLABEL="splash"
CONFIG_APANIC_MMC=y
# CONFIG_CORE_DUMP_DEFAULT_ELF_HEADERS is not set
CONFIG_UEVENT_HELPER_PATH="/sbin/hotplug"
#
CONFIG_SERIAL_CORE=y
CONFIG_SERIAL_CORE_CONSOLE=y
CONFIG_SERIAL_AMBA_PL011=y
CONFIG_SERIAL_AMBA_PL011_CONSOLE=y

#
# vcodec support drivers
#
#CONFIG_IMG_DEC is not set

#
# img encode support
#
CONFIG_IMG_ENC=m
CONFIG_HIK3_VPP=y
CONFIG_ION=y
CONFIG_ION_HISI=y

#
# Console display driver support
#
CONFIG_DUMMY_CONSOLE=y
CONFIG_SOUND=y
CONFIG_SOUND_OSS_CORE=y
CONFIG_SOUND_OSS_CORE_PRECLAIM=y
CONFIG_SND=y
CONFIG_SND_TIMER=y
CONFIG_SND_PCM=y
CONFIG_SND_OSSEMUL=y
CONFIG_SND_PCM_OSS=y
CONFIG_SND_PCM_OSS_PLUGINS=y
CONFIG_SND_SUPPORT_OLD_API=y
CONFIG_SND_VERBOSE_PROCFS=y
CONFIG_SND_DRIVERS=y
CONFIG_SND_ARM=y
CONFIG_SND_USB=y
#
# HID support
#
CONFIG_HID=y
CONFIG_HID_GENERIC=y
#
# USB HID support
#
CONFIG_USB_HID=y
CONFIG_USB_SUPPORT=y
CONFIG_USB_COMMON=y
CONFIG_USB_ARCH_HAS_HCD=y
CONFIG_USB=y
#
# Miscellaneous USB options
#
CONFIG_USB_DEFAULT_PERSIST=y
#
# USB Host Controller Drivers
#
CONFIG_USB_SUSB_HDRC=y
CONFIG_USB_SUSB_PCD=y
CONFIG_USB_SUSB_HCD=y
#
# USB Miscellaneous drivers
#
CONFIG_DEBUG_FS=y
CONFIG_USB_GADGET=y
CONFIG_USB_GADGET_VBUS_DRAW=500
CONFIG_USB_GADGET_STORAGE_NUM_BUFFERS=2
CONFIG_K3V3_BALONG_MODEM=y

#
# USB Peripheral Controller
#
CONFIG_USB_LIBCOMPOSITE=y
CONFIG_USB_F_ACM=y
CONFIG_USB_U_SERIAL=y
CONFIG_USB_G_ANDROID=y
CONFIG_MMC=y
CONFIG_RTC_CLASS=y
CONFIG_RTC_HCTOSYS=y
CONFIG_RTC_HCTOSYS_DEVICE="rtc0"
#
# RTC interfaces
#
CONFIG_RTC_INTF_SYSFS=y
CONFIG_RTC_INTF_PROC=y
CONFIG_RTC_INTF_DEV=y
#
# on-CPU RTC drivers
#
# CONFIG_RTC_DRV_PL030 is not set
CONFIG_RTC_DRV_PL031=y
# CONFIG_HISI_CS is not set
# CONFIG_HISI_CS_ETM_PCSAVE_DEFAULT_ENABLE is not set
# CONFIG_HISI_CS_STM_DEFAULT_ENABLE is not set
# CONFIG_SPS is not set

#
# PMU RTC
#
# CONFIG_RTC_DRV_HI3630_PMU is not set


#
# Pin controllers
#
CONFIG_PINMUX=y
CONFIG_PINCTRL=y
CONFIG_PINCONF=y
CONFIG_GENERIC_PINCONF=y
# CONFIG_DEBUG_PINCTRL is not set
CONFIG_PINCTRL_SINGLE=y
CONFIG_ARCH_HAVE_CUSTOM_GPIO_H=y
CONFIG_ARCH_WANT_OPTIONAL_GPIOLIB=y
CONFIG_ARCH_REQUIRE_GPIOLIB=y
CONFIG_GPIOLIB=y
CONFIG_OF_GPIO=y
# CONFIG_DEBUG_GPIO is not set
CONFIG_GPIO_SYSFS=y
CONFIG_GPIO_PL061=y
CONFIG_DEBUG_FS=y

CONFIG_IOMMU_API=y
CONFIG_IOMMU_SUPPORT=y
CONFIG_OF_IOMMU=y
CONFIG_K3V300_IOMMU=y
CONFIG_K3V300_IOMMU_TEST=y

#
# File systems
#
CONFIG_EXT4_FS=y
CONFIG_EXT4_FS_XATTR=y
CONFIG_EXT4_FS_POSIX_ACL=y
CONFIG_EXT4_FS_SECURITY=y
CONFIG_FUSE_FS=y
CONFIG_SDCARD_FS=y
CONFIG_CUSE=y
CONFIG_VFAT_FS=y
CONFIG_TMPFS=y
CONFIG_CRAMFS=y

#for exfat begin
CONFIG_EXFAT_FS=y
CONFIG_EXFAT_DEFAULT_CODEPAGE=437
CONFIG_EXFAT_DEFAULT_IOCHARSET="utf8"
CONFIG_NLS_UTF8=y
#for exfat end

CONFIG_NLS_CODEPAGE_437=y
CONFIG_NLS_ISO8859_1=y
CONFIG_PRINTK_TIME=y
CONFIG_HISI_TIME =y

CONFIG_MAGIC_SYSRQ=y

CONFIG_DEBUG_KERNEL=y
# CONFIG_DEBUG_KMEMLEAK is not set
# CONFIG_HAVE_DEBUG_KMEMLEAK is not set
# CONFIG_DEBUG_KMEMLEAK_EARLY_LOG_SIZE is not set
CONFIG_ILOCKDEP=y
CONFIG_DEBUG_ILOCKDEP_NUM=32
CONFIG_DETECT_HUNG_TASK=y
CONFIG_HW_DETECT_HUNG_TASK=y
CONFIG_DEFAULT_HUNG_TASK_TIMEOUT=120
# CONFIG_BOOTPARAM_HUNG_TASK_PANIC is not set
CONFIG_BOOTPARAM_HUNG_TASK_PANIC_VALUE=0
CONFIG_HISI_RDR=y
CONFIG_SCHED_DEBUG=y
CONFIG_DEBUG_PREEMPT=y
CONFIG_DEBUG_RT_MUTEXES=y
CONFIG_DEBUG_ATOMIC_SLEEP=y
CONFIG_DEBUG_INFO=y
CONFIG_DEBUG_USER=y
CONFIG_DEBUG_HI3630_UART0_SUPPORT=y
# CONFIG_DEBUG_HI3630_UART6_SUPPORT is not set
CONFIG_DEBUG_LL=y
CONFIG_EARLY_PRINTK=y
CONFIG_PRINTK_EXTENSION=y
CONFIG_LOCKUP_DETECTOR=y

#
# RCU Debugging
#
CONFIG_DEBUG_RODATA=y
# CONFIG_DEBUG_RODATA_TEST is not set


CONFIG_PANIC_TIMEOUT=1
CONFIG_HISI_REBOOT_TYPE=y

#
# Graphics support
#
CONFIG_FB=y
# CONFIG_FB_FAKE is not set
# CONFIG_FB_VIRTUAL is not set
CONFIG_FB_K3=y
# CONFIG_FASTBOOT_DISP_ENABLE is not set

CONFIG_BACKLIGHT_LCD_SUPPORT=y
CONFIG_BACKLIGHT_CLASS_DEVICE=y

CONFIG_LCD_CLASS_DEVICE=y
CONFIG_NEW_LEDS=y
CONFIG_LEDS_CLASS=y
CONFIG_LEDS_TRIGGERS=y
CONFIG_LEDS_TRIGGER_TIMER=y
#
# mali gpu support
#
CONFIG_MALI_T6XX=y
# CONFIG_REPORT_VSYNC is not set

# DMA
CONFIG_DMADEVICES=y
CONFIG_HAS_DMA=y
CONFIG_DMA_ENGINE=y
CONFIG_PL330_DMA=y
CONFIG_DMA_VIRTUAL_CHANNELS=y
CONFIG_HISI_DMA=y
CONFIG_DMATEST=n

# SPI
CONFIG_SPI=y
CONFIG_SPI_MASTER=y
CONFIG_SPI_PL022=y
CONFIG_SPI_HI3630_CS_USE_PCTRL=y
CONFIG_SPI_SPIDEV=y

#
# I2C Hardware Bus support
#
CONFIG_I2C=y
CONFIG_I2C_BOARDINFO=y
CONFIG_I2C_COMPAT=y
CONFIG_I2C_HELPER_AUTO=y

#
# I2C system bus drivers (mostly embedded / system-on-chip)
#
CONFIG_I2C_DESIGNWARE_CORE=y
CONFIG_I2C_DESIGNWARE_PLATFORM=y
CONFIG_HISI_I2C_DESIGNWARE=y
CONFIG_I2C_DESIGNWARE_HI3630=y

CONFIG_MMC=y
# CONFIG_MMC_DEBUG is not set
# CONFIG_MMC_UNSAFE_RESUME is not set
# CONFIG_MMC_CLKGATE is not set
#
# MMC/SD/SDIO Card Drivers
#
CONFIG_MMC_BLOCK=y
CONFIG_MMC_BLOCK_MINORS=64
CONFIG_MMC_BLOCK_BOUNCE=y

#
# MMC/SD/SDIO Host Controller Drivers
#
CONFIG_MMC_DW=y
CONFIG_MMC_DW_IDMAC=y
CONFIG_MMC_DW_PLTFM=y
CONFIG_MMC_DW_HISILICON=y

#SECURE_EXTENSION
#
CONFIG_SECURE_EXTENSION=y

CONFIG_TZDRIVER=y
#
#Touchscreen Driver
CONFIG_INPUT=y
CONFIG_INPUT_TOUCHSCREEN=y
# CONFIG_TOUCHSCREEN_SYNAPTICS_I2C_RMI is not set
CONFIG_INPUT_EVDEV=y

#Huawei touchscreen driver
CONFIG_HUAWEI_TS=y
CONFIG_SYNAPTICS_TS=y
CONFIG_CYPRESS_TS=y
#

#
# Android
#

CONFIG_SHMEM=y
CONFIG_ASHMEM=y
CONFIG_STAGING=y
CONFIG_ANDROID=y
CONFIG_ANDROID_BINDER_IPC=y
CONFIG_ANDROID_LOGGER=y
CONFIG_ANDROID_TIMED_OUTPUT=y
CONFIG_ANDROID_LOW_MEMORY_KILLER=y
CONFIG_ANDROID_INTF_ALARM_DEV=y
CONFIG_HAS_WAKELOCK=y
CONFIG_WAKELOCK=y
CONFIG_DM_CRYPT=y
CONFIG_POWER_SUPPLY=y
CONFIG_ANDROID_PARANOID_NETWORK=y
CONFIG_NET_ACTIVITY_STATS=y
CONFIG_INPUT_MISC=y
CONFIG_INPUT_UINPUT=y
CONFIG_INPUT_GPIO=y
CONFIG_USB_G_ANDROID=y
CONFIG_SWITCH=y
CONFIG_CRYPTO_TWOFISH=y
CONFIG_CPU_FREQ_GOV_INTERACTIVE=y
CONFIG_CPU_FREQ_DEFAULT_GOV_INTERACTIVE=y


CONFIG_MTD=y
CONFIG_MTD_CMDLINE_PARTS=y
CONFIG_MTD_CHAR=y
CONFIG_HISI_NVE=y
CONFIG_MTD_BLKDEVS=y
CONFIG_MTD_BLOCK=y
CONFIG_MTD_BLOCK2MTD=y
CONFIG_MTD_OOPS=y
CONFIG_MTD_MAP_BANK_WIDTH_1=y
CONFIG_MTD_MAP_BANK_WIDTH_2=y
CONFIG_MTD_MAP_BANK_WIDTH_4=y
CONFIG_MTD_CFI_I1=y
CONFIG_MTD_CFI_I2=y

CONFIG_BALONG_MTD=y
#
# clk
#
CONFIG_HI3630_CLK=y
CONFIG_COMMON_CLK_DEBUG=y
CONFIG_HI3630_CLK_DEBUG=y
# CONFIG_HI3630_CLK_ALWAYS_ON is not set
CONFIG_HI3630_CLK_MAILBOX_SUPPORT=y

#
# NoC Support
#
CONFIG_HISI_NOC=y
CONFIG_HISI_NOC_ERR_PROBE=y

#
# HI6421V300 pmu drivers
#
CONFIG_REGULATOR=y
CONFIG_HI3XXX_HI6421V300_PMIC=y
CONFIG_HI3XXX_REGULATOR_HI6421V300=y
CONFIG_HI3XXX_HI3630_CORE=y
CONFIG_HI3XXX_REGULATOR_KIRIN925=y
CONFIG_HI6421_OCP=y
CONFIG_INPUT_HI6421_ONKEY=y
CONFIG_INPUT_MISC=y
CONFIG_PMU_NOT_EXIST_FPGA=y
CONFIG_HI6421_VIBRATOR=y
CONFIG_HI6421_LED=y
#
#thermal monitor
#
#CONFIG_THERMAL is not set
#CONFIG_HI3XXX_THERMAL_TSENSOR is not set
#CONFIG_HI3XXX_THERMAL_PERIPHERAL is not set

#
# hisilicon hkadc support
#
CONFIG_HI3XXX_HKADC=y
# CONFIG_HI3XXX_HKADC_DEBUG is not set
#
#

#
# pm opp support
#
CONFIG_PM_OPP=y

#
# gpu devfreq support
#
CONFIG_DEVFREQ_GOV_MALI_ONDEMAND=y
CONFIG_PM_DEVFREQ=y
CONFIG_MALI_T6XX_RT_PM=y
# CONFIG_PM_RUNTIME is not set

#
# ddr devfreq support
#
CONFIG_HISI_DDR_DEVFREQ=y
CONFIG_HISI_DDR_DEVFREQ_USER=y

#
# ipc support
#
CONFIG_HISI_MAILBOX=y
CONFIG_HISI_MAILBOX_TEST=y
CONFIG_HI3630_LPM3_IPC=y

#
# efuse support
#
CONFIG_HISI_EFUSE=y

#
# udp board id support
#
CONFIG_HISI_UDP_BOARDID=y

#
# lpm3 watchdog & debug support
#
CONFIG_HISI_LPM3=y
CONFIG_HISI_LPM3_DEBUG=y

#
# Multimedia core support
#
CONFIG_MEDIA_SUPPORT=y
CONFIG_MEDIA_CAMERA_SUPPORT=y
CONFIG_MEDIA_CONTROLLER=y
CONFIG_VIDEO_DEV=y
CONFIG_VIDEO_V4L2_COMMON=y
# CONFIG_DVB_CORE is not set
CONFIG_VIDEO_MEDIA=y
#
# camera support
#
CONFIG_VIDEO_HISI_CAMERA=y
CONFIG_HISI_CAMERA_SENSOR=y
CONFIG_HISI_CAMERA_VCM=y
CONFIG_HISI_CAMERA_VIDEO=y
CONFIG_HISI_CAMERA_FLASH=y
# camera isp support
CONFIG_HISI_CAMERA_OVISP23=y
# camera sensor support
CONFIG_HISI_CAMERA_OV8830=y
CONFIG_HISI_CAMERA_IMX135=y
CONFIG_HISI_CAMERA_MT9M114=y
CONFIG_HISI_CAMERA_OV5648=y
CONFIG_HISI_CAMERA_IMX214=y
# camera vcm support
CONFIG_HISI_CAMERA_AD5823=y
CONFIG_HISI_CAMERA_DW9714=y
# camera flash support
CONFIG_HISI_CAMERA_TPS61310=y

#
# CPU Frequency scaling
#
#cpufreq core
CONFIG_CPU_FREQ=y
CONFIG_CPU_FREQ_TABLE=y
CONFIG_CPU_FREQ_GOV_COMMON=y
# CONFIG_CPU_FREQ_STAT is not set
# CONFIG_CPU_FREQ_STAT_DETAILS is not set

#big.little
CONFIG_BIG_LITTLE=y
CONFIG_ARM_BIG_LITTLE_CPUFREQ=y
CONFIG_ARM_DT_BL_CPUFREQ=y
CONFIG_HISI_CPUFREQ=y

#governor
# CONFIG_CPU_FREQ_DEFAULT_GOV_PERFORMANCE is not set
# CONFIG_CPU_FREQ_DEFAULT_GOV_USERSPACE is not set
# CONFIG_CPU_FREQ_DEFAULT_GOV_ONDEMAND is not set
# CONFIG_CPU_FREQ_DEFAULT_GOV_CONSERVATIVE is not set
CONFIG_CPU_FREQ_DEFAULT_GOV_INTERACTIVE=y
CONFIG_CPU_FREQ_GOV_PERFORMANCE=y
CONFIG_CPU_FREQ_GOV_POWERSAVE=y
CONFIG_CPU_FREQ_GOV_USERSPACE=y
CONFIG_CPU_FREQ_GOV_ONDEMAND=y
CONFIG_CPU_FREQ_GOV_INTERACTIVE=y
CONFIG_CPU_FREQ_GOV_CONSERVATIVE=y
CONFIG_INPUTHUB=y

# CONFIG_PARTIAL_UPDATES is not set

#hifi dsp
CONFIG_SND_HIFI_LPP=y
CONFIG_SND_HIFI_SEC_LOAD=y

#mailbox
CONFIG_HIFI_MAILBOX=y
CONFIG_HIFI_IPC=y

#
# Logger extend configuration
#
CONFIG_LOGGER_EXTEND=y
CONFIG_LOG_SWITCH=y
CONFIG_LOG_EXCEPTION=y
CONFIG_LOG_JANK=y

#
# cmdline
#
CONFIG_HW_CMDLINE_PARSE=y
#
# power support
#
CONFIG_POWER_HUAWEI=y
CONFIG_BATTERY_HISI_COUL=y
CONFIG_BATTERY_HISI_HI6421V300=y
CONFIG_BQ_BCI_BATTERY=y
CONFIG_BQ2419X_CHARGER=y

#
# device check
#
CONFIG_HUAWEI_HW_DEV_DCT=y
```
