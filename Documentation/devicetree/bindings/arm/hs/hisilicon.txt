## arch/arm/mach-hi6210-legacy/Kconfig
```kconfig
menu "Hisilicon hi6210 board feature"
	depends on ARCH_HI6XXX

# -------------------------------------
if ARCH_HI6XXX

comment "Hisilicon K3V200 options"

choice
	prompt "Select K3V200 processor family for target system"

endchoice

# config MACH_TC45MSU3
#	bool "TC45MSU3 Board"
#	help
#	  Support for  Hisilicon TC45MSU3 FPGA Verify platform

config MACH_HI6210SFT
	bool "HI6210SFT Board"
	help
	  Support for  Hisilicon Balong hi6210sft platform

config MACH_HI6210OEM
	bool "HI6210OEM Board"
	help
	  Support for  Hisilicon Balong hi6210oem platform

comment "K3V200 features"
config K3_EDB_LEVEL
	int "Kernel Early-Debug Level( 0~254, 255 => Disable Early-Debug)"
	range 0 255
	default "0"
	help
	  Set the debug level of Early-Debug, low level will cause more debug message
# ADC driver

config IPPS_SUPPORT
	bool "IPPS driver support"
	select ARCH_HAS_CPUFREQ
	default y
	help
	  IPPS driver support for cpu gpu ddr dvfs.

config IPPS_PARAM_ALTERNATIVE
	bool "IPPS parameters seperate from firmware"
	default y
	help
	  IPPS parameters seperate from firmware.

config TRIM_VOL
	bool "TRIM Voltage support"
	default n
	help
	  TRIM Voltage patch support.

config S10_IPPS_FIRMWARE
	bool "S10 IPPS Firmware"
	depends on IPPS_SUPPORT
	default n
	help
	  S10 Special IPPS Firmware.

config MMC_EMMC_DEVICE
	bool "emmc device support"
	default y
	help
	  EMMC device support.

config MMC_SD_DEVICE
	bool "sd device support"
	default y
	help
	  SD device support.

config MMC_SDIO_DEVICE
	bool "sdio device support"
	default y
	help
	  SDIO device support.
config WIFI_DEVICE
	bool "bcm4330-wifi device support"
	select WIFI_CONTROL_FUNC
	default n
	help
	  bcm4330-wifi device support

config XMM_POWER
	bool "xmm6260 power control support"
	default y
	help
	  xmm6260 power control

config XMM_RMNET
	bool "xmm6260 rmnet support"
	default y
	help
	  xmm6260 rmnet

config DEFAULT_TIMERCLK
	int "Kernel Timer Clock Frequence"
	default "26000000"
	help
	  Set default timer clock frequence

config CONNECTIVE_CONTROL_FPGA
	bool "connective platform select"
	default n
	help
	  Set connective platform

config LOWPM_DEBUG
	bool "low power debug property"
	depends on DEBUG_FS
	help
		set low power debug property

config DEBUG_LED
	bool "LED light for debug"
	default n
	help
		set LED light for debug

config HI6401_CODEC
	bool "hi6401 codec support"
	default n
	help
	  hi6401 codec  support.

config HI6421_CODEC
	bool "hi6421 codec support"
	default n
	help
	  hi6421 codec  support.

config HISI_ALTER_HARDWARE_NAME
	bool "Hardware name can be set a alternative one"
	default y
	help
	Hardware name can be set a alternative one

config DEBUG_IRQ_WARNING
    bool "debug irq warning"
    default n
    help
      show warnings if irq is enabled in irq-contex

config DEBUG_MUTEX_ERROR
    bool "debug mutex error"
    default n

endif

config MIGRATION_RT_WALKAROUND
    bool "walk around for migrating rt task"
    default n
endmenu
```

## arch/arm/mach-hisi/Kconfig
```kconfig
config SECURE_EXTENSION
        bool "security extension support"
        default n
        help
          Include Security Extension.

config ARCH_HISI
	bool "Hisilicon family"
	select ARCH_HAS_CPUFREQ
	select ARCH_REQUIRE_GPIOLIB
	select ARM_AMBA
	select ARM_GIC
	select CLKDEV_LOOKUP
	select COMMON_CLK
	select GENERIC_CLOCKEVENTS
	select HAVE_CLK
	select HAVE_SMP
	select NO_IOPORT
	select PINCTRL
	select PINCTRL_SINGLE
	select ARCH_HAS_OPP
	select ARCH_HAS_PASR

	help
	  Support for Hislicon Hi36xx/Hi37xx/Hi6620 processor family

	
if ARCH_HISI

config ARCH_HI3630FPGA
	bool "Hisilicon Development Board"
	default n

	select ARM_CCI
	select CPU_V7
	select ARM_TIMER_SP804
	help
	  Say 'Y' here if you want to support the Hisilicon Development
	  Board.

config ARCH_HI3630EMULATOR
	bool "Hisilicon Emulator Board"
	default n

	select ARM_CCI
	select CPU_V7
	select ARM_TIMER_SP804
	help
	  Say 'Y' here if you want to support the Hisilicon Development
	  Board.

config ARCH_HI3630
	bool "Hisilicon UDP Board"
	default n

	select ARM_CCI
	select CPU_V7
	select ARM_TIMER_SP804
	help
	  Say 'Y' here if you want to support the Hisilicon Development
	  Board.

config ARCH_HI6620
	bool "Hisilicon HI6620 OEM Development Board"
	default n

	select ARM_CCI
	select CPU_V7
	select ARM_TIMER_SP804
	help
	  Say 'Y' here if you want to support the Hisilicon HI6620 Development
	  Board.

config ARCH_HI6XXX
	bool "Hisilicon HI6xxx Development Board"
	default n

	select ARM_CCI
	select CPU_V7
	select ARM_TIMER_SP804
	help
	  Say 'Y' here if you want to support the Hisilicon HI6210 Development
	  Board.
	
menu "Hisilicon NoC Support"
config HI6421_OCP
	bool "Hisilicon chip over current protect"
	default n
	help
	  Say 'Y' here if you want to support the Hisilicon OCP.
endmenu

config HI3630_LPM3_IPC
	bool "InterProcessor Communication Support"
	default n
	help
          support Acore communication with LPM3

config HISI_LPM3
	bool "Hisilicon LPM3"
	default n
	help
	  Hi3630 lpm3 watchdog driver

config HISI_LPM3_DEBUG
	depends on HISI_LPM3
	depends on HISI_MAILBOX
	bool "Hisilicon LPM3 DEBUG"
	default n
	help
	  Hi3630 lpm3 debug driver

config HISI_REBOOT_TYPE
	bool "Hisilicon reboot type"
	default n
	help
	  Hi3630 reboot type
endif

config HISI_UDP_BOARDID
	bool "Hisilicon udp board id driver"
	default y
	help
	Hi3630 udp board id driver support

config HISI_ALTER_HARDWARE_NAME
	bool "Hardware name can be set a alternative one"
	default y
	help
	Hardware name can be set a alternative one

config HISI_SR_DEBUG
	bool "hisi suspend-resume debug interface"
	depends on PM
	default n
	help
	suspend-resume debug for hisi platform

config HISI_SR_DEBUG_SLEEP
	bool "hisi suspend-resume debug sleep"
	depends on PM
	default n
	help
	suspend-resume debug sleep for hisi platform

config HISI_BALONG_MODEM
	bool "Hisilicon ap+modem config"
	default n
	help
	Hisilicon ap+modem config support.
```

## arch/arm/mach-hs/Kconfig
```kconfig
menu "Hisilicon Hi3xxx family"

config ARCH_HS
	bool "Hisilicon Hi36xx/Hi37xx family" if ARCH_MULTI_V7
	select CACHE_L2X0
	select CACHE_PL310
	select PINCTRL
	select PINCTRL_SINGLE
	select SERIAL_AMBA_PL011
	select SERIAL_AMBA_PL011_CONSOLE
	help
	  Support for Hislicon Hi36xx/Hi37xx processor family

if ARCH_HS

config MACH_HS_DT
	bool "Hisilicon Development Board"
	default y
	help
	  Say 'Y' here if you want to support the Hisilicon Development
	  Board.

menu "Hisilicon Hi3620 Features"

config IPPS_SUPPORT
	bool "IPPS driver support"
	select ARCH_HAS_CPUFREQ
	default n
	help
	  IPPS driver support for cpu gpu ddr dvfs

config IPPS_PARAM_ALTERNATIVE
	bool "IPPS parameters seperate from firmware"
	default n
	help
	  IPPS parameters seperate from firmware

config TRIM_VOL
	bool "TRIM Voltage support"
	default n
	help
	  TRIM Voltage Patch Support
endmenu
endif

endmenu
```

## arch/arm64/Kconfig.debug
```kconfig
menu "Kernel hacking"

source "lib/Kconfig.debug"

config FRAME_POINTER
	bool
	default y

config DEBUG_STACK_USAGE
	bool "Enable stack utilization instrumentation"
	depends on DEBUG_KERNEL
	help
	  Enables the display of the minimum amount of free stack which each
	  task has ever had available in the sysrq-T output.

config STRICT_DEVMEM
	bool "Filter access to /dev/mem"
	depends on MMU
	help
	  If this option is disabled, you allow userspace (root) access to all
	  of memory, including kernel and userspace memory. Accidental
	  access to this is obviously disastrous, but specific access can
	  be used by people debugging the kernel.

	  If this option is switched on, the /dev/mem file only allows
	  userspace access to memory mapped peripherals.

	  If in doubt, say Y.

config ARM64_PTDUMP
	bool "Export kernel pagetable layout to userspace via debugfs"
	depends on DEBUG_KERNEL
	select DEBUG_FS
        help
	  Say Y here if you want to show the kernel pagetable layout in a
	  debugfs file. This information is only useful for kernel developers
	  who are working in architecture specific areas of the kernel.
	  It is probably not a good idea to enable this feature in a production
	  kernel.
	  If in doubt, say "N"	  
	  
config EARLY_PRINTK
	bool "Early printk support"
	default y
	help
	  Say Y here if you want to have an early console using the
	  earlyprintk=<name>[,<addr>][,<options>] kernel parameter. It
	  is assumed that the early console device has been initialised
	  by the boot loader prior to starting the Linux kernel.

config PID_IN_CONTEXTIDR
	bool "Write the current PID to the CONTEXTIDR register"
	help
	  Enabling this option causes the kernel to write the current PID to
	  the CONTEXTIDR register, at the expense of some additional
	  instructions during context switch. Say Y here only if you are
	  planning to use hardware trace tools with this kernel.

config DEBUG_RODATA
	bool "Make kernel text and rodata read-only"
	help
	  If this is set, kernel text and rodata will be made read-only. This
	  is to help catch accidental or malicious attempts to change the
	  kernel's executable code. Additionally splits rodata from kernel
	  text so it can be made explicitly non-executable.

          If in doubt, say Y

config DEBUG_ALIGN_RODATA
	depends on DEBUG_RODATA && !ARM64_64K_PAGES
	bool "Align linker sections up to SECTION_SIZE"
	help
	  If this option is enabled, sections that may potentially be marked as
	  read only or non-executable will be aligned up to the section size of
	  the kernel. This prevents sections from being split into pages and
	  avoids a potential TLB penalty. The downside is an increase in
	  alignment and potentially wasted space. Turn on this option if
	  performance is more important than memory pressure.

	  If in doubt, say N

config DEBUG_SET_MODULE_RONX
        bool "Set loadable kernel module data as NX and text as RO"
        depends on MODULES
        help
          This option helps catch unintended modifications to loadable
          kernel module's text and read-only data. It also prevents execution
          of module data. Such protection may interfere with run-time code
          patching and dynamic kernel tracing - and they might also protect
          against certain classes of kernel exploits.
          If in doubt, say "N".

config FORCE_PAGES
        bool "Force lowmem to be mapped with 4K pages"
        help
          There are some advanced debug features that can only be done when
          memory is mapped with pages instead of sections. Enable this option
          to always map lowmem pages with pages. This may have a performance
          cost due to increased TLB pressure.

          If unsure say N.

config FREE_PAGES_RDONLY
        bool "Set pages as read only while on the buddy list"
        select FORCE_PAGES
        select DEBUG_PAGEALLOC
        help
          Pages are always mapped in the kernel. This means that anyone
          can write to the page if they have the address. Enable this option
          to mark pages as read only to trigger a fault if any code attempts
          to write to a page on the buddy list. This may have a performance
          impact.

          If unsure, say N.		  
		  
endmenu
```

## arch/arm64/configs/eng_defconfig/hi3650/hisi_debug_defconfig
```kconfig
CONFIG_KPROBES=y
CONFIG_HAVE_KPROBES=y
CONFIG_KRETPROBES=y
CONFIG_HAVE_KRETPROBES=y
```

## drivers/atfdriver/Kconfig
```kconfig
config ATFDRIVER 
    tristate "Secure Execution Communicator driver"
    default n
    help
      Provides a communication interface between userspace and
      Trusted Firmware -BL31 Operating Environment.
```

## drivers/clk/hisilicon/Kconfig
```kconfig
config HI3xxx_CLK_CORE
	bool "Core clock driver of Hi3xxx Soc"
	default n if COMMON_CLK

config HI3620_CLK_MIPI_DSI
	bool "MIPI DSI clock driver of Hi3620 SoC"
	default y if COMMON_CLK && FB_HI3620

config HISI_CLK
	bool "clock driver of Hi6250 and hi3650 Soc"
	default n

config HISI_CLK_ALWAYS_ON
	bool "all clocks of Hisi Soc are always on"
	default n

config HISI_CLK_HI3660
	bool "3660 clock spec"
	default n

config HISI_HI6250_CLK
	bool "6250 clock spec"
	default n

config HISI_CLK_MAILBOX_SUPPORT
	depends on HISI_CLK
	depends on HISI_MAILBOX
	bool "clk driver support mailbox communication"
	default n

config HISI_CLK_DEBUG 
	depends on COMMON_CLK_DEBUG
	bool "HiSilicon clock driver debug"
	default n
```

## drivers/connectivity/Kconfig
```kconfig
#
# Generic huawei hisi misc drivers configuration
#
menuconfig CONNECTIVITY_HI110X
	bool "Hisilicon Wireless Connectivity Support"
	---help---
		If you want to use Hisilicon  Wireless Connectivity, you should set this,
		and choose one product

if CONNECTIVITY_HI110X

if ARCH_HI6250

config HISI_GPS_REF_CLK
       bool "hisi_gnss_refclk"
       default y
endif

config HI110X_DRIVER_PATH
	string "The Kernel Driver Path"
	default "drivers/connectivity/hisi"

source "drivers/connectivity/hisi/Kconfig"
source "drivers/connectivity/hisi/platform/Kconfig"
source "drivers/connectivity/hisi/wifi/Kconfig"
endif
```

## drivers/contexthub/Kconfig
```kconfig
menuconfig CONTEXTHUB
	tristate "contexthub feature support"
	default n
	help
	  Say Y here to enable context hub feature support. This allows
	  mcu to manage all sensors.
config  IOM3_RECOVERY
	bool "iom7 recovery feature support"
	default n

	help
	  Say 'Y' here if you want to support the cmdline parse
```

## drivers/cpufreq/hisi/Kconfig.arm
```kconfig
config ARCH_HISI_MAXFREQ
	bool "Hisilicon platform cpu max freq recognition"
	depends on PM_OPP
	default n
	help
	  Hisilicon platform cpu max freq recognition.
```

## drivers/crypto/dx_ccp63/Kconfig
```kconfig
#
# DX CC-P Driver Layer
#

comment "DX CC-P Sep RAM size"

config DX_SEP_SRAM_SIZE
	int
	default "4096"

comment "DX CC-P ROM Version"

config DX_ROM_VERSION
	hex
	default "0x03000009"

comment "DX CC-P coherent dma ops"

config DX_DISABLE_COHERENT_DMA_OPS
	bool "DX CC-P coherent dma ops"
	default y
	help
	  DX CC-P coherent dma ops

config DX_FPGA_ENV
	bool "DX CC-P FPGA envirament"
	default n
	help
	  DX CC-P FPGA envirament

config DX_DEBUG
	bool "DX CC-P driver debug option"
	default n
	help
	  DX CC-P driver debug option
```

## drivers/devfreq/hisi/Kconfig
```kconfig
config DEVFREQ_GOV_MALI_ONDEMAND
	tristate "Mali Ondemand"
	help
	  Base on simple ondemand governor.

config DEVFREQ_GOV_PM_QOS
	bool "PM QOS"
	help
	  Sets the frequency based on pm_qos throughput constraints.

config HISI_DDR_DEVFREQ_DEBUGFS
	bool "Hisilicon ddr devfreq debugfs"
	depends on HI3650_DDR_DEVFREQ && DEBUG_FS
	default n
	help
	  This is a testing driver for HISI ddr devfreq function.

config HISI_DDR_DEVFREQ
	bool "Hisilicon ddr devfreq support"
	depends on PM_DEVFREQ && PM_OPP
	select DEVFREQ_GOV_PM_QOS
	default n
	help
	  Scale ddr freqency down threshold for HI3650 platform.
```

## drivers/dsm/Kconfig
```kconfig
#
# huawei device state monitor configuration
#

config HUAWEI_DSM
	bool "huawei dsm"
	default n
	help
	  If you say yes here you get support for huawei touchscreen.
config HUAWEI_SDCARD_VOLD
	bool "huawei sdcard vold"
	default y
	help
	  If you say yes here you get support for huawei vold radar.
```

## drivers/dsm/dsm_earlyboot_client/Kconfig
```kconfig
config DSM_EARLYBOOT_CLIENT
    default y
    help
This module adds support for bus dmd based on Balong V3R3 chipset.
```
