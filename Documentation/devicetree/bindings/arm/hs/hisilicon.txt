## Documentation/devicetree/bindings/arm/hs/hisilicon.txt
```
Hisilicon Platforms Device Tree Bindings
----------------------------------------------------

Hi3716 Development Board
Required root node properties:
	- compatible = "hisilicon,hi3716-dkb";

Hi4511 Board
Required root node properties:
	- compatible = "hisilicon,hi3620-hi4511";


Hisilicon sctrl resiter description

Required properties:
- compatible : "hisilicon,sctrl"
- reg : Address and size of sysctrl.
- smp_reg : offset in sysctrl for notifying slave cpu booting
		cpu 1, reg;
		cpu 2, reg + 0x4;
		cpu 3, reg + 0x8;
		If reg value is not zero, cpun exit wfi and go
- resume_reg : offset in sysctrl for notifying cpu0 when resume
- reset_reg : offset in sysctrl for system reset

Example:
	hi3716:
	sctrl@f8000000 {
		compatible = "hisilicon,sctrl";
		reg = <0xf8000000 0x1000>;
		smp_reg = <0xc0>;
		reboot_reg = <0x4>;
	};

	hi3620:
	sctrl@fc802000 {
		compatible = "hisilicon,sctrl";
		reg = <0xfc802000 0x1000>;
		smp_reg = <0x31c>;
		resume_reg = <0x308>;
		reboot_reg = <0x4>;
	};
```

## Documentation/devicetree/bindings/mmc/arasan,sdhci.txt
```
Device Tree Bindings for the Arasan SDCHI Controller

  The bindings follow the mmc[1] and the clock bindings[2]. Only deviations are
  documented here.

  [1] Documentation/devicetree/bindings/mmc/mmc.txt
  [2] Documentation/devicetree/bindings/clock/clock-bindings.txt

Required Properties:
  - compatible: Compatibility string. Must be 'arasan,sdhci'
  - reg: From mmc bindings: Register location and length.
  - clocks: From clock bindings: Handles to clock inputs.
  - clock-names: From clock bindings: Tuple including "clk_xin" and "clk_ahb"

Example:
	sdhci@e0100000 {
		compatible = "arasan,sdhci";
		reg = <0xe0100000 0x1000>;
		clock-names = "clk_xin", "clk_ahb";
		clocks = <&clkc 21>, <&clkc 32>;
		interrupt-parent = <&gic>;
		interrupts = <0 24 4>;
	} ;
```

## Documentation/devicetree/bindings/mmc/hisilicon-dw-mshc.txt
```
* Hisilicon specific extensions to the Synopsis Designware Mobile
  Storage Host Controller

Read synopsis-dw-mshc.txt for more details
The Synopsis designware mobile storage host controller is used to interface
a SoC with storage medium such as eMMC or SD/MMC cards. This file documents
differences between the core Synopsis dw mshc controller properties described
by synopsis-dw-mshc.txt and the properties used by the Hisilicon specific
extensions to the Synopsis Designware Mobile Storage Host Controller.

Required Properties:

* compatible: should be
	- "hisilicon,hi4511-dw-mshc": for controllers with hi4511
	  specific extentions.
	- "hisilicon,hi3620-dw-mshc": for controllers with hi3620
	  specific extentions.

Required properties for a slot:

* vmmc-supply is vmmc used in dwmmc
* fifo-depth should be provided if register can not provide correct value

Example:

  The MSHC controller node can be split into two portions, SoC specific and
  board specific portions as listed below.

	dwmmc_0: dwmmc0@fcd03000 {
		compatible = "hisilicon,hi4511-dw-mshc";
		reg = <0xfcd03000 0x1000>;
		interrupts = <0 16 4>;
		#address-cells = <1>;
		#size-cells = <0>;
		clocks = <&clk_sd>, <&clk_ddrc_per>;
		clock-names = "ciu", "biu";
	};
	dwmmc0@fcd03000 {
		num-slots = <1>;
		vmmc-supply = <&ldo12>;
		fifo-depth = <0x100>;
		supports-highspeed;
		pinctrl-names = "default";
		pinctrl-0 = <&sd_pmx_pins &sd_cfg_func1 &sd_cfg_func2>;
		slot@0 {
			reg = <0>;
			bus-width = <4>;
			hisilicon,cd-pinmux-gpio = <&gpio10 3 0>;
		};
	};
```
