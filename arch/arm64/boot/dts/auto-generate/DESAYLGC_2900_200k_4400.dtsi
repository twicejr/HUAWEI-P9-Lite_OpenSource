/* DO NOT EDIT - Automatically generated by python */
/ {
		DESAYLGC_2900_200k_4400:DESAYLGC_2900_200k_4400 {
			fcc = <2900>;
			default_rbatt_mohm = <100>;
			id_identify_min = <2786>;
			id_identify_max = <3312>;
			id_voltage_min = <2941>;
			id_voltage_max = <3167>;
			vbat_max = <4400>;
			temp_para = 
						"-32767","0","-1","0","4100","0",
						"0","5","-1","290","4400","0",
						"5","10","-1","870","4400","3",
						"10","45","-1","-1","4400","3",
						"45","50","-1","1015","4400","3",
						"50","32767","-1","0","4400","0";
			vbat_para = 
						"-32767","3400","-1","820","0",
						"3400","32767","-1","-1","0";
			segment_para = 
						"-32767","4150","2900","4208","50",
						"4150","4450","2030","4400","0";
			batt_brand = "DESAYLGC";
			fcc_temp = <2969 2972 3010 3010 2983 2954>;
			fcc_sf_x = <0 100 200 300 400 500>;
			fcc_sf_y = <100 96 94 92 90 88>;
			fcc_sf_cols = <6>;
			pc_sf_rows = <1>;
			pc_sf_cols = <1>;
			pc_sf_row_entries = <0>;
			pc_sf_percent = <100>;
			pc_sf_sf = <100>;
			rbatt_sf_rows = <28>;
			rbatt_sf_cols = <6>;
			rbatt_sf_percent = <100 95 90 85 80 75 70 65 60 55 50 45 40 35 30 25 20 15 10 9 8 7 6 5 4 3 2 1>;
			rbatt_sf_sf = <
			               2338 1341 622 128 88 71
			               2334 1340 622 128 88 71
			               2208 1311 613 131 90 73
			               2113 1291 608 136 95 75
			               2062 1259 613 143 99 79
			               2024 1306 630 154 105 82
			               1827 1209 670 172 114 87
			               1821 1100 549 178 124 92
			               1791 1102 522 173 128 98
			               1799 1090 512 137 108 85
			               1834 1083 511 124 90 75
			               1872 1121 516 128 94 77
			               1930 1171 529 135 101 82
			               2010 1235 563 144 107 87
			               2110 1309 611 149 106 86
			               2242 1394 663 146 100 79
			               2408 1517 713 141 96 77
			               2618 1706 821 134 92 76
			               4512 1995 796 141 95 82
			               4711 2102 847 144 97 76
			               4924 2268 910 147 97 81
			               5174 2440 1005 151 99 81
			               5388 2536 1061 149 101 79
			               5679 2660 1109 152 100 80
			               5944 2794 1138 164 103 87
			               6236 2961 1195 262 117 82
			               6648 3255 1328 717 174 98
			               7182 3669 1799 465 214 161
			              >;
			pc_temp_ocv_rows = <29>;
			pc_temp_ocv_cols = <6>;
			pc_temp_ocv_percent = <100 95 90 85 80 75 70 65 60 55 50 45 40 35 30 25 20 15 10 9 8 7 6 5 4 3 2 1>;
			pc_temp_ocv_ocv = <
			                   4392 4388 4390 4374 4365 4358
			                   4302 4308 4324 4314 4308 4303
			                   4231 4240 4261 4257 4251 4248
			                   4170 4182 4203 4200 4196 4193
			                   4118 4126 4149 4146 4141 4139
			                   4066 4088 4099 4095 4089 4088
			                   3970 4015 4052 4048 4041 4039
			                   3929 3943 3968 3987 3993 3994
			                   3885 3906 3922 3945 3949 3951
			                   3852 3869 3885 3896 3900 3901
			                   3829 3835 3854 3859 3861 3862
			                   3810 3815 3826 3833 3835 3835
			                   3794 3800 3803 3811 3813 3814
			                   3779 3786 3788 3793 3795 3794
			                   3764 3771 3776 3777 3776 3772
			                   3748 3752 3759 3761 3756 3744
			                   3730 3732 3735 3737 3732 3718
			                   3708 3714 3715 3704 3700 3689
			                   3679 3694 3696 3688 3681 3669
			                   3670 3686 3691 3687 3680 3668
			                   3657 3680 3685 3685 3678 3666
			                   3643 3672 3677 3680 3675 3663
			                   3624 3659 3662 3668 3668 3654
			                   3602 3637 3639 3635 3642 3626
			                   3572 3605 3604 3589 3601 3586
			                   3532 3558 3556 3534 3549 3534
			                   3479 3495 3487 3486 3481 3464
			                   3399 3403 3401 3388 3382 3367
			                   3200 3200 3200 3200 3200 3200
			                  >;
		};
};
