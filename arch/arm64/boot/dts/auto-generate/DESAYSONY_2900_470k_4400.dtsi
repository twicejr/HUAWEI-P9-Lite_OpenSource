/* DO NOT EDIT - Automatically generated by python */
/ {
		DESAYSONY_2900_470k_4400:DESAYSONY_2900_470k_4400 {
			fcc = <2900>;
			default_rbatt_mohm = <100>;
			id_identify_min = <3312>;
			id_identify_max = <3767>;
			id_voltage_min = <3457>;
			id_voltage_max = <3696>;
			vbat_max = <4400>;
			temp_para = 
						"-32767","0","-1","0","4100","0",
						"0","5","-1","290","4400","0",
						"5","10","-1","870","4400","3",
						"10","45","-1","-1","4400","3",
						"45","50","-1","1015","4400","3",
						"50","32767","-1","0","4400","0";
			vbat_para = 
						"-32767","3400","-1","820","0",
						"3400","32767","-1","-1","0";
			segment_para = 
						"-32767","4150","2900","4208","50",
						"4150","4450","2030","4400","0";
			batt_brand = "DESAYSONY";
			fcc_temp = <2930 2945 2948 2997 2961 2940>;
			fcc_sf_x = <0 100 200 300 400 500>;
			fcc_sf_y = <100 96 94 92 90 88>;
			fcc_sf_cols = <6>;
			pc_sf_rows = <1>;
			pc_sf_cols = <1>;
			pc_sf_row_entries = <0>;
			pc_sf_percent = <100>;
			pc_sf_sf = <100>;
			rbatt_sf_rows = <28>;
			rbatt_sf_cols = <6>;
			rbatt_sf_percent = <100 95 90 85 80 75 70 65 60 55 50 45 40 35 30 25 20 15 10 9 8 7 6 5 4 3 2 1>;
			rbatt_sf_sf = <
			               1308 801 390 155 119 106
			               1309 802 390 155 119 106
			               1343 827 404 161 122 107
			               1357 851 410 167 126 109
			               1344 860 428 173 130 112
			               1352 900 450 182 136 115
			               1286 863 469 192 142 119
			               1269 815 454 209 152 125
			               1275 807 399 212 161 131
			               1287 818 378 176 141 118
			               1319 825 386 156 123 109
			               1378 868 399 161 127 110
			               1444 930 417 168 134 116
			               1532 1013 442 176 140 121
			               1634 1116 482 183 138 121
			               1755 1254 535 180 131 113
			               1952 1434 591 172 129 112
			               2337 1694 653 167 126 112
			               3184 1728 640 164 132 117
			               3518 1861 623 168 131 116
			               3930 2080 653 173 130 115
			               4437 2314 712 175 132 116
			               5029 2612 763 177 132 117
			               5777 3034 830 179 129 114
			               6802 3476 922 176 130 113
			               8344 4133 1022 195 133 114
			               10979 5330 1242 285 162 138
			               18098 6833 1464 390 256 166
			              >;
			pc_temp_ocv_rows = <29>;
			pc_temp_ocv_cols = <6>;
			pc_temp_ocv_percent = <100 95 90 85 80 75 70 65 60 55 50 45 40 35 30 25 20 15 10 9 8 7 6 5 4 3 2 1>;
			pc_temp_ocv_ocv = <
			                   4386 4382 4380 4379 4368 4362
			                   4306 4309 4314 4322 4312 4308
			                   4240 4245 4256 4267 4257 4253
			                   4178 4186 4197 4210 4202 4198
			                   4115 4127 4142 4155 4147 4144
			                   4063 4080 4091 4102 4095 4093
			                   3996 4018 4042 4052 4047 4045
			                   3942 3954 3988 4005 4002 4000
			                   3899 3907 3929 3957 3958 3958
			                   3862 3869 3884 3905 3905 3905
			                   3831 3834 3852 3865 3866 3866
			                   3809 3810 3824 3838 3839 3840
			                   3789 3792 3802 3815 3818 3817
			                   3772 3779 3784 3796 3798 3798
			                   3755 3765 3771 3780 3779 3776
			                   3730 3749 3759 3762 3757 3747
			                   3703 3724 3736 3737 3731 3720
			                   3679 3684 3694 3700 3698 3688
			                   3654 3648 3660 3676 3672 3662
			                   3645 3641 3658 3674 3670 3660
			                   3637 3637 3654 3671 3668 3658
			                   3628 3630 3650 3667 3665 3654
			                   3618 3620 3643 3661 3659 3649
			                   3602 3607 3631 3648 3645 3632
			                   3573 3581 3606 3613 3610 3595
			                   3526 3532 3557 3557 3556 3540
			                   3455 3465 3488 3485 3483 3469
			                   3355 3366 3387 3384 3383 3367
			                   3200 3200 3200 3200 3200 3200
			                  >;
		};
};
