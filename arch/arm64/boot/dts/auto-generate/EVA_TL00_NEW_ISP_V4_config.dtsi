/**
 * Huawei Ltd.
 * PhosphorV660
 */


/include/ "EVA_TL00_NEW_V4_config.dtsi"

/{
	hisi,modem_id = <0x3C012000>;
	hisi,boardid = <3 5 6 8>;
	hisi,boardname = "EVA_TL00_NEW_ISP_V4";

	amba{
		spi0: spi@ffd70000{
			depth_isp: depth_isp@0 {
				/*chip-type 1:dummy  2:Al6045  4:Al6610*/
				depth_isp,chip_type = <4>;
			};
		};
	};
};
