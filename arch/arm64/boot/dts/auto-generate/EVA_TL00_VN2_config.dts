/**
 * Huawei Ltd.
 * PhosphorV660
 */

/dts-v1/;

/include/ "fastboot.dtsi"
/include/ "EVA_TL00_VN1_config.dtsi"
/include/ "EVA_TL00_VN2_pin.dtsi"
/include/ "EVA_TL00_VN2_modem_pin.dtsi"
/include/ "EVA_TL00_VN2_hi6402_pin.dtsi"

/{
	hisi,modem_id = <0x3C013400>;
	hisi,boardid = <3 5 8 7>;
	hisi,boardname = "EVA_TL00_VN2";
	hisi,config_profile = "normalhigh";
	target-cpu {
		target_cpu = "Kirin 955";
	};
};
