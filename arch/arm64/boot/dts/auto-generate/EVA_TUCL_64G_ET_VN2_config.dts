/**
 * Huawei Ltd.
 * PhosphorV660
 */

/dts-v1/;

/include/ "fastboot.dtsi"
/include/ "EVA_TUCL_64G_ET_VN1_config.dtsi"
/include/ "EVA_TUCL_64G_ET_VN2_pin.dtsi"
/include/ "EVA_TUCL_64G_ET_VN2_modem_pin.dtsi"
/include/ "EVA_TUCL_64G_ET_VN2_hi6402_pin.dtsi"

/{
	hisi,modem_id = <0x3C013C00>;
	hisi,boardid = <3 5 8 5>;
	hisi,boardname = "EVA_TUCL_64G_ET_VN2";
	hisi,config_profile = "highhigh";
	target-cpu {
		target_cpu = "Kirin 955";
	};
};
