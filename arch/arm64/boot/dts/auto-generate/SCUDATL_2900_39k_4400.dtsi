/* DO NOT EDIT - Automatically generated by python */
/ {
		SCUDATL_2900_39k_4400:SCUDATL_2900_39k_4400 {
			fcc = <2900>;
			default_rbatt_mohm = <100>;
			id_identify_min = <1235>;
			id_identify_max = <1759>;
			id_voltage_min = <1420>;
			id_voltage_max = <1562>;
			vbat_max = <4400>;
			temp_para = 
						"-32767","0","-1","0","4100","0",
						"0","5","-1","290","4400","0",
						"5","10","-1","870","4400","3",
						"10","45","-1","-1","4400","3",
						"45","50","-1","1015","4400","3",
						"50","32767","-1","0","4400","0";
			vbat_para = 
						"-32767","3400","-1","820","0",
						"3400","32767","-1","-1","0";
			segment_para = 
						"-32767","4150","2900","4208","50",
						"4150","4450","2030","4400","0";
			batt_brand = "SCUDATL";
			fcc_temp = <2940 2938 2935 2952 2947 2927>;
			fcc_sf_x = <0 100 200 300 400 500>;
			fcc_sf_y = <100 96 94 92 90 88>;
			fcc_sf_cols = <6>;
			pc_sf_rows = <1>;
			pc_sf_cols = <1>;
			pc_sf_row_entries = <0>;
			pc_sf_percent = <100>;
			pc_sf_sf = <100>;
			rbatt_sf_rows = <28>;
			rbatt_sf_cols = <6>;
			rbatt_sf_percent = <100 95 90 85 80 75 70 65 60 55 50 45 40 35 30 25 20 15 10 9 8 7 6 5 4 3 2 1>;
			rbatt_sf_sf = <
			               2312 1233 550 132 105 95
			               2309 1233 550 132 105 95
			               2110 1214 544 132 106 94
			               1959 1187 545 134 108 96
			               1849 1151 549 138 110 97
			               1804 1173 579 145 114 99
			               1605 1079 587 155 120 102
			               1596 992 512 168 128 107
			               1587 997 499 175 137 113
			               1583 982 481 139 115 99
			               1615 988 478 128 106 95
			               1676 1024 481 129 105 96
			               1754 1109 496 131 109 98
			               1847 1212 549 135 114 102
			               1952 1336 620 136 115 104
			               2068 1471 710 131 105 95
			               2207 1624 827 129 105 94
			               2394 1764 993 131 106 94
			               3061 1415 774 128 107 96
			               3492 1582 828 129 107 97
			               3975 1807 904 131 107 98
			               4444 2051 1012 133 108 100
			               5047 2350 1188 132 109 102
			               5737 2735 1383 134 108 98
			               6563 3190 1588 135 110 98
			               7637 3817 1925 137 112 101
			               9197 4802 2526 144 119 103
			               12257 6435 3589 167 120 105
			              >;
			pc_temp_ocv_rows = <29>;
			pc_temp_ocv_cols = <6>;
			pc_temp_ocv_percent = <100 95 90 85 80 75 70 65 60 55 50 45 40 35 30 25 20 15 10 9 8 7 6 5 4 3 2 1>;
			pc_temp_ocv_ocv = <
			                   4383 4380 4377 4372 4368 4363
			                   4288 4297 4302 4306 4303 4299
			                   4219 4230 4239 4247 4245 4241
			                   4160 4170 4182 4189 4187 4184
			                   4103 4111 4128 4133 4131 4128
			                   4055 4068 4078 4080 4078 4076
			                   3963 3999 4022 4031 4030 4028
			                   3922 3937 3957 3983 3984 3983
			                   3884 3900 3916 3940 3942 3941
			                   3850 3862 3875 3888 3889 3888
			                   3827 3830 3842 3853 3854 3854
			                   3811 3809 3816 3828 3829 3828
			                   3797 3798 3797 3808 3809 3808
			                   3784 3788 3787 3792 3792 3791
			                   3771 3779 3778 3777 3775 3772
			                   3757 3767 3767 3760 3753 3742
			                   3743 3749 3750 3741 3732 3720
			                   3727 3725 3722 3716 3707 3696
			                   3702 3696 3691 3691 3684 3673
			                   3695 3691 3687 3690 3683 3671
			                   3688 3687 3684 3688 3681 3670
			                   3680 3682 3679 3686 3679 3667
			                   3670 3675 3672 3682 3674 3661
			                   3652 3661 3658 3669 3657 3644
			                   3622 3630 3627 3632 3619 3606
			                   3575 3579 3576 3581 3567 3556
			                   3507 3508 3505 3512 3499 3489
			                   3402 3400 3401 3410 3398 3389
			                   3200 3200 3200 3200 3200 3200
			                  >;
		};
};
