/* DO NOT EDIT - Automatically generated by python */
/ {
		SUNWODASDI_2900_22k_4400:SUNWODASDI_2900_22k_4400 {
			fcc = <2900>;
			default_rbatt_mohm = <100>;
			id_identify_min = <751>;
			id_identify_max = <1235>;
			id_voltage_min = <949>;
			id_voltage_max = <1051>;
			vbat_max = <4400>;
			temp_para = 
						"-32767","0","-1","0","4100","0",
						"0","5","-1","290","4400","0",
						"5","10","-1","870","4400","3",
						"10","45","-1","-1","4400","3",
						"45","50","-1","1015","4400","3",
						"50","32767","-1","0","4400","0";
			vbat_para = 
						"-32767","3400","-1","820","0",
						"3400","32767","-1","-1","0";
			segment_para = 
						"-32767","4150","2900","4208","50",
						"4150","4450","2030","4400","0";
			batt_brand = "SUNWODASDI";
			fcc_temp = <2934 2933 2965 2951 2931 2909>;
			fcc_sf_x = <0 100 200 300 400 500>;
			fcc_sf_y = <100 96 94 92 90 88>;
			fcc_sf_cols = <6>;
			pc_sf_rows = <1>;
			pc_sf_cols = <1>;
			pc_sf_row_entries = <0>;
			pc_sf_percent = <100>;
			pc_sf_sf = <100>;
			rbatt_sf_rows = <28>;
			rbatt_sf_cols = <6>;
			rbatt_sf_percent = <100 95 90 85 80 75 70 65 60 55 50 45 40 35 30 25 20 15 10 9 8 7 6 5 4 3 2 1>;
			rbatt_sf_sf = <
			               2293 1454 733 160 118 100
			               2291 1453 732 160 118 100
			               2140 1403 720 161 117 101
			               2010 1367 709 164 119 102
			               1938 1319 719 170 122 103
			               1880 1326 753 178 126 105
			               1626 1147 733 199 137 108
			               1625 1053 613 199 141 113
			               1587 1042 594 208 153 123
			               1637 1031 561 168 134 111
			               1708 1021 545 151 115 101
			               1777 1105 545 152 116 100
			               1858 1198 574 156 120 104
			               1947 1298 652 161 126 108
			               2039 1392 744 165 128 110
			               2150 1471 841 162 120 103
			               2290 1557 926 160 117 101
			               2479 1687 1034 162 117 102
			               3489 1591 855 161 120 104
			               3798 1745 903 160 119 108
			               4025 1832 980 162 121 107
			               4162 1990 1057 166 123 108
			               4486 2193 1156 168 121 109
			               4665 2348 1270 165 121 107
			               4969 2427 1298 170 118 107
			               5274 2622 1340 177 124 109
			               5592 2831 1461 196 128 112
			               6244 3224 1716 528 161 123
			              >;
			pc_temp_ocv_rows = <29>;
			pc_temp_ocv_cols = <6>;
			pc_temp_ocv_percent = <100 95 90 85 80 75 70 65 60 55 50 45 40 35 30 25 20 15 10 9 8 7 6 5 4 3 2 1>;
			pc_temp_ocv_ocv = <
			                   4388 4385 4390 4372 4361 4353
			                   4275 4287 4307 4306 4299 4295
			                   4208 4217 4242 4248 4241 4238
			                   4150 4163 4184 4192 4186 4182
			                   4104 4112 4131 4139 4132 4128
			                   4058 4076 4087 4086 4080 4077
			                   3950 3990 4030 4044 4036 4030
			                   3908 3928 3952 3975 3980 3986
			                   3860 3888 3911 3942 3946 3945
			                   3837 3855 3873 3893 3895 3894
			                   3821 3822 3842 3856 3856 3856
			                   3804 3808 3816 3830 3830 3829
			                   3787 3796 3796 3809 3810 3808
			                   3771 3783 3786 3792 3792 3791
			                   3754 3768 3775 3776 3775 3772
			                   3741 3751 3762 3761 3755 3744
			                   3728 3733 3742 3740 3733 3720
			                   3714 3719 3719 3712 3706 3693
			                   3690 3704 3698 3689 3681 3669
			                   3685 3700 3693 3687 3680 3668
			                   3678 3693 3690 3685 3679 3667
			                   3664 3688 3684 3682 3677 3665
			                   3652 3681 3677 3676 3672 3659
			                   3631 3667 3664 3654 3659 3643
			                   3604 3638 3638 3610 3623 3607
			                   3565 3592 3592 3549 3570 3555
			                   3503 3524 3520 3464 3498 3486
			                   3404 3417 3411 3334 3394 3385
			                   3200 3200 3200 3200 3200 3200
			                  >;
		};
};
