/* DO NOT EDIT - Automatically generated by python */
/ {
		coslightguangyu_3400_68k_4400:coslightguangyu_3400_68k_4400 {
			fcc = <3400>;
			default_rbatt_mohm = <100>;
			id_identify_min = <1759>;
			id_identify_max = <2281>;
			id_voltage_min = <1956>;
			id_voltage_max = <2135>;
			vbat_max = <4400>;
			temp_para = 
						"-32767","0","-1","0","4100","0",
						"0","10","-1","1020","4400","3",
						"10","45","-1","-1","4400","3",
						"45","50","-1","1190","4400","3",
						"50","32767","-1","0","4400","0";
			vbat_para = 
						"-32767","3400","-1","820","0",
						"3400","32767","-1","-1","0";
			segment_para = 
						"-32767","4150","3400","4208","50",
						"4150","4450","2380","4400","0";
			batt_brand = "coslightguangyu";
			fcc_temp = <3444 3445 3446 3462 3457 3433>;
			fcc_sf_x = <0 100 200 300 400 500>;
			fcc_sf_y = <100 96 94 92 90 88>;
			fcc_sf_cols = <6>;
			pc_sf_rows = <1>;
			pc_sf_cols = <1>;
			pc_sf_row_entries = <0>;
			pc_sf_percent = <100>;
			pc_sf_sf = <100>;
			rbatt_sf_rows = <28>;
			rbatt_sf_cols = <6>;
			rbatt_sf_percent = <100 95 90 85 80 75 70 65 60 55 50 45 40 35 30 25 20 15 10 9 8 7 6 5 4 3 2 1>;
			rbatt_sf_sf = <
			               2217 1484 816 172 117 101
			               2214 1483 815 172 117 101
			               2045 1414 798 171 116 101
			               1916 1347 767 170 116 101
			               1829 1285 754 170 117 103
			               1759 1274 767 173 119 104
			               1604 1174 744 182 123 105
			               1583 1095 679 186 128 109
			               1557 1085 651 195 135 113
			               1541 1068 632 162 119 103
			               1573 1062 636 150 111 100
			               1613 1108 648 150 112 101
			               1661 1157 688 154 114 103
			               1723 1225 750 157 119 105
			               1799 1304 829 159 121 107
			               1892 1391 921 156 114 101
			               1997 1480 1030 155 112 102
			               2140 1577 1167 163 113 102
			               3342 1751 1121 158 115 103
			               3616 1905 1205 156 115 105
			               3863 2058 1292 162 116 104
			               4115 2231 1406 165 119 106
			               4378 2400 1559 167 119 106
			               4577 2572 1708 166 116 104
			               4835 2700 1766 167 117 104
			               5157 2871 1897 176 120 106
			               5614 3175 2094 189 123 107
			               6295 3617 2432 331 142 114
			              >;
			pc_temp_ocv_rows = <29>;
			pc_temp_ocv_cols = <6>;
			pc_temp_ocv_percent = <100 95 90 85 80 75 70 65 60 55 50 45 40 35 30 25 20 15 10 9 8 7 6 5 4 3 2 1>;
			pc_temp_ocv_ocv = <
			                   4397 4394 4391 4384 4379 4373
			                   4300 4306 4312 4324 4323 4318
			                   4221 4232 4245 4267 4267 4262
			                   4158 4169 4181 4210 4210 4206
			                   4103 4111 4126 4154 4154 4150
			                   4049 4067 4081 4100 4100 4096
			                   3966 4000 4026 4051 4049 4046
			                   3924 3939 3962 3997 4001 4000
			                   3884 3899 3913 3953 3955 3954
			                   3847 3862 3871 3899 3901 3900
			                   3827 3829 3839 3862 3864 3865
			                   3812 3814 3814 3835 3837 3837
			                   3798 3802 3800 3813 3815 3814
			                   3783 3790 3790 3793 3796 3794
			                   3768 3777 3779 3776 3777 3773
			                   3753 3761 3766 3758 3751 3741
			                   3737 3739 3746 3736 3728 3717
			                   3721 3716 3718 3709 3703 3692
			                   3698 3694 3687 3687 3681 3669
			                   3690 3689 3683 3685 3679 3668
			                   3680 3683 3678 3683 3677 3666
			                   3669 3677 3672 3679 3675 3663
			                   3654 3667 3664 3671 3668 3657
			                   3630 3649 3651 3648 3648 3635
			                   3595 3618 3622 3606 3610 3596
			                   3549 3569 3575 3550 3558 3545
			                   3487 3501 3507 3473 3488 3477
			                   3391 3397 3406 3361 3385 3377
			                   3200 3200 3200 3200 3200 3200
			                  >;
		};
};
