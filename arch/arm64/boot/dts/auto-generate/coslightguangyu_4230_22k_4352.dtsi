/* DO NOT EDIT - Automatically generated by python */
/ {
		coslightguangyu_4230_22k_4352:coslightguangyu_4230_22k_4352 {
			fcc = <4230>;
			default_rbatt_mohm = <100>;
			id_identify_min = <751>;
			id_identify_max = <1235>;
			id_voltage_min = <949>;
			id_voltage_max = <1051>;
			vbat_max = <4352>;
			temp_para = 
						"-32767","0","-1","0","4100","0",
						"0","10","-1","1269","4352","3",
						"10","45","-1","-1","4352","3",
						"45","50","-1","1480","4352","3",
						"50","32767","-1","0","4352","0";
			vbat_para = 
						"-32767","3400","-1","820","0",
						"3400","32767","-1","-1","0";
			segment_para = 
						"-32767","4150","4230","4208","50",
						"4150","4450","2961","4352","0";
			batt_brand = "coslightguangyu";
			fcc_temp = <4298 4298 4299 4316 4308 4281>;
			fcc_sf_x = <0 100 200 300 400 500>;
			fcc_sf_y = <100 96 94 92 90 88>;
			fcc_sf_cols = <6>;
			pc_sf_rows = <1>;
			pc_sf_cols = <1>;
			pc_sf_row_entries = <0>;
			pc_sf_percent = <100>;
			pc_sf_sf = <100>;
			rbatt_sf_rows = <28>;
			rbatt_sf_cols = <6>;
			rbatt_sf_percent = <100 95 90 85 80 75 70 65 60 55 50 45 40 35 30 25 20 15 10 9 8 7 6 5 4 3 2 1>;
			rbatt_sf_sf = <
			               1127 1127 585 130 100 92
			               1127 1127 585 130 100 92
			               1092 1092 579 128 100 93
			               1052 1052 566 130 101 93
			               1049 1049 588 132 102 94
			               945 945 563 141 108 95
			               905 905 528 135 105 96
			               890 890 535 148 111 98
			               868 868 508 148 116 101
			               872 872 500 126 102 95
			               891 891 510 121 99 93
			               917 917 531 121 99 94
			               946 946 559 123 100 95
			               985 985 597 125 103 96
			               1032 1032 641 126 103 96
			               1089 1089 698 125 99 93
			               1153 1153 770 126 99 93
			               1234 1234 864 130 100 93
			               1362 1362 825 127 102 95
			               1474 1474 881 126 103 96
			               1608 1608 975 129 105 96
			               1744 1744 1091 130 103 97
			               1896 1896 1195 132 105 98
			               2052 2052 1303 130 103 97
			               2222 2222 1388 131 103 97
			               2390 2390 1547 134 103 97
			               2659 2659 1773 138 105 97
			               3037 3037 2090 160 112 100
			              >;
			pc_temp_ocv_rows = <29>;
			pc_temp_ocv_cols = <6>;
			pc_temp_ocv_percent = <100 95 90 85 80 75 70 65 60 55 50 45 40 35 30 25 20 15 10 9 8 7 6 5 4 3 2 1>;
			pc_temp_ocv_ocv = <
			                   4331 4331 4333 4328 4323 4317
			                   4241 4241 4248 4260 4259 4255
			                   4178 4178 4187 4203 4203 4199
			                   4122 4122 4130 4150 4149 4145
			                   4080 4080 4088 4098 4097 4095
			                   3998 3998 4023 4057 4052 4047
			                   3944 3944 3964 3991 3996 4002
			                   3904 3904 3929 3959 3964 3961
			                   3865 3865 3882 3919 3922 3920
			                   3839 3839 3846 3871 3873 3872
			                   3821 3821 3821 3840 3842 3842
			                   3807 3807 3806 3818 3819 3819
			                   3795 3795 3795 3800 3801 3800
			                   3785 3785 3786 3786 3786 3784
			                   3773 3773 3776 3772 3770 3766
			                   3760 3760 3763 3758 3748 3736
			                   3740 3740 3744 3738 3728 3715
			                   3716 3716 3718 3712 3704 3692
			                   3693 3693 3689 3690 3682 3670
			                   3688 3688 3685 3688 3681 3669
			                   3683 3683 3681 3686 3679 3667
			                   3677 3677 3676 3683 3676 3664
			                   3666 3666 3667 3678 3671 3657
			                   3647 3647 3650 3661 3652 3635
			                   3615 3615 3618 3622 3614 3596
			                   3565 3565 3570 3569 3563 3545
			                   3496 3496 3502 3499 3494 3477
			                   3396 3396 3404 3397 3394 3377
			                   3200 3200 3200 3200 3200 3200
			                  >;
		};
};
