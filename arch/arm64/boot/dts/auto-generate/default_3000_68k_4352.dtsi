/* DO NOT EDIT - Automatically generated by python */
/ {
		default_3000_68k_4352:default_3000_68k_4352 {
			fcc = <3000>;
			default_rbatt_mohm = <100>;
			id_identify_min = <1759>;
			id_identify_max = <2281>;
			id_voltage_min = <1956>;
			id_voltage_max = <2135>;
			vbat_max = <4352>;
			temp_para = 
						"-32767","0","-1","0","4100","0",
						"0","5","-1","300","4352","0",
						"5","10","-1","900","4352","3",
						"10","45","-1","-1","4352","3",
						"45","50","-1","1050","4352","3",
						"50","32767","-1","0","4352","0";
			vbat_para = 
						"-32767","3400","-1","820","0",
						"3400","32767","-1","-1","0";
			segment_para = 
						"-32767","4150","3000","4208","50",
						"4150","4450","2100","4352","0";
			batt_brand = "default";
			fcc_temp = <3007 3010 3005 3022 3018 2996>;
			fcc_sf_x = <0 100 200 300 400 500>;
			fcc_sf_y = <100 96 94 92 90 88>;
			fcc_sf_cols = <6>;
			pc_sf_rows = <1>;
			pc_sf_cols = <1>;
			pc_sf_row_entries = <0>;
			pc_sf_percent = <100>;
			pc_sf_sf = <100>;
			rbatt_sf_rows = <28>;
			rbatt_sf_cols = <6>;
			rbatt_sf_percent = <100 95 90 85 80 75 70 65 60 55 50 45 40 35 30 25 20 15 10 9 8 7 6 5 4 3 2 1>;
			rbatt_sf_sf = <
			               1971 888 459 150 121 112
			               1970 888 459 150 121 112
			               1839 913 472 152 123 113
			               1713 920 490 156 125 115
			               1676 943 504 161 128 116
			               1543 895 532 170 132 118
			               1517 837 489 181 137 121
			               1515 831 470 199 148 127
			               1516 824 448 200 160 137
			               1531 823 437 155 129 116
			               1611 847 434 150 123 114
			               1714 921 422 151 124 115
			               1830 1023 448 155 128 117
			               1954 1148 499 158 134 120
			               2083 1284 576 159 132 122
			               2230 1422 664 157 125 114
			               2410 1589 766 154 122 113
			               2657 1792 883 159 123 113
			               3658 1996 983 161 128 117
			               4481 2141 924 161 129 119
			               4966 2392 991 159 127 116
			               5434 2660 1095 166 127 116
			               5970 2933 1229 168 130 118
			               6541 3252 1382 172 129 118
			               7189 3594 1509 175 129 117
			               7980 3994 1669 183 132 119
			               8915 4511 1946 202 136 120
			               10198 5252 2365 279 143 122
			              >;
			pc_temp_ocv_rows = <29>;
			pc_temp_ocv_cols = <6>;
			pc_temp_ocv_percent = <100 95 90 85 80 75 70 65 60 55 50 45 40 35 30 25 20 15 10 9 8 7 6 5 4 3 2 1>;
			pc_temp_ocv_ocv = <
			                   4326 4325 4322 4317 4311 4305
			                   4224 4239 4246 4254 4249 4245
			                   4156 4178 4186 4196 4193 4189
			                   4090 4121 4132 4142 4138 4134
			                   4041 4073 4082 4090 4086 4083
			                   3967 4011 4034 4042 4038 4035
			                   3917 3951 3976 3997 3994 3991
			                   3878 3907 3929 3957 3955 3952
			                   3843 3868 3885 3914 3915 3914
			                   3815 3833 3849 3865 3865 3863
			                   3801 3808 3821 3835 3835 3834
			                   3788 3796 3797 3813 3812 3812
			                   3774 3786 3785 3794 3794 3793
			                   3760 3776 3777 3779 3780 3778
			                   3746 3761 3768 3767 3765 3762
			                   3732 3740 3753 3754 3747 3737
			                   3716 3720 3730 3734 3726 3716
			                   3699 3702 3700 3705 3699 3688
			                   3671 3684 3677 3680 3674 3664
			                   3662 3677 3673 3679 3672 3662
			                   3653 3671 3669 3677 3671 3660
			                   3640 3664 3664 3673 3668 3657
			                   3626 3654 3658 3667 3663 3652
			                   3606 3637 3645 3650 3650 3638
			                   3578 3609 3618 3611 3614 3604
			                   3540 3566 3571 3554 3560 3553
			                   3482 3500 3502 3478 3490 3486
			                   3389 3399 3403 3363 3387 3387
			                   3200 3200 3200 3200 3200 3200
			                  >;
		};
};
