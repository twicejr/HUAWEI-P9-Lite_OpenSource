/* DO NOT EDIT - Automatically generated by python */
/ {
		desaysdi_3300_110k_4400:desaysdi_3300_110k_4400 {
			fcc = <3300>;
			default_rbatt_mohm = <100>;
			id_identify_min = <2281>;
			id_identify_max = <2786>;
			id_voltage_min = <2426>;
			id_voltage_max = <2631>;
			vbat_max = <4400>;
			temp_para = 
						"-32767","0","-1","0","4100","0",
						"0","10","-1","990","4400","3",
						"10","45","-1","-1","4400","3",
						"45","50","-1","1155","4400","3",
						"50","32767","-1","0","4400","0";
			vbat_para = 
						"-32767","3400","-1","820","0",
						"3400","32767","-1","-1","0";
			segment_para = 
						"-32767","4150","3300","4208","50",
						"4150","4450","2310","4400","0";
			batt_brand = "desaysdi";
			fcc_temp = <3359 3356 3359 3379 3368 3346>;
			fcc_sf_x = <0 100 200 300 400 500>;
			fcc_sf_y = <100 96 94 92 90 88>;
			fcc_sf_cols = <6>;
			pc_sf_rows = <1>;
			pc_sf_cols = <1>;
			pc_sf_row_entries = <0>;
			pc_sf_percent = <100>;
			pc_sf_sf = <100>;
			rbatt_sf_rows = <28>;
			rbatt_sf_cols = <6>;
			rbatt_sf_percent = <100 95 90 85 80 75 70 65 60 55 50 45 40 35 30 25 20 15 10 9 8 7 6 5 4 3 2 1>;
			rbatt_sf_sf = <
			               2374 1329 574 159 119 105
			               2371 1329 574 159 119 105
			               2190 1314 578 161 120 105
			               2042 1279 576 165 121 106
			               1965 1242 577 170 124 108
			               1887 1256 598 178 127 110
			               1723 1125 583 191 133 113
			               1735 1108 534 201 141 117
			               1714 1102 530 202 150 124
			               1697 1087 517 162 126 109
			               1730 1085 515 154 118 105
			               1777 1121 512 155 118 106
			               1826 1182 520 159 121 109
			               1899 1250 556 162 125 112
			               1982 1332 599 161 125 113
			               2088 1431 655 158 115 104
			               2216 1557 728 158 115 104
			               2392 1709 827 161 118 104
			               3414 1621 753 155 118 108
			               3694 1757 776 157 119 107
			               4001 1891 827 158 119 108
			               4382 2060 903 159 121 110
			               4811 2283 991 162 121 108
			               5281 2561 1078 159 118 106
			               5889 2858 1185 165 121 106
			               6702 3273 1360 170 123 111
			               7772 3942 1684 194 132 112
			               9740 5090 2302 355 154 118
			              >;
			pc_temp_ocv_rows = <29>;
			pc_temp_ocv_cols = <6>;
			pc_temp_ocv_percent = <100 95 90 85 80 75 70 65 60 55 50 45 40 35 30 25 20 15 10 9 8 7 6 5 4 3 2 1>;
			pc_temp_ocv_ocv = <
			                   4382 4378 4376 4368 4362 4355
			                   4280 4291 4298 4301 4297 4292
			                   4210 4227 4238 4242 4238 4233
			                   4147 4168 4179 4184 4181 4176
			                   4098 4110 4124 4128 4125 4122
			                   4041 4066 4076 4076 4073 4070
			                   3952 3981 4012 4026 4024 4022
			                   3917 3935 3951 3978 3979 3978
			                   3878 3898 3913 3934 3937 3937
			                   3839 3859 3874 3882 3885 3883
			                   3817 3825 3842 3849 3851 3850
			                   3801 3805 3814 3824 3826 3825
			                   3786 3791 3793 3805 3806 3805
			                   3773 3779 3782 3788 3789 3788
			                   3759 3767 3772 3772 3773 3770
			                   3744 3751 3760 3757 3751 3740
			                   3728 3734 3742 3738 3730 3718
			                   3708 3716 3718 3713 3706 3695
			                   3682 3697 3694 3690 3682 3672
			                   3674 3692 3690 3688 3681 3671
			                   3663 3685 3686 3686 3680 3669
			                   3651 3676 3683 3683 3677 3666
			                   3638 3664 3676 3676 3672 3660
			                   3618 3647 3662 3655 3655 3640
			                   3589 3617 3630 3614 3617 3602
			                   3549 3570 3578 3558 3565 3551
			                   3487 3501 3506 3483 3497 3484
			                   3391 3398 3399 3377 3396 3385
			                   3200 3200 3200 3200 3200 3200
			                  >;
		};
};
