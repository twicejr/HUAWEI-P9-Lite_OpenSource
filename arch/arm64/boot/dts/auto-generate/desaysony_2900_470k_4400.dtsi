/* DO NOT EDIT - Automatically generated by python */
/ {
		desaysony_2900_470k_4400:desaysony_2900_470k_4400 {
			fcc = <2900>;
			default_rbatt_mohm = <100>;
			id_identify_min = <3312>;
			id_identify_max = <3767>;
			id_voltage_min = <3457>;
			id_voltage_max = <3696>;
			vbat_max = <4400>;
			temp_para = 
						"-32767","0","-1","0","4100","0",
						"0","10","-1","870","4400","3",
						"10","45","-1","-1","4400","3",
						"45","50","-1","1015","4400","3",
						"50","32767","-1","0","4400","0";
			vbat_para = 
						"-32767","3400","-1","820","0",
						"3400","32767","-1","-1","0";
			segment_para = 
						"-32767","4150","2900","4208","50",
						"4150","4450","2030","4400","0";
			batt_brand = "desaysony";
			fcc_temp = <3029 3027 3029 3045 3030 3014>;
			fcc_sf_x = <0 100 200 300 400 500>;
			fcc_sf_y = <100 96 94 92 90 88>;
			fcc_sf_cols = <6>;
			pc_sf_rows = <1>;
			pc_sf_cols = <1>;
			pc_sf_row_entries = <0>;
			pc_sf_percent = <100>;
			pc_sf_sf = <100>;
			rbatt_sf_rows = <28>;
			rbatt_sf_cols = <6>;
			rbatt_sf_percent = <100 95 90 85 80 75 70 65 60 55 50 45 40 35 30 25 20 15 10 9 8 7 6 5 4 3 2 1>;
			rbatt_sf_sf = <
			               2043 944 393 133 107 97
			               2042 944 393 133 107 97
			               1895 952 398 134 109 98
			               1757 947 400 138 112 99
			               1661 945 416 144 115 102
			               1617 930 430 151 119 104
			               1430 872 455 163 125 108
			               1412 815 402 180 135 112
			               1416 822 374 183 147 121
			               1405 812 361 137 117 103
			               1423 817 360 131 108 99
			               1472 856 365 133 110 99
			               1529 921 370 137 112 102
			               1606 996 386 143 117 107
			               1700 1091 419 142 119 108
			               1818 1210 463 138 108 100
			               1965 1370 515 134 106 98
			               2163 1593 595 137 107 98
			               2437 1409 560 138 110 101
			               2696 1336 515 140 110 103
			               3044 1494 538 140 111 103
			               3435 1687 573 140 112 104
			               3896 1902 643 142 113 103
			               4392 2178 722 141 110 101
			               5108 2531 779 144 110 100
			               6069 3034 905 149 112 103
			               7448 3877 1151 165 117 104
			               10032 5481 1732 399 146 113
			              >;
			pc_temp_ocv_rows = <29>;
			pc_temp_ocv_cols = <6>;
			pc_temp_ocv_percent = <100 95 90 85 80 75 70 65 60 55 50 45 40 35 30 25 20 15 10 9 8 7 6 5 4 3 2 1>;
			pc_temp_ocv_ocv = <
			                   4386 4383 4382 4374 4367 4361
			                   4289 4302 4309 4312 4306 4301
			                   4221 4240 4250 4253 4248 4243
			                   4159 4183 4192 4195 4190 4185
			                   4103 4129 4137 4139 4134 4129
			                   4056 4072 4087 4085 4080 4077
			                   3967 3998 4030 4036 4032 4028
			                   3926 3938 3962 3986 3984 3983
			                   3892 3902 3918 3941 3942 3941
			                   3855 3864 3879 3887 3888 3887
			                   3828 3831 3846 3853 3853 3853
			                   3809 3809 3821 3828 3828 3827
			                   3793 3796 3799 3807 3808 3806
			                   3779 3786 3785 3791 3791 3789
			                   3766 3776 3776 3776 3775 3772
			                   3752 3763 3767 3760 3754 3742
			                   3738 3743 3749 3740 3733 3720
			                   3724 3717 3724 3714 3708 3695
			                   3704 3700 3696 3691 3684 3672
			                   3697 3695 3694 3690 3683 3671
			                   3689 3690 3691 3688 3681 3670
			                   3679 3686 3687 3685 3679 3668
			                   3667 3678 3682 3679 3674 3662
			                   3646 3663 3669 3658 3659 3643
			                   3617 3633 3638 3616 3623 3604
			                   3573 3585 3588 3559 3571 3553
			                   3509 3516 3517 3482 3503 3484
			                   3406 3410 3411 3374 3403 3384
			                   3200 3200 3200 3200 3200 3200
			                  >;
		};
};
