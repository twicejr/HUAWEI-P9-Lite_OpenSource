/* DO NOT EDIT - Automatically generated by python */
/ {
		desaysony_3400_110k_4400:desaysony_3400_110k_4400 {
			fcc = <3400>;
			default_rbatt_mohm = <100>;
			id_identify_min = <2281>;
			id_identify_max = <2786>;
			id_voltage_min = <2426>;
			id_voltage_max = <2631>;
			vbat_max = <4400>;
			temp_para = 
						"-32767","0","-1","0","4100","0",
						"0","10","-1","1020","4400","3",
						"10","45","-1","-1","4400","3",
						"45","50","-1","1190","4400","3",
						"50","32767","-1","0","4400","0";
			vbat_para = 
						"-32767","3400","-1","820","0",
						"3400","32767","-1","-1","0";
			segment_para = 
						"-32767","4150","3400","4208","50",
						"4150","4450","2380","4400","0";
			batt_brand = "desaysony";
			fcc_temp = <3462 3467 3490 3545 3522 3493>;
			fcc_sf_x = <0 100 200 300 400 500>;
			fcc_sf_y = <100 96 94 92 90 88>;
			fcc_sf_cols = <6>;
			pc_sf_rows = <1>;
			pc_sf_cols = <1>;
			pc_sf_row_entries = <0>;
			pc_sf_percent = <100>;
			pc_sf_sf = <100>;
			rbatt_sf_rows = <28>;
			rbatt_sf_cols = <6>;
			rbatt_sf_percent = <100 95 90 85 80 75 70 65 60 55 50 45 40 35 30 25 20 15 10 9 8 7 6 5 4 3 2 1>;
			rbatt_sf_sf = <
			               1291 629 342 137 107 95
			               1291 629 343 137 107 95
			               1307 655 358 140 108 96
			               1309 666 369 146 110 97
			               1321 660 383 151 114 99
			               1343 688 395 161 118 101
			               1275 638 401 173 125 104
			               1295 617 368 182 133 110
			               1315 633 352 171 134 113
			               1330 640 345 148 116 101
			               1346 653 351 140 108 97
			               1386 681 358 142 110 97
			               1457 717 369 147 113 99
			               1543 760 387 151 118 102
			               1683 814 411 153 117 102
			               1849 892 447 149 111 98
			               2073 1000 488 147 111 99
			               2388 1212 553 166 111 98
			               3001 1518 548 148 110 98
			               3103 1700 577 147 112 98
			               3228 1930 623 151 113 99
			               3512 2210 686 155 116 100
			               3876 2569 764 156 114 99
			               4385 3126 886 159 112 99
			               5656 3901 1051 172 117 101
			               7859 5234 1360 232 131 105
			               16246 7801 2056 310 132 160
			               38614 16968 3024 311 263 179
			              >;
			pc_temp_ocv_rows = <29>;
			pc_temp_ocv_cols = <6>;
			pc_temp_ocv_percent = <100 95 90 85 80 75 70 65 60 55 50 45 40 35 30 25 20 15 10 9 8 7 6 5 4 3 2 1>;
			pc_temp_ocv_ocv = <
			                   4386 4384 4381 4374 4367 4360
			                   4297 4307 4311 4311 4306 4300
			                   4222 4245 4251 4253 4248 4243
			                   4156 4186 4192 4195 4190 4187
			                   4097 4123 4136 4138 4135 4131
			                   4049 4076 4081 4085 4082 4079
			                   3976 4010 4029 4035 4033 4031
			                   3926 3952 3969 3986 3987 3986
			                   3883 3909 3920 3936 3939 3940
			                   3846 3868 3879 3890 3892 3891
			                   3811 3834 3846 3855 3857 3857
			                   3782 3808 3818 3829 3831 3831
			                   3760 3788 3796 3808 3810 3810
			                   3739 3772 3779 3789 3793 3791
			                   3723 3755 3765 3772 3772 3767
			                   3704 3738 3751 3752 3747 3737
			                   3685 3712 3728 3729 3724 3712
			                   3664 3677 3691 3704 3694 3684
			                   3641 3643 3656 3673 3669 3659
			                   3634 3635 3650 3669 3666 3656
			                   3624 3627 3644 3664 3662 3652
			                   3613 3618 3637 3657 3655 3646
			                   3598 3604 3626 3645 3643 3633
			                   3580 3585 3608 3620 3615 3604
			                   3549 3554 3575 3578 3572 3561
			                   3499 3506 3522 3525 3516 3507
			                   3430 3437 3460 3460 3445 3441
			                   3329 3348 3356 3364 3354 3350
			                   3200 3200 3200 3200 3200 3200
			                  >;
		};
};
