/*
 *  Copyright (C) 2014 Hisilicon Ltd.
 *  Author: Bintian Wang <bintian.wang@huawei.com>
 *
 *  This program is free software; you can redistribute it and/or modify
 *  it under the terms of the GNU General Public License version 2 as
 *  publishhed by the Free Software Foundation.
 */

/dts-v1/;
/include/ "fastboot.dtsi"
/include/ "hi3650_hi3650_fpga_080_3080_config.dtsi"

/ {
	hisi,boardid = <3 0 8 2>;
	hisi,boardname = "hi3650_hi3650_fpga_080_3082";
};
