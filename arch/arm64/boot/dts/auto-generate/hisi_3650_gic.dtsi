/{
	gic: interrupt-controller@e82b0000 {
		compatible = "arm,cortex-a9-gic";
		#interrupt-cells = <3>;
		#address-cells = <2>;
		#size-cells = <2>;
		ranges;
		interrupt-controller;
		redistributor-stride = <0x0 0x30000>;
		reg = <0x0 0xe82b1000 0x0 0x1000>,	/* GICD */
		      <0x0 0xe82b2000 0x0 0x1000>;	/* GICC */
		interrupts = <1 9 0xff04>;
	};
};