/* Copyright (c) 2012, Code Aurora Forum. All rights reserved.
 *
 * This program is free software; you can redistribute it and/or modify
 * it under the terms of the GNU General Public License version 2 and
 * only version 2 as published by the Free Software Foundation.
 *
 * This program is distributed in the hope that it will be useful,
 * but WITHOUT ANY WARRANTY; without even the implied warranty of
 * MERCHANTABILITY or FITNESS FOR A PARTICULAR PURPOSE.  See the
 * GNU General Public License for more details.
 */

/ {
	hisi,ion {
		compatible = "hisi,k3v5-ion";
		iommu_info{
			start-addr = <0x40000>;
			size = <0xbffc0000>;
		};

		linear{
			start-addr = <0x40000>;
			size = <0xbffc0000>;
			page-size = <0x1000>;
			page-align = <0x40000>;
		};

	};
};
