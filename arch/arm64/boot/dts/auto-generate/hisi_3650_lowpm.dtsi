

/{
	lowpm_func {
		compatible = "hisilicon,lowpm_func";
		reg = <0x0 0xfff32000 0x0 0x1000>;
		plat-name = "hi3650";
		irq-table = "IPI_RESCHEDULE",
					"IPI_CALL_FUNC",
					"IPI_CALL_FUNC_SINGLE",
					"IPI_CPU_STOP",
					"IPI_TIMER",
					"NULL",
					"NULL",
					"NULL",
					"NULL",
					"NULL",
					"NULL",
					"NULL",
					"NULL",
					"NULL",
					"NULL",
					"NULL",
					"NULL",
					"NULL",
					"NULL",
					"NULL",
					"NULL",
					"NULL",
					"NULL",
					"NULL",
					"NULL",
					"Virtual maintenance interrupt",
					"Hypervisor timer",
					"Virtual timer",
					"Legacy FIQ signal",
					"Secure physical timer",
					"Non-secure physical timer",
					"Legacy IRQ signal",
					"Maia_interr",
					"Maia_exterr",
					"Maia_pmu0",
					"Maia_pmu1",
					"Maia_pmu2",
					"Maia_pmu3",
					"Maia_cti0",
					"Maia_cti1",
					"Maia_cti2",
					"Maia_cti3",
					"Maia_COMMRX0",
					"Maia_COMMRX1",
					"Maia_COMMRX2",
					"Maia_COMMRX3",
					"Maia_COMMTX0",
					"Maia_COMMTX1",
					"Maia_COMMTX2",
					"Maia_COMMTX3",
					"Maia_COMMIRQ0",
					"Maia_COMMIRQ1",
					"Maia_COMMIRQ2",
					"Maia_COMMIRQ3",
					"A53_interr",
					"A53_exterr",
					"A53_pmu0",
					"A53_pmu1",
					"A53_pmu2",
					"A53_pmu3",
					"A53_cti0",
					"A53_cti1",
					"A53_cti2",
					"A53_cti3",
					"A53_COMMRX0",
					"A53_COMMRX1",
					"A53_COMMRX2",
					"A53_COMMRX3",
					"A53_COMMTX0",
					"A53_COMMTX1",
					"A53_COMMTX2",
					"A53_COMMTX3",
					"A53_COMMIRQ0",
					"A53_COMMIRQ1",
					"A53_COMMIRQ2",
					"A53_COMMIRQ3",
					"WatchDog0",
					"WatchDog1",
					"RTC0",
					"RTC1",
					"TIME00",
					"TIME01",
					"TIME10",
					"TIME11",
					"TIME20",
					"TIME21",
					"TIME30",
					"TIME31",
					"TIME40",
					"TIME41",
					"TIME50",
					"TIME51",
					"TIME60",
					"TIME61",
					"TIME70",
					"TIME71",
					"TIME80",
					"TIME81",
					"TIME90",
					"TIME91",
					"TIME100",
					"TIME101",
					"TIME110",
					"TIME111",
					"TIME120",
					"TIME121",
					"UART0",
					"UART1",
					"UART2",
					"UART4",
					"UART5",
					"UART6",
					"SPI1",
					"I2C3",
					"I2C4",
					"I2C5(PMU_I2C)",
					"GPIO0[]",
					"GPIO1[]",
					"GPIO2[]",
					"GPIO3[]",
					"GPIO4[]",
					"GPIO5[]",
					"GPIO6[]",
					"GPIO7[]",
					"GPIO8[]",
					"GPIO9[]",
					"GPIO10[]",
					"GPIO11[]",
					"GPIO12[]",
					"GPIO13[]",
					"GPIO14[]",
					"GPIO15[]",
					"GPIO16[]",
					"GPIO17[]",
					"GPIO18[]",
					"GPIO19[]",
					"GPIO20[]",
					"GPIO21[]",
					"GPIO22[]",
					"GPIO23[]",
					"GPIO24[]",
					"GPIO25[]",
					"GPIO26[]",
					"GPIO27[]",
					"IOMCU_WD",
					"IOMCU_SPI",
					"IOMCU_UART3",
					"IOMCU_UART8",
					"IOMCU_SPI2",
					"IOMCU_I2C3",
					"IOMCU_I2C0",
					"IOMCU_I2C1",
					"IOMCU_I2C2",
					"IOMCU_GPIO0_INT1",
					"IOMCU_GPIO1_INT1",
					"IOMCU_GPIO2_INT1",
					"IOMCU_GPIO3_INT1",
					"IOMCU_DMAC_INT0",
					"IOMCU_DMAC_ns_INT0",
					"PERF_STAT",
					"IOMCU_COMB",
					"IOMCU_BLPWM",
					"NOC-comb",
					"intr_dmss",
					"intr_ddrc0_err",
					"intr_ddrc1_err",
					"PMCTRL",
					"SECENG_P",
					"SECENG_S",
					"EMMC0",
					"EMMC1",
					"SD3",
					"SDIO0",
					"SDIO1",
					"DMAC_int0",
					"DMAC_ns_int0",
					"CLK_MONITOR",
					"TSENSOR_Maia",
					"TSENSOR_A53",
					"TSENSOR_G3D",
					"TSENSOR_Modem",
					"ASP_ARM_SECURE",
					"ASP_ARM",
					"VDM_INT2",
					"VDM_INT0",
					"VDM_INT1",
					"MODEM_IPC0[0]",
					"MODEM_IPC1[0]",
					"MDM_bus_err",
					"MDM_EDMAC[3]",
					"MDM_EDMAC_NS[3]",
					"USB3[0]",
					"USB3[1]",
					"USB3_OTG",
					"USB3_BC",
					"PMC-DDRC-DFS",
					"Reserved",
					"PMC-DVFS-Maia",
					"PMC-DVFS-A53",
					"PMC-DVFS-G3D",
					"PMC-AVS-Maia",
					"PMC-AVS-A53",
					"PMC-AVS-G3D",
					"PMC-AVS-IDLE-Maia",
					"PMC-AVS-IDLE-A53",
					"PMC-AVS-IDLE-G3D",
					"M3_LP_wd",
					"CCI400_err",
					"CCI400_overflow",
					"CCI400_overflow[4]",
					"IPC_S_int0",
					"IPC_S_int1",
					"IPC_S_int4",
					"IPC_S_mbx0",
					"IPC_S_mbx1",
					"IPC_S_mbx2",
					"IPC_S_mbx3",
					"IPC_S_mbx4",
					"IPC_S_mbx5",
					"IPC_S_mbx6",
					"IPC_S_mbx7",
					"IPC_S_mbx8",
					"IPC_S_mbx9",
					"IPC_S_mbx18",
					"IPC_NS_int0",
					"IPC_NS_int1",
					"IPC_NS_int4",
					"IPC_NS_int5",
					"IPC_NS_int6",
					"IPC_NS_mbx0",
					"IPC_NS_mbx1",
					"IPC_NS_mbx2",
					"IPC_NS_mbx3",
					"IPC_NS_mbx4",
					"IPC_NS_mbx5",
					"IPC_NS_mbx6",
					"IPC_NS_mbx7",
					"IPC_NS_mbx8",
					"IPC_NS_mbx9",
					"IPC_NS_mbx18",
					"aximon_cpufast_intr",
					"MDM_WDOG_intr",
					"ASP-IPC-ARM",
					"ASP-IPC-MCPU",
					"ASP-IPC-BBE16",
					"ASP_WD",
					"ASP_AXI_DLOCK",
					"ASP_DMA_SECURE",
					"ASP_DMA_SECURE_N",
					"SCI0",
					"SCI1",
					"SOCP0",
					"SOCP1",
					"MDM_IPF_intr0",
					"MDM_IPF_intr1",
					"ddrc_fatal_int[3:0]",
					"Reserved",
					"MDM_UICC_intr",
					"GIC_IRQ_OUT[0]",
					"GIC_IRQ_OUT[1]",
					"GIC_IRQ_OUT[2]",
					"GIC_IRQ_OUT[3]",
					"GIC_IRQ_OUT[4]",
					"GIC_IRQ_OUT[5]",
					"GIC_IRQ_OUT[6]",
					"GIC_IRQ_OUT[7]",
					"GIC_FIQ_OUT[0]",
					"GIC_FIQ_OUT[1]",
					"GIC_FIQ_OUT[2]",
					"GIC_FIQ_OUT[3]",
					"GIC_FIQ_OUT[4]",
					"GIC_FIQ_OUT[5]",
					"GIC_FIQ_OUT[6]",
					"GIC_FIQ_OUT[7]",
					"NANDC",
					"CoreSight_ETR_Full",
					"CoreSight_ETF_Full",
					"DSS-pdp",
					"DSS-sdp",
					"DSS-offline",
					"DSS_mcu_pdp",
					"DSS_mcu_sdp",
					"DSS_mcu_offline",
					"DSS_dsi0",
					"DSS_dsi1",
					"IVP32_SMMU_irpt_s",
					"IVP32_SMMU_irpt_ns",
					"IVP32_WATCH_DOG",
					"VENC",
					"VDEC",
					"G3D_JOB",
					"G3D_MMU",
					"G3D_GPU",
					"isp_irq[0]",
					"isp_irq[1]",
					"isp_irq[2]",
					"isp_irq[3]",
					"isp_irq[4]",
					"isp_irq[5]",
					"isp_irq[6]",
					"isp_irq[7]",
					"isp_a7_to_gic_mbx_int[0]",
					"isp_a7_to_gic_mbx_int[1]",
					"isp_a7_to_gic_ipc_int",
					"isp_a7_watchdog_int",
					"isp_axi_dlcok",
					"isp_axi_irq_out",
					"ivp32_dwaxi_dlock_irq",
					"mmbuf_asc0",
					"mmbuf_asc1",
					"reserved",
					"reserved",
					"reserved",
					"reserved",
					"reserved",
					"reserved",
					"reserved",
					"reserved",
					"reserved",
					"reserved";

		status = "ok";
	};
};
