/{
    gpu: mali@E8970000 {
        compatible = "arm,malit6xx", "arm,mali-midgard";
        #cooling-cells = <2>; /* min followed by max */
        gpu_outstanding = <0x0>;
        reg = <0x0 0xE8970000 0x0 0x4000>;
        interrupts = <0 258 4 0 259 4 0 260 4>;
	interrupt-names = "JOB", "MMU", "GPU";
	clocks = <&clk_g3d>;
	gpu-supply = <&g3d>;
	operating-points = <
		/* <frequency> <voltage>*/
		120000  696000
		240000  698000
		360000  700000
		480000  744000
		680000  820000
		800000  943000
		900000 1073000
	>;
    };
};
