/*
 * Hisilicon Ltd. hi3xxxASIC SoC
 *
 * Copyright (C) 2013 Hisilicon Technologies CO., Ltd.
 *
 * This program is free software; you can redistribute it and/or modify
 * it under the terms of the GNU General Public License version 2 as
 * publishhed by the Free Software Foundation.
 */
/{
	trusted_core {
		compatible = "trusted_core";
		interrupts = <0 278 4>;
		sec-s-buring-supply = <&sec_s>;
		sec-s-regulator-enable;
		tui-enable;
	};
};
