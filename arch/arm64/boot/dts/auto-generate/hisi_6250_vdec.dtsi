/* Copyright (c) 2012, Code Aurora Forum. All rights reserved.
 *
 * This program is free software; you can redistribute it and/or modify
 * it under the terms of the GNU General Public License version 2 and
 * only version 2 as published by the Free Software Foundation.
 *
 * This program is distributed in the hope that it will be useful,
 * but WITHOUT ANY WARRANTY; without even the implied warranty of
 * MERCHANTABILITY or FITNESS FOR A PARTICULAR PURPOSE.  See the
 * GNU General Public License for more details.
 */
/ {
  vdec{
        compatible = "hisi,kirin950-vdec";
        reg = <0x0 0xe8800000 0x0 0x100000>;
        interrupts = <0 257 4>; 
        clocks = <&clk_gate_vdec>;
        clock-names = "clk_vdec";
        dec_outstanding_qos = <0x0>;
        dec_outstanding_bw = <0x0>;
        ldo_vdec-supply = <&vdec>;
        status = "disabled";
      };
};
