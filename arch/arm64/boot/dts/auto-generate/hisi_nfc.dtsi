/*
 *  Copyright (C) 2013 Huawei co Ltd.
 *
 *  This program is free software; you can redistribute it and/or modify
 *  it under the terms of the GNU General Public License version 2 as
 *  publishhed by the Free Software Foundation.
 */

/ {
    hisi_nfc {
        compatible = "hisilicon,hisi_nfc";
        hisi_nfc_chip_type = "hisi_nfc";

        nfc_hisi_conf_name = "libnfc_hisi_austin_udp.conf";                                                              
        nfc_default_hisi_conf_name = "libnfc_default_hisi_austin_udp.conf";
    };
};
