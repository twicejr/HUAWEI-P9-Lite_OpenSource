 /*
  *  Copyright (C) 2013 Huawei co Ltd.
  *
  *  This program is free software; you can redistribute it and/or modify
  *  it under the terms of the GNU General Public License version 2 as
  *  publishhed by the Free Software Foundation.
  */

 / {
		antenna_fpga{
			compatible = "antenna_fpga";
			antenna_fpga,gpio-reset= <&gpio0 2 0>;
			antenna_fpga,gpio-cdone = <&gpio4 1 0>;
			antenna_fpga,gpio-cs = <&gpio8 3 0>;
			antenna_fpga,pre-image-filename = "GRACE-CLG-V0.bin";
			antenna_fpga,gpio-exception = <&gpio0 0 0>;
			antenna_fpga,vccio0 = "LSW50";
			status = "disabled";
		};
 };
