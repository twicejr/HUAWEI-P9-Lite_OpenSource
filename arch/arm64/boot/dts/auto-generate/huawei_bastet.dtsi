/*
 *  Copyright (C) 2014 Huawei co., Ltd.
 *
 *  This program is free software; you can redistribute it and/or modify
 *  it under the terms of the GNU General Public License version 2 as
 *  publishhed by the Free Software Foundation.
 */

/ {
	bastet: bastet {
		compatible = "huawei,bastet";
		status = "ok";
	};
};
