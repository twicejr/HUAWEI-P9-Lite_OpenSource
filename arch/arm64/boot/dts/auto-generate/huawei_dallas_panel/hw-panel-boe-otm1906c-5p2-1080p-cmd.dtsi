/* Copyright (c) 2013, The Linux Foundation. All rights reserved.
 *
 * This program is free software; you can redistribute it and/or modify
 * it under the terms of the GNU General Public License version 2 and
 * only version 2 as published by the Free Software Foundation.
 *
 * This program is distributed in the hope that it will be useful,
 * but WITHOUT ANY WARRANTY; without even the implied warranty of
 * MERCHANTABILITY or FITNESS FOR A PARTICULAR PURPOSE.  See the
 * GNU General Public License for more details.
 */

/*---------------------------------------------------------------------------
 * This file is autogenerated file using gcdb parser. Please do not edit it.
 * Update input XML file to add a new entry or update variable in this file
 * VERSION = "1.0"
 *---------------------------------------------------------------------------*/
/{
	dss_boe_otm1906c_5p2_1080p_cmd:boe_otm1906c_5p2_1080p_cmd {
		compatible = "hisilicon,boe_otm1906c_5p2_1080p_cmd";
		hisilicon,dss-panel-name = "BOE_OTM1906C 5.2' COMMAND TFT 1080 x 1920";
		hisilicon,dss-panel-xres = <1080>;
		hisilicon,dss-panel-yres = <1920>;
		hisilicon,dss-panel-width = <65>;
		hisilicon,dss-panel-height = <115>;
		hisilicon,dss-panel-orientation = <1>;
		hisilicon,dss-panel-bpp = <2>;
		hisilicon,dss-panel-bgrfmt = <0>;
		hisilicon,dss-panel-bl-type = <8>;
		hisilicon,dss-panel-blmin = <2>;
		hisilicon,dss-panel-blmax = <255>;
		hisilicon,dss-panel-bl-def = <102>;
		hisilicon,dss-panel-type = <16>;
		hisilicon,dss-panel-ifbc-type = <0>;
		hisilicon,dss-panel-bl-pwm-preci-type = <0>;
		hisilicon,dss-panel-frc-enable = <0>;
		hisilicon,dss-panel-esd-enable = <1>;
		hisilicon,dss-panel-lcd-ajust-support = <1>;
		hisilicon,dss-panel-pxl-clk = <144>;
		hisilicon,dss-panel-pxl-clk-div = <1>;
		hisilicon,dss-panel-dirt-updt-support = <0>;
		hisilicon,dss-panel-dsi-upt-support = <0>;
		hisilicon,dss-panel-vsyn-ctr-type = <7>;
		hisilicon,dss-panel-step-support = <1>;
		hisilicon,dss-panel-esd-skip-mipi-check = <1>;
		hisilicon,dss-ldi-h-back-porch = <20>;
		hisilicon,dss-ldi-h-front-porch = <22>;
		hisilicon,dss-ldi-h-pulse-width = <10>;
		hisilicon,dss-ldi-v-back-porch = <12>;
		hisilicon,dss-ldi-v-front-porch = <14>;
		hisilicon,dss-ldi-v-pulse-width = <4>;
		hisilicon,dss-ldi-hsync-plr = <0>;
		hisilicon,dss-ldi-vsync-plr = <0>;
		hisilicon,dss-ldi-pixel-clk-plr = <0>;
		hisilicon,dss-ldi-data-en-plr = <0>;
		hisilicon,dss-ldi-dpi-a-overlap-size = <0>;
		hisilicon,dss-ldi-dpi-b-overlap-size = <0>;
		hisilicon,dss-sbl-stren-limit = <128>;
		hisilicon,dss-sbl-cal-a = <60>;
		hisilicon,dss-sbl-cal-b = <95>;
		hisilicon,dss-sbl-cal-c = <5>;
		hisilicon,dss-sbl-cal-d = <1>;
		hisilicon,dss-sbl-tf-ctl = <5>;
		hisilicon,dss-sbl-blmin = <480>;
		hisilicon,dss-sbl-blmax = <4096>;
		hisilicon,dss-sbl-bl-scale = <0xff>;
		hisilicon,dss-sbl-am-light-min = <14>;
		hisilicon,dss-sbl-filter-a = <1738>;
		hisilicon,dss-sbl-filter-b = <6>;
		hisilicon,dss-sbl-logo-left = <0>;
		hisilicon,dss-sbl-logo-top = <0>;
		hisilicon,dss-sbl-variance-intensity-space = <145>;
		hisilicon,dss-sbl-slope-max = <54>;
		hisilicon,dss-sbl-slope-min = <160>;
		hisilicon,dss-mipi-vc = <0>;
		hisilicon,dss-mipi-lane-nums = <3>;
		hisilicon,dss-mipi-color-mode = <5>;
		hisilicon,dss-mipi-dsi-bit-clk = <490>;
		hisilicon,dss-mipi-burst-mode = <0>;
		hisilicon,dss-mipi-max-esc-clk = <9>;
		hisilicon,dss-mipi-dsi-bit-clk-val-a = <471>;
		hisilicon,dss-mipi-dsi-bit-clk-val-b = <480>;
		hisilicon,dss-mipi-dsi-bit-clk-val-c = <490>;
		hisilicon,dss-mipi-dsi-bit-clk-val-d = <500>;
		hisilicon,dss-mipi-dsi-bit-clk-val-e = <0>;
		hisilicon,dss-mipi-dsi-bit-clk-upt = <490>;
		hisilicon,dss-mipi-rg-vcm-adjust = <6>;
		hisilicon,dss-mipi-non-continue-enable = <1>;
		hisilicon,dss-mipi-clk-post-adjust = <20>;
		hisilicon,dss-dirt-left-align = <0xffff>;
		hisilicon,dss-dirt-right-align = <0xffff>;
		hisilicon,dss-dirt-top-align = <16>;
		hisilicon,dss-dirt-bott-align = <16>;
		hisilicon,dss-dirt-width-align = <0xffff>;
		hisilicon,dss-dirt-height-align = <0xffff>;
		hisilicon,dss-dirt-width-min = <1080>;
		hisilicon,dss-dirt-height-min = <16>;
		hisilicon,dss-dirt-top-start = <0xffff>;
		hisilicon,dss-dirt-bott-start = <0xffff>;
		iovcc-off-is-need-delay = <0>;
		iovcc-on-is-need-reset = <1>;
		lcd-ctrl-tp-power = <1>;
		lock-cmd-support = <1>;
		read-power-status = <1>;
		esd-set-backlight = <0>;
		hisilicon,dss-color-temp-support = <0>;
		hisilicon,dss-prefix-ce-support = <0>;
		hisilicon,dss-prefix-sharp-one-d-support = <0>;
		hisilicon,dss-prefix-sharp-two-d-support = <0>;
		hisilicon,dss-sbl-support = <0>;
		hisilicon,dss-gamma-support = <1>;
		hisilicon,dss-gmp-support = <0>;
		hisilicon,dss-xcc-support = <1>;
		hisilicon,dss-acm-support = <1>;
		hisilicon,dss-acm-ce-support = <1>;
		hisilicon,dss-acm-valid-num = <7>;
		hisilicon,dss-acm-r_hh0 = <0x7f>;
		hisilicon,dss-acm-r_lh0 = <0xe>;
		hisilicon,dss-acm-r_hh1 = <0xbe>;
		hisilicon,dss-acm-r_lh1 = <0x80>;
		hisilicon,dss-acm-r_hh2 = <0xff>;
		hisilicon,dss-acm-r_lh2 = <0xbf>;
		hisilicon,dss-acm-r_hh3 = <0x1c0>;
		hisilicon,dss-acm-r_lh3 = <0x100>;
		hisilicon,dss-acm-r_hh4 = <0x27f>;
		hisilicon,dss-acm-r_lh4 = <0x1c1>;
		hisilicon,dss-acm-r_hh5 = <0x323>;
		hisilicon,dss-acm-r_lh5 = <0x280>;
		hisilicon,dss-acm-r_hh6 = <0x381>;
		hisilicon,dss-acm-r_lh6 = <0x324>;

		hisilicon,dss-on-cmds = <
					0x29 0x00 0x0a 0x00 0x02 0x00 0x00
				0x29 0x00 0x0a 0x00 0x04 0xFF 0x19 0x06 0x01
				0x29 0x00 0x0a 0x00 0x02 0x00 0x80
				0x29 0x00 0x0a 0x00 0x03 0xFF 0x19 0x06
				0x29 0x00 0x0a 0x00 0x02 0x00 0xA0
				0x29 0x00 0x0a 0x00 0x04 0xC1 0x00 0xC0 0x10
				0x29 0x00 0x0a 0x00 0x02 0x00 0x91
				0x29 0x00 0x0a 0x00 0x03 0xC5 0x14 0x28
				0x29 0x00 0x0a 0x00 0x02 0x00 0x95
				0x29 0x00 0x0a 0x00 0x02 0xC5 0x11
				0x29 0x00 0x0a 0x00 0x02 0x00 0x80
				0x29 0x00 0x0a 0x00 0x03 0xC1 0x55 0x55
				0x29 0x00 0x0a 0x00 0x02 0x00 0x94
				0x29 0x00 0x0a 0x00 0x02 0xC5 0x67
				0x29 0x00 0x0a 0x00 0x02 0x00 0xA4
				0x29 0x00 0x0a 0x00 0x02 0xC5 0x67
				0x29 0x00 0x0a 0x00 0x02 0x00 0xC1
				0x29 0x00 0x0a 0x00 0x02 0xC5 0xb5
				0x29 0x00 0x0a 0x00 0x02 0x00 0x81
				0x29 0x00 0x0a 0x00 0x02 0xA5 0x05
				0x29 0x00 0x0a 0x00 0x02 0x00 0xB3
				0x29 0x00 0x0a 0x00 0x02 0xC0 0x88
				0x29 0x00 0x0a 0x00 0x02 0x00 0xB4
				0x29 0x00 0x0a 0x00 0x02 0xC0 0x00
				0x29 0x00 0x0a 0x00 0x02 0x00 0x00
				0x29 0x00 0x0a 0x00 0x03 0xD8 0x23 0x23
				0x29 0x00 0x0a 0x00 0x02 0x00 0x80
				0x29 0x00 0x0a 0x00 0x02 0xC4 0x81
				0x29 0x00 0x0a 0x00 0x02 0x00 0xA0
				0x29 0x00 0x0a 0x00 0x02 0xB3 0x33
				0x29 0x00 0x0a 0x00 0x02 0x00 0xA6
				0x29 0x00 0x0a 0x00 0x02 0xB3 0x20
				0x29 0x00 0x0a 0x00 0x02 0x00 0xE0
				0x29 0x00 0x0a 0x00 0x0B 0xB4 0x1C 0x19 0x3F 0x01 0x64 0x5C 0x01 0xA0 0x5F 0xA0
				0x29 0x00 0x0a 0x00 0x02 0x00 0xF0
				0x29 0x00 0x0a 0x00 0x02 0xB4 0x64
				0x29 0x00 0x0a 0x00 0x02 0x00 0x90
				0x29 0x00 0x0a 0x00 0x07 0xC0 0x00 0x00 0x00 0x02 0x00 0x04
				0x29 0x00 0x0a 0x00 0x02 0x00 0x80
				0x29 0x00 0x0a 0x00 0x0F 0xC0 0x00 0x71 0x00 0x0A 0x0A 0x00 0x71 0x0A 0x0A 0x00 0x71 0x00 0x0A 0x0A
				0x29 0x00 0x0a 0x00 0x02 0x00 0xA0
				0x29 0x00 0x0a 0x00 0x10 0xC0 0x00 0x00 0x02 0x00 0x04 0x14 0x04 0x33 0x00 0x33 0x00 0x33 0x00 0x33 0x00
				0x29 0x00 0x0a 0x00 0x02 0x00 0xD0
				0x29 0x00 0x0a 0x00 0x10 0xC0 0x00 0x00 0x02 0x00 0x04 0x14 0x04 0x33 0x00 0x33 0x00 0x33 0x00 0x33 0x00
				0x29 0x00 0x0a 0x00 0x02 0x00 0x80
				0x29 0x00 0x0a 0x00 0x0D 0xC2 0x83 0x01 0x00 0x00 0x82 0x01 0x00 0x00 0x00 0x00 0x00 0x00
				0x29 0x00 0x0a 0x00 0x02 0x00 0x90
				0x29 0x00 0x0a 0x00 0x0D 0xC2 0x00 0x00 0x00 0x00 0x00 0x00 0x00 0x00 0x00 0x00 0x00 0x00
				0x29 0x00 0x0a 0x00 0x02 0x00 0xA0
				0x29 0x00 0x0a 0x00 0x0E 0xC2 0x00 0x00 0x00 0x00 0x00 0x00 0x00 0x00 0x00 0x00 0x00 0x00 0x00
				0x29 0x00 0x0a 0x00 0x02 0x00 0xB0
				0x29 0x00 0x0a 0x00 0x10 0xC2 0x82 0x02 0x00 0x00 0x88 0x81 0x02 0x00 0x00 0x88 0x00 0x02 0x00 0x00 0x88
				0x29 0x00 0x0a 0x00 0x02 0x00 0xC0
				0x29 0x00 0x0a 0x00 0x10 0xC2 0x01 0x02 0x00 0x00 0x88 0x00 0x00 0x00 0x00 0x00 0x00 0x00 0x00 0x00 0x00
				0x29 0x00 0x0a 0x00 0x02 0x00 0xD0
				0x29 0x00 0x0a 0x00 0x10 0xC2 0x00 0x00 0x00 0x00 0x00 0x00 0x00 0x00 0x00 0x00 0x33 0x33 0x33 0x33 0x00
				0x29 0x00 0x0a 0x00 0x02 0x00 0x80
				0x29 0x00 0x0a 0x00 0x10 0xC3 0x00 0x00 0x00 0x00 0x00 0x00 0x00 0x00 0x00 0x00 0x00 0x00 0x00 0x00 0x00
				0x29 0x00 0x0a 0x00 0x02 0x00 0xA0
				0x29 0x00 0x0a 0x00 0x0D 0xC3 0x83 0x01 0x00 0x00 0x82 0x01 0x00 0x00 0x00 0x00 0x00 0x00
				0x29 0x00 0x0a 0x00 0x02 0x00 0xB0
				0x29 0x00 0x0a 0x00 0x0F 0xC3 0x00 0x00 0x00 0x00 0x82 0x02 0x00 0x00 0x88 0x81 0x02 0x00 0x00 0x88
				0x29 0x00 0x0a 0x00 0x02 0x00 0xC0
				0x29 0x00 0x0a 0x00 0x10 0xC3 0x00 0x02 0x00 0x00 0x88 0x01 0x02 0x00 0x00 0x88 0x00 0x00 0x00 0x00 0x00
				0x29 0x00 0x0a 0x00 0x02 0x00 0xD0
				0x29 0x00 0x0a 0x00 0x10 0xC3 0x00 0x00 0x00 0x00 0x00 0x00 0x00 0x00 0x00 0x00 0x00 0x00 0x00 0x00 0x00
				0x29 0x00 0x0a 0x00 0x02 0x00 0xE0
				0x29 0x00 0x0a 0x00 0x06 0xC3 0x33 0x33 0x33 0x33 0x00
				0x29 0x00 0x0a 0x00 0x02 0x00 0xB0
				0x29 0x00 0x0a 0x00 0x04 0xC5 0x00 0x00 0x01
				0x29 0x00 0x0a 0x00 0x02 0x00 0x80
				0x29 0x00 0x0a 0x00 0x0C 0xCB 0x00 0x00 0x00 0x00 0x30 0x00 0x03 0x00 0x00 0x00 0x70
				0x29 0x00 0x0a 0x00 0x02 0x00 0x90
				0x29 0x00 0x0a 0x00 0x10 0xCB 0x00 0x00 0x00 0x00 0x00 0x00 0x00 0x00 0x00 0x00 0x00 0x00 0x00 0x00 0x00
				0x29 0x00 0x0a 0x00 0x02 0x00 0xA0
				0x29 0x00 0x0a 0x00 0x10 0xCB 0x00 0x00 0x00 0xBF 0x00 0x00 0x00 0x00 0x00 0xFF 0x00 0x00 0x00 0x00 0x00
				0x29 0x00 0x0a 0x00 0x02 0x00 0xB0
				0x29 0x00 0x0a 0x00 0x0D 0xCB 0x00 0x00 0x00 0x00 0x00 0x00 0x00 0x00 0x00 0x00 0x77 0x77
				0x29 0x00 0x0a 0x00 0x02 0x00 0xC0
				0x29 0x00 0x0a 0x00 0x10 0xCB 0x01 0x01 0x01 0x01 0x01 0x01 0x01 0x01 0x01 0x01 0x01 0x01 0x01 0x01 0x01
				0x29 0x00 0x0a 0x00 0x02 0x00 0xD0
				0x29 0x00 0x0a 0x00 0x10 0xCB 0x01 0x01 0x01 0xF3 0x01 0x01 0x01 0x01 0x00 0xF3 0x00 0x00 0x01 0x00 0x01
				0x29 0x00 0x0a 0x00 0x02 0x00 0xE0
				0x29 0x00 0x0a 0x00 0x0D 0xCB 0x00 0x01 0x00 0x01 0x00 0x01 0x00 0x01 0x00 0x00 0x77 0x07
				0x29 0x00 0x0a 0x00 0x02 0x00 0xF0
				0x29 0x00 0x0a 0x00 0x0C 0xCB 0x00 0x00 0xFF 0xFF 0xFF 0xFF 0x03 0x22 0x02 0x00 0x70
				0x29 0x00 0x0a 0x00 0x02 0x00 0x80
				0x29 0x00 0x0a 0x00 0x0D 0xCC 0x08 0x09 0x18 0x19 0x0C 0x0D 0x0E 0x0F 0x07 0x07 0x07 0x07
				0x29 0x00 0x0a 0x00 0x02 0x00 0x90
				0x29 0x00 0x0a 0x00 0x0D 0xCC 0x09 0x08 0x19 0x18 0x0F 0x0E 0x0D 0x0C 0x07 0x07 0x07 0x07
				0x29 0x00 0x0a 0x00 0x02 0x00 0xA0
				0x29 0x00 0x0a 0x00 0x10 0xCC 0x14 0x15 0x16 0x17 0x1C 0x1D 0x1E 0x1F 0x01 0x04 0x20 0x07 0x07 0x07 0x00
				0x29 0x00 0x0a 0x00 0x02 0x00 0xB0
				0x29 0x00 0x0a 0x00 0x09 0xCC 0x01 0x02 0x03 0x04 0x05 0x06 0x07 0x07
				0x29 0x00 0x0a 0x00 0x02 0x00 0xC0
				0x29 0x00 0x0a 0x00 0x10 0xCC 0x00 0x00 0x00 0x00 0x00 0x00 0x00 0x00 0x00 0x00 0x00 0x00 0x00 0x00 0x00
				0x29 0x00 0x0a 0x00 0x02 0x00 0xD0
				0x29 0x00 0x0a 0x00 0x10 0xCC 0x00 0x00 0x00 0x00 0x00 0x00 0x00 0x00 0x00 0x00 0x00 0x00 0x00 0x00 0x00
				0x29 0x00 0x0a 0x00 0x02 0x00 0xE0
				0x29 0x00 0x0a 0x00 0x10 0xCC 0x00 0x00 0x00 0x00 0x00 0x00 0x00 0x00 0x00 0x00 0x00 0x00 0x00 0x00 0x00
				0x29 0x00 0x0a 0x00 0x02 0x00 0x80
				0x29 0x00 0x0a 0x00 0x10 0xCD 0x1A 0x01 0x11 0x12 0x1A 0x05 0x18 0x07 0x1A 0x1A 0x23 0x23 0x23 0x1F 0x1E
				0x29 0x00 0x0a 0x00 0x02 0x00 0x90
				0x29 0x00 0x0a 0x00 0x04 0xCD 0x1D 0x23 0x23
				0x29 0x00 0x0a 0x00 0x02 0x00 0xA0
				0x29 0x00 0x0a 0x00 0x10 0xCD 0x1A 0x02 0x11 0x12 0x1A 0x06 0x18 0x08 0x1A 0x1A 0x23 0x23 0x23 0x1F 0x1E
				0x29 0x00 0x0a 0x00 0x02 0x00 0xB0
				0x29 0x00 0x0a 0x00 0x04 0xCD 0x1D 0x23 0x23
				0x29 0x00 0x0a 0x00 0x02 0x00 0x80
				0x29 0x00 0x0a 0x00 0x0B 0xA4 0xAF 0x00 0x20 0x04 0x00 0x17 0x15 0x03 0x60 0x00
				0x29 0x00 0x0a 0x00 0x02 0x00 0x90
				0x29 0x00 0x0a 0x00 0x04 0xA4 0x00 0x00 0x00
				0x29 0x00 0x0a 0x00 0x02 0x00 0x80
				0x29 0x00 0x0a 0x00 0x0D 0xA7 0xFF 0x0F 0x1E 0x00 0x1F 0x00 0x01 0x98 0x00 0x00 0x00 0x00
				0x29 0x00 0x0a 0x00 0x02 0x00 0x90
				0x29 0x00 0x0a 0x00 0x0B 0xA7 0x1C 0x1F 0x3B 0x00 0x00 0xBE 0x80 0xBE 0x05 0xF0
				0x29 0x00 0x0a 0x00 0x02 0x00 0xA0
				0x29 0x00 0x0a 0x00 0x02 0xA7 0x30
				0x29 0x00 0x0a 0x00 0x02 0x00 0xB0
				0x29 0x00 0x0a 0x00 0x06 0xA7 0x39 0x20 0x10 0x00 0x00
				0x29 0x00 0x0a 0x00 0x02 0x00 0xC0
				0x29 0x00 0x0a 0x00 0x0D 0xA7 0xFF 0x0F 0x1E 0x00 0x1F 0x00 0x01 0x18 0x00 0x00 0x00 0x00
				0x29 0x00 0x0a 0x00 0x02 0x00 0xD0
				0x29 0x00 0x0a 0x00 0x0B 0xA7 0xFF 0xFF 0x1C 0x00 0x01 0x7C 0x81 0x7C 0x0B 0xE0
				0x29 0x00 0x0a 0x00 0x02 0x00 0xE0
				0x29 0x00 0x0a 0x00 0x02 0xA7 0x30
				0x29 0x00 0x0a 0x00 0x02 0x00 0xF0
				0x29 0x00 0x0a 0x00 0x06 0xA7 0x1C 0x3E 0x3D 0x00 0x00
				0x29 0x00 0x0a 0x00 0x02 0x00 0x80
				0x29 0x00 0x0a 0x00 0x0D 0xA9 0x00 0x00 0x00 0x00 0x00 0x00 0x00 0x00 0x00 0x00 0x00 0x00
				0x29 0x00 0x0a 0x00 0x02 0x00 0x90
				0x29 0x00 0x0a 0x00 0x0B 0xA9 0x00 0x00 0x00 0x00 0x00 0x00 0x00 0x00 0x00 0x00
				0x29 0x00 0x0a 0x00 0x02 0x00 0xA0
				0x29 0x00 0x0a 0x00 0x02 0xA9 0x00
				0x29 0x00 0x0a 0x00 0x02 0x00 0xB0
				0x29 0x00 0x0a 0x00 0x06 0xA9 0x00 0x00 0x00 0x00 0x00
				0x29 0x00 0x0a 0x00 0x02 0x00 0xC0
				0x29 0x00 0x0a 0x00 0x0F 0xA9 0xFF 0x3A 0x49 0x00 0x1E 0x00 0x01 0x00 0x00 0x00 0x00 0x00 0x00 0x77
				0x29 0x00 0x0a 0x00 0x02 0x00 0xD0
				0x29 0x00 0x0a 0x00 0x0B 0xA9 0xFF 0xFF 0x1D 0x00 0x01 0x7C 0x81 0x7C 0x0B 0xE0
				0x29 0x00 0x0a 0x00 0x02 0x00 0xE0
				0x29 0x00 0x0a 0x00 0x02 0xA9 0x30
				0x29 0x00 0x0a 0x00 0x02 0x00 0xF0
				0x29 0x00 0x0a 0x00 0x06 0xA9 0x00 0x3C 0x3C 0x00 0x00
				0x29 0x00 0x0a 0x00 0x02 0x00 0xB0
				0x29 0x00 0x0a 0x00 0x09 0xA4 0x05 0xF0 0x0B 0xE0 0x00 0x00 0x0B 0xE0
				0x29 0x00 0x0a 0x00 0x02 0x00 0x80
				0x29 0x00 0x0a 0x00 0x10 0xAB 0x05 0x14 0x00 0x00 0xFF 0x6A 0x00 0x00 0x00 0x00 0x00 0x00 0x00 0x00 0x00
				0x29 0x00 0x0a 0x00 0x02 0x00 0xA0
				0x29 0x00 0x0a 0x00 0x10 0xAB 0x00 0x00 0x00 0x00 0x00 0x00 0x00 0x07 0x00 0x00 0x00 0x00 0x01 0x00 0x00
				0x29 0x00 0x0a 0x00 0x02 0x00 0xB0
				0x29 0x00 0x0a 0x00 0x0D 0xAB 0x00 0x00 0x68 0x0A 0x00 0x00 0x44 0x04 0x00 0x00 0x00 0x00
				0x29 0x00 0x0a 0x00 0x02 0x00 0x93
				0x29 0x00 0x0a 0x00 0x02 0xB3 0x01
				0x29 0x00 0x0a 0x00 0x02 0x00 0x80
				0x29 0x00 0x0a 0x00 0x08 0xCE 0x00 0x00 0x00 0x00 0x00 0x00 0x00
				0x29 0x00 0x0a 0x00 0x02 0x00 0x87
				0x29 0x00 0x0a 0x00 0x08 0xCE 0x00 0x00 0x33 0x00 0x33 0x00 0x00
				0x29 0x00 0x0a 0x00 0x02 0x00 0xF0
				0x29 0x00 0x0a 0x00 0x05 0xCE 0x00 0x00 0x00 0x00
				0x29 0x00 0x0a 0x00 0x02 0x00 0x90
				0x29 0x00 0x0a 0x00 0x10 0xCE 0x00 0x00 0x00 0xF0 0x00 0x00 0x00 0x00 0xFC 0x00 0xFC 0x00 0x00 0x00 0x00
				0x29 0x00 0x0a 0x00 0x02 0x00 0xA0
				0x29 0x00 0x0a 0x00 0x08 0xCE 0x00 0x00 0x40 0x40 0x40 0x00 0x00
				0x29 0x00 0x0a 0x00 0x02 0x00 0xB0
				0x29 0x00 0x0a 0x00 0x10 0xCE 0x01 0x01 0x01 0x01 0x01 0x01 0x01 0x01 0xF1 0x01 0xF1 0x01 0x01 0x01 0x01
				0x29 0x00 0x0a 0x00 0x02 0x00 0xC0
				0x29 0x00 0x0a 0x00 0x08 0xCE 0x01 0x01 0x01 0x01 0x01 0x01 0x01
				0x29 0x00 0x0a 0x00 0x02 0x00 0xD0
				0x29 0x00 0x0a 0x00 0x10 0xCE 0x04 0x04 0x04 0x04 0x04 0x04 0x04 0x04 0xF7 0x04 0xF7 0x04 0x04 0x00 0x00
				0x29 0x00 0x0a 0x00 0x02 0x00 0xE0
				0x29 0x00 0x0a 0x00 0x08 0xCE 0x00 0x00 0x15 0x15 0x15 0x04 0x04
				0x29 0x00 0x0a 0x00 0x02 0x00 0xF4
				0x29 0x00 0x0a 0x00 0x02 0xCE 0x25
				0x29 0x00 0x0a 0x00 0x02 0x00 0xB0
				0x29 0x00 0x0a 0x00 0x02 0xCA 0x01
				0x29 0x00 0x0a 0x00 0x02 0x00 0xB1
				0x29 0x00 0x0a 0x00 0x02 0xCA 0x01
				0x29 0x00 0x0a 0x00 0x02 0x00 0xB3
				0x29 0x00 0x0a 0x00 0x02 0xCA 0x40
				0x29 0x00 0x0a 0x00 0x02 0x00 0x00
				0x29 0x00 0x0a 0x00 0x02 0x1C 0x00
				0x29 0x00 0x0a 0x00 0x02 0x00 0xE0
				0x29 0x00 0x0a 0x00 0x02 0xB4 0x9C
				0x29 0x00 0x0a 0x00 0x02 0x00 0x83
				0x29 0x00 0x0a 0x00 0x02 0xB3 0x22
				0x29 0x00 0x0a 0x00 0x02 0x00 0x00
				0x29 0x00 0x0a 0x00 0x04 0xFF 0xFF 0xFF 0xFF
				0x15 0x00 0x0a 0x00 0x02 0x53 0x24
				0x15 0x00 0x0a 0x00 0x02 0x55 0x01
				0x15 0x00 0x0a 0x00 0x02 0x5E 0x28
				0x15 0x00 0x0a 0x00 0x02 0x35 0x00
				0x15 0x00 0x0a 0x00 0x02 0x51 0x00
				0x29 0x00 0x0a 0x00 0x05 0x2A 0x00 0x00 0x04 0x37
				0x29 0x00 0x0a 0x00 0x05 0x2B 0x00 0x00 0x07 0x7F
                                0x29 0x00 0x0a 0x00 0x03 0x44 0x07 0x70
				0x05 0x00 0x78 0x01 0x02 0x11 0x00
				0x05 0x00 0x14 0x01 0x02 0x29 0x00
				0x29 0x00 0x0a 0x00 0x03 0x99 0x00 0x00>;
		hisilicon,dss-off-cmds = <
					0x29 0x00 0x0a 0x00 0x03 0x99 0x95 0x27
				0x05 0x00 0x14 0x01 0x02 0x28 0x00
				0x05 0x00 0x78 0x01 0x02 0x10 0x00>;
		hisilicon,dss-esd-reg = <
					0x0a>;
		hisilicon,dss-esd-value = <
					0x9c>;
		hisilicon,dss-mipi-check-reg = <
					0x0a 0x0b 0x0c 0x0d>;
		hisilicon,dss-mipi-check-value = <
					0x9c 0x00 0x07 0x00>;
		hisilicon,dss-cabc-off-mode = <
					0x29 0x00 0x0a 0x00 0x03 0x99 0x95 0x27
				0x15 0x00 0x0a 0x00 0x02 0x55 0x00
				0x29 0x00 0x0a 0x00 0x03 0x99 0x00 0x00>;
		hisilicon,dss-cabc-ui-mode = <
					0x29 0x00 0x0a 0x00 0x03 0x99 0x95 0x27
				0x15 0x00 0x0a 0x00 0x02 0x55 0x01
				0x29 0x00 0x0a 0x00 0x03 0x99 0x00 0x00>;
		hisilicon,dss-cabc-still-mode = <
					0x29 0x00 0x0a 0x00 0x03 0x99 0x95 0x27
				0x15 0x00 0x0a 0x00 0x02 0x55 0x02
				0x29 0x00 0x0a 0x00 0x03 0x99 0x00 0x00>;
		hisilicon,dss-cabc-moving-mode = <
					0x29 0x00 0x0a 0x00 0x03 0x99 0x95 0x27
				0x15 0x00 0x0a 0x00 0x02 0x55 0x03
				0x29 0x00 0x0a 0x00 0x03 0x99 0x00 0x00>;
		hisilicon,dss-dot-inversion = <
					0x29 0x00 0x0a 0x00 0x02 0x00 0x00
				0x29 0x00 0x0a 0x00 0x04 0xFF 0x19 0x06 0x01
				0x29 0x00 0x0a 0x00 0x02 0x00 0x80
				0x29 0x00 0x0a 0x00 0x03 0xFF 0x19 0x06
				0x29 0x00 0x0a 0x00 0x02 0x00 0xB3
				0x29 0x00 0x0a 0x00 0x02 0xC0 0x00
				0x29 0x00 0x0a 0x00 0x02 0x00 0x00
				0x29 0x00 0x0a 0x00 0x02 0xFB 0x01
				0x29 0x00 0x0a 0x00 0x02 0x00 0x00
				0x29 0x00 0x0a 0x00 0x04 0xFF 0xFF 0xFF 0xFF>;
		hisilicon,dss-column-inversion = <
					0x29 0x00 0x0a 0x00 0x02 0x00 0x00
				0x29 0x00 0x0a 0x00 0x04 0xFF 0x19 0x06 0x01
				0x29 0x00 0x0a 0x00 0x02 0x00 0x80
				0x29 0x00 0x0a 0x00 0x03 0xFF 0x19 0x06
				0x29 0x00 0x0a 0x00 0x02 0x00 0xB3
				0x29 0x00 0x0a 0x00 0x02 0xC0 0x88
				0x29 0x00 0x0a 0x00 0x02 0x00 0x00
				0x29 0x00 0x0a 0x00 0x02 0xFB 0x01
				0x29 0x00 0x0a 0x00 0x02 0x00 0x00
				0x29 0x00 0x0a 0x00 0x04 0xFF 0xFF 0xFF 0xFF>;
		hisilicon,dss-forword-scan = <
					0x29 0x00 0x0a 0x00 0x02 0x00 0x00
				0x29 0x00 0x0a 0x00 0x04 0xFF 0x19 0x06 0x01
				0x29 0x00 0x0a 0x00 0x02 0x00 0x80
				0x29 0x00 0x0a 0x00 0x03 0xFF 0x19 0x06
				0x29 0x00 0x0a 0x00 0x02 0x00 0xB4
				0x29 0x00 0x0a 0x00 0x02 0xC0 0x00
				0x29 0x00 0x0a 0x00 0x02 0x00 0x00
				0x29 0x00 0x0a 0x00 0x02 0xFB 0x01
				0x29 0x00 0x0a 0x00 0x02 0x00 0x00
				0x29 0x00 0x0a 0x00 0x04 0xFF 0xFF 0xFF 0xFF>;
		hisilicon,dss-revert-scan = <
					0x29 0x00 0x0a 0x00 0x02 0x00 0x00
				0x29 0x00 0x0a 0x00 0x04 0xFF 0x19 0x06 0x01
				0x29 0x00 0x0a 0x00 0x02 0x00 0x80
				0x29 0x00 0x0a 0x00 0x03 0xFF 0x19 0x06
				0x29 0x00 0x0a 0x00 0x02 0x00 0xB4
				0x29 0x00 0x0a 0x00 0x02 0xC0 0x50
				0x29 0x00 0x0a 0x00 0x02 0x00 0x00
				0x29 0x00 0x0a 0x00 0x02 0xFB 0x01
				0x29 0x00 0x0a 0x00 0x02 0x00 0x00
				0x29 0x00 0x0a 0x00 0x04 0xFF 0xFF 0xFF 0xFF>;
		gpios = <&gpio1 7 0>, <&gpio2 4 0>, <&gpio2 5 0>, <&gpio3 0 0>;
		lcdanalog-vcc = <3100000>;
		lcdio-vcc = <1800000>;
		lcd-bias = <5500000>;
		lcd-vsp = <5500000>;
		lcd-vsn = <5500000>;
		lcd-rst-first-high = <15>;
		lcd-rst-low = <5>;
		lcd-rst-second-hight = <15>;
		lcdio-vcc-supply = <&ldo4>;
		lcdanalog-vcc-supply = <&ldo17>;
		lcd_backlight-supply = <&schg_boost2>;
		vcc_lcdbias-supply = <&schg_boost4>;
		lcd_vsp-supply = <&schg_ldo3>;
		lcd_vsn-supply = <&schg_cpn1>;
		pinctrl-names = "default","idle";
		pinctrl-0 = <&gpio015_pmx_func &gpio020_pmx_func &gpio021_pmx_func &gpio024_pmx_func &gpio015_cfg_func &gpio020_cfg_func &gpio021_cfg_func &gpio024_cfg_func>;
		pinctrl-1 = <&gpio015_pmx_idle &gpio020_pmx_idle &gpio021_pmx_idle &gpio024_pmx_idle &gpio015_cfg_idle &gpio020_cfg_idle &gpio021_cfg_idle &gpio024_cfg_idle>;
		status = "disabled";
	};
};
