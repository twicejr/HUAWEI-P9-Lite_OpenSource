/* Copyright (c) 2013, The Linux Foundation. All rights reserved.
 *
 * This program is free software; you can redistribute it and/or modify
 * it under the terms of the GNU General Public License version 2 and
 * only version 2 as published by the Free Software Foundation.
 *
 * This program is distributed in the hope that it will be useful,
 * but WITHOUT ANY WARRANTY; without even the implied warranty of
 * MERCHANTABILITY or FITNESS FOR A PARTICULAR PURPOSE.  See the
 * GNU General Public License for more details.
 */

/*---------------------------------------------------------------------------
 * This file is autogenerated file using gcdb parser. Please do not edit it.
 * Update input XML file to add a new entry or update variable in this file
 * VERSION = "1.0"
 *---------------------------------------------------------------------------*/
/{
	dss_inx_otm1901a_5p2_1080p_video:inx_otm1901a_5p2_1080p_video {
		compatible = "hisilicon,inx_otm1901a_5p2_1080p_video";
		hisilicon,dss-panel-name = "INX_OTM1901A 5.2' VIDEO TFT 1080 x 1920";
		hisilicon,dss-panel-xres = <1080>;
		hisilicon,dss-panel-yres = <1920>;
		hisilicon,dss-panel-width = <65>;
		hisilicon,dss-panel-height = <115>;
		hisilicon,dss-panel-orientation = <1>;
		hisilicon,dss-panel-bpp = <2>;
		hisilicon,dss-panel-bgrfmt = <0>;
		hisilicon,dss-panel-bl-type = <8>;
		hisilicon,dss-panel-blmin = <2>;
		hisilicon,dss-panel-blmax = <255>;
		hisilicon,dss-panel-bl-def = <102>;
		hisilicon,dss-panel-type = <8>;
		hisilicon,dss-panel-ifbc-type = <0>;
		hisilicon,dss-panel-bl-pwm-preci-type = <0>;
		hisilicon,dss-panel-frc-enable = <0>;
		hisilicon,dss-panel-esd-enable = <1>;
		hisilicon,dss-panel-lcd-ajust-support = <1>;
		hisilicon,dss-panel-pxl-clk = <144>;
		hisilicon,dss-panel-pxl-clk-div = <1>;
		hisilicon,dss-panel-dirt-updt-support = <0>;
		hisilicon,dss-panel-dsi-upt-support = <0>;
		hisilicon,dss-panel-vsyn-ctr-type = <0>;
		hisilicon,dss-panel-step-support = <1>;
		hisilicon,dss-panel-esd-skip-mipi-check = <1>;
		hisilicon,dss-ldi-h-back-porch = <10>;
		hisilicon,dss-ldi-h-front-porch = <120>;
		hisilicon,dss-ldi-h-pulse-width = <8>;
		hisilicon,dss-ldi-v-back-porch = <30>;
		hisilicon,dss-ldi-v-front-porch = <10>;
		hisilicon,dss-ldi-v-pulse-width = <10>;
		hisilicon,dss-ldi-hsync-plr = <0>;
		hisilicon,dss-ldi-vsync-plr = <0>;
		hisilicon,dss-ldi-pixel-clk-plr = <0>;
		hisilicon,dss-ldi-data-en-plr = <0>;
		hisilicon,dss-ldi-dpi-a-overlap-size = <0>;
		hisilicon,dss-ldi-dpi-b-overlap-size = <0>;
		hisilicon,dss-sbl-stren-limit = <128>;
		hisilicon,dss-sbl-cal-a = <60>;
		hisilicon,dss-sbl-cal-b = <95>;
		hisilicon,dss-sbl-cal-c = <5>;
		hisilicon,dss-sbl-cal-d = <1>;
		hisilicon,dss-sbl-tf-ctl = <5>;
		hisilicon,dss-sbl-blmin = <480>;
		hisilicon,dss-sbl-blmax = <4096>;
		hisilicon,dss-sbl-bl-scale = <0xff>;
		hisilicon,dss-sbl-am-light-min = <14>;
		hisilicon,dss-sbl-filter-a = <1738>;
		hisilicon,dss-sbl-filter-b = <6>;
		hisilicon,dss-sbl-logo-left = <0>;
		hisilicon,dss-sbl-logo-top = <0>;
		hisilicon,dss-mipi-vc = <0>;
		hisilicon,dss-mipi-lane-nums = <3>;
		hisilicon,dss-mipi-color-mode = <5>;
		hisilicon,dss-mipi-dsi-bit-clk = <490>;
		hisilicon,dss-mipi-burst-mode = <2>;
		hisilicon,dss-mipi-max-esc-clk = <9>;
		hisilicon,dss-mipi-dsi-bit-clk-val-a = <471>;
		hisilicon,dss-mipi-dsi-bit-clk-val-b = <480>;
		hisilicon,dss-mipi-dsi-bit-clk-val-c = <490>;
		hisilicon,dss-mipi-dsi-bit-clk-val-d = <500>;
		hisilicon,dss-mipi-dsi-bit-clk-val-e = <0>;
		hisilicon,dss-mipi-dsi-bit-clk-upt = <490>;
		hisilicon,dss-mipi-rg-vcm-adjust = <6>;
		hisilicon,dss-mipi-non-continue-enable = <1>;
		hisilicon,dss-mipi-clk-post-adjust = <30>;
		hisilicon,dss-dirt-left-align = <2>;
		hisilicon,dss-dirt-right-align = <2>;
		hisilicon,dss-dirt-top-align = <2>;
		hisilicon,dss-dirt-bott-align = <2>;
		hisilicon,dss-dirt-width-align = <2>;
		hisilicon,dss-dirt-height-align = <2>;
		hisilicon,dss-dirt-width-min = <2>;
		hisilicon,dss-dirt-height-min = <2>;
		hisilicon,dss-dirt-top-start = <0xffff>;
		hisilicon,dss-dirt-bott-start = <0xffff>;
		iovcc-off-is-need-delay = <0>;
		iovcc-on-is-need-reset = <0>;
		lcd-ctrl-tp-power = <0>;
		lock-cmd-support = <0>;
		read-power-status = <1>;
		esd-set-backlight = <1>;
		hisilicon,dss-color-temp-support = <0>;
		hisilicon,dss-prefix-ce-support = <0>;
		hisilicon,dss-prefix-sharp-one-d-support = <0>;
		hisilicon,dss-prefix-sharp-two-d-support = <0>;
		hisilicon,dss-sbl-support = <0>;
		hisilicon,dss-gamma-support = <1>;
		hisilicon,dss-gmp-support = <0>;
		hisilicon,dss-xcc-support = <1>;
		hisilicon,dss-acm-support = <1>;
		hisilicon,dss-acm-ce-support = <1>;
		hisilicon,dss-acm-valid-num = <7>;
		hisilicon,dss-acm-r_hh0 = <0x80>;
		hisilicon,dss-acm-r_lh0 = <0x12>;
		hisilicon,dss-acm-r_hh1 = <0xfd>;
		hisilicon,dss-acm-r_lh1 = <0x81>;
		hisilicon,dss-acm-r_hh2 = <0x17f>;
		hisilicon,dss-acm-r_lh2 = <0xfe>;
		hisilicon,dss-acm-r_hh3 = <0x1ff>;
		hisilicon,dss-acm-r_lh3 = <0x180>;
		hisilicon,dss-acm-r_hh4 = <0x27f>;
		hisilicon,dss-acm-r_lh4 = <0x200>;
		hisilicon,dss-acm-r_hh5 = <0x3bf>;
		hisilicon,dss-acm-r_lh5 = <0x280>;
		hisilicon,dss-acm-r_hh6 = <0x3f7>;
		hisilicon,dss-acm-r_lh6 = <0x3c0>;

		hisilicon,dss-on-cmds = <
					0x29 0x00 0x0a 0x00 0x02 0x00 0x00
				0x29 0x00 0x0a 0x00 0x05 0xFF 0x19 0x01 0x01 0x00
				0x29 0x00 0x0a 0x00 0x02 0x00 0x80
				0x29 0x00 0x0a 0x00 0x03 0xFF 0x19 0x01
				0x29 0x00 0x0a 0x00 0x02 0x00 0xDA
				0x29 0x00 0x0a 0x01 0x02 0xF5 0x21
				0x29 0x00 0x0a 0x00 0x02 0x00 0x00
				0x29 0x00 0x0a 0x01 0x02 0xFB 0x01
				0x29 0x00 0x0a 0x00 0x02 0x00 0x00
				0x29 0x00 0x0a 0x01 0x02 0xEB 0x10
				0x29 0x00 0x0a 0x00 0x02 0x00 0x02
				0x29 0x00 0x0a 0x01 0x02 0xFF 0x03
				0x29 0x00 0x0a 0x00 0x02 0x00 0x00
				0x29 0x00 0x0a 0x01 0x02 0xC0 0x00
				0x29 0x00 0x0a 0x00 0x02 0x00 0x02
				0x29 0x00 0x0a 0x01 0x02 0xFF 0x01
				0x29 0x00 0x0a 0x00 0x02 0x00 0x00
				0x29 0x00 0x0a 0x00 0x02 0x1C 0x33
				0x29 0x00 0x0a 0x00 0x02 0x00 0xA0
				0x29 0x00 0x0a 0x00 0x02 0xC1 0xE8
				0x29 0x00 0x0a 0x00 0x02 0x00 0xA7
				0x29 0x00 0x0a 0x00 0x02 0xC1 0x00
				0x29 0x00 0x0a 0x00 0x02 0x00 0x90
				0x29 0x00 0x0a 0x00 0x07 0xC0 0x00 0x2F 0x00 0x00 0x00 0x01
				0x29 0x00 0x0a 0x00 0x02 0x00 0xC0
				0x29 0x00 0x0a 0x00 0x07 0xC0 0x00 0x2F 0x00 0x00 0x00 0x01
				0x29 0x00 0x0a 0x00 0x02 0x00 0x9A
				0x29 0x00 0x0a 0x00 0x02 0xC0 0x1E
				0x29 0x00 0x0a 0x00 0x02 0x00 0xAC
				0x29 0x00 0x0a 0x00 0x02 0xC0 0x06
				0x29 0x00 0x0a 0x00 0x02 0x00 0xDC
				0x29 0x00 0x0a 0x00 0x02 0xC0 0x06
				0x29 0x00 0x0a 0x00 0x02 0x00 0x81
				0x29 0x00 0x0a 0x00 0x02 0xA5 0x04
				0x29 0x00 0x0a 0x00 0x02 0x00 0xD0
				0x29 0x00 0x0a 0x00 0x05 0xF5 0x00 0x00 0x00 0x00
				0x29 0x00 0x0a 0x00 0x02 0x00 0x92
				0x29 0x00 0x0a 0x00 0x02 0xE9 0x00
				0x29 0x00 0x0a 0x00 0x02 0x00 0x93
				0x29 0x00 0x0a 0x00 0x02 0xC5 0x1F
				0x29 0x00 0x0a 0x00 0x02 0x00 0x97
				0x29 0x00 0x0a 0x00 0x02 0xC5 0x1E
				0x29 0x00 0x0a 0x00 0x02 0x00 0x95
				0x29 0x00 0x0a 0x00 0x02 0xC5 0x12
				0x29 0x00 0x0a 0x00 0x02 0x00 0x99
				0x29 0x00 0x0a 0x00 0x02 0xC5 0x11
				0x29 0x00 0x0a 0x00 0x02 0x00 0xB3
				0x29 0x00 0x0a 0x00 0x02 0xC0 0xCC
				0x29 0x00 0x0a 0x00 0x02 0x00 0xBC
				0x29 0x00 0x0a 0x00 0x02 0xC0 0x00
				0x29 0x00 0x0a 0x00 0x02 0x00 0x80
				0x29 0x00 0x0a 0x00 0x0F 0xC0 0x00 0x84 0x00 0x08 0x08 0x00 0x84 0x08 0x08 0x00 0x84 0x00 0x08 0x08
				0x29 0x00 0x0a 0x00 0x02 0x00 0xF0
				0x29 0x00 0x0a 0x00 0x07 0xC3 0x11 0x01 0x00 0x00 0x00 0x0C
				0x29 0x00 0x0a 0x00 0x02 0x00 0xA0
				0x29 0x00 0x0a 0x00 0x08 0xC0 0x00 0x00 0x00 0x00 0x00 0x1C 0x08
				0x29 0x00 0x0a 0x00 0x02 0x00 0xD0
				0x29 0x00 0x0a 0x00 0x08 0xC0 0x00 0x00 0x00 0x00 0x00 0x1D 0x07
				0x29 0x00 0x0a 0x00 0x02 0x00 0x90
				0x29 0x00 0x0a 0x00 0x09 0xc2 0x82 0x00 0x03 0x8c 0x81 0x00 0x03 0x8c
				0x29 0x00 0x0a 0x00 0x02 0x00 0x80
				0x29 0x00 0x0a 0x00 0x0D 0xc3 0x80 0x01 0x07 0x00 0x03 0x8c 0x01 0x02 0x07 0x00 0x03 0x8c
				0x29 0x00 0x0a 0x00 0x02 0x00 0x90
				0x29 0x00 0x0a 0x00 0x0D 0xc3 0x02 0x03 0x07 0x00 0x03 0x8c 0x03 0x04 0x07 0x00 0x03 0x8c
				0x29 0x00 0x0a 0x00 0x02 0x00 0xa0
				0x29 0x00 0x0a 0x00 0x0D 0xc3 0x04 0x05 0x07 0x00 0x03 0x8c 0x05 0x06 0x07 0x00 0x03 0x8c
				0x29 0x00 0x0a 0x00 0x02 0x00 0xb0
				0x29 0x00 0x0a 0x00 0x0D 0xc3 0x06 0x07 0x07 0x00 0x03 0x8c 0x07 0x08 0x07 0x00 0x03 0x8c
				0x29 0x00 0x0a 0x00 0x02 0x00 0x80
				0x29 0x00 0x0a 0x00 0x10 0xCC 0x09 0x0A 0x11 0x12 0x13 0x14 0x15 0x16 0x17 0x18 0x28 0x28 0x28 0x28 0x28
				0x29 0x00 0x0a 0x00 0x02 0x00 0x90
				0x29 0x00 0x0a 0x00 0x10 0xCC 0x0A 0x09 0x18 0x17 0x16 0x15 0x14 0x13 0x12 0x11 0x28 0x28 0x28 0x28 0x28
				0x29 0x00 0x0a 0x00 0x02 0x00 0xA0
				0x29 0x00 0x0a 0x00 0x10 0xCC 0x1D 0x1E 0x1F 0x19 0x1A 0x1B 0x1C 0x20 0x0B 0x22 0x23 0x24 0x25 0x26 0x27
				0x29 0x00 0x0a 0x00 0x02 0x00 0xB0
				0x29 0x00 0x0a 0x00 0x09 0xCC 0x01 0x02 0x03 0x05 0x06 0x07 0x04 0x08
				0x29 0x00 0x0a 0x00 0x02 0x00 0xC0
				0x29 0x00 0x0a 0x00 0x0D 0xCC 0x00 0x00 0x00 0x00 0x00 0x00 0x00 0x00 0x00 0x00 0x00 0x77
				0x29 0x00 0x0a 0x00 0x02 0x00 0xD0
				0x29 0x00 0x0a 0x00 0x0D 0xCC 0x00 0x00 0xF0 0xFF 0xFF 0x3F 0xFC 0x0F 0x00 0x00 0x00 0x77
				0x29 0x00 0x0a 0x00 0x02 0x00 0x80
				0x29 0x00 0x0a 0x00 0x10 0xCB 0x00 0x00 0x00 0x00 0x00 0x00 0x00 0x00 0x00 0x00 0x00 0x00 0x00 0x00 0x00
				0x29 0x00 0x0a 0x00 0x02 0x00 0x90
				0x29 0x00 0x0a 0x00 0x10 0xCB 0x00 0x00 0x00 0x00 0x00 0x00 0x00 0x00 0x3F 0x00 0x00 0x00 0x00 0x00 0x00
				0x29 0x00 0x0a 0x00 0x02 0x00 0xA0
				0x29 0x00 0x0a 0x00 0x10 0xCB 0x01 0x01 0x01 0x01 0x01 0x01 0x01 0x01 0x01 0x01 0x00 0x00 0x00 0x00 0x00
				0x29 0x00 0x0a 0x00 0x02 0x00 0xB0
				0x29 0x00 0x0a 0x00 0x10 0xCB 0x05 0x05 0x05 0x00 0x00 0x00 0x00 0x3C 0x15 0x00 0x00 0x00 0x00 0x00 0x00
				0x29 0x00 0x0a 0x00 0x02 0x00 0xC0
				0x29 0x00 0x0a 0x00 0x09 0xCB 0x00 0x00 0x00 0x33 0x33 0x33 0x77 0x77
				0x29 0x00 0x0a 0x00 0x02 0x00 0xD0
				0x29 0x00 0x0a 0x00 0x09 0xCB 0x00 0x00 0x00 0x00 0x00 0x00 0x77 0x77
				0x29 0x00 0x0a 0x00 0x02 0x00 0xE0
				0x29 0x00 0x0a 0x00 0x09 0xCB 0x03 0x03 0x03 0x00 0x00 0x00 0x77 0x77
				0x29 0x00 0x0a 0x00 0x02 0x00 0xF0
				0x29 0x00 0x0a 0x00 0x09 0xCB 0x31 0x31 0x31 0x01 0x01 0x01 0x77 0x77
				0x29 0x00 0x0a 0x00 0x02 0x00 0xA0
				0x29 0x00 0x0a 0x00 0x10 0xCD 0x3D 0x3D 0x3D 0x3D 0x3D 0x3D 0x3D 0x3D 0x01 0x03 0x05 0x07 0x09 0x3D 0x3D 
				0x29 0x00 0x0a 0x00 0x02 0x00 0x90
				0x29 0x00 0x0a 0x00 0x0C 0xCD 0x18 0x17 0x17 0x25 0x25 0x25 0x1F 0x20 0x21 0x25 0x25
				0x29 0x00 0x0a 0x00 0x02 0x00 0x80
				0x29 0x00 0x0a 0x00 0x10 0xCD 0x3D 0x3D 0x3D 0x3D 0x3D 0x3D 0x3D 0x3D 0x02 0x04 0x06 0x08 0x0A 0x3D 0x3D
				0x29 0x00 0x0a 0x00 0x02 0x00 0xB0
				0x29 0x00 0x0a 0x00 0x0C 0xCD 0x18 0x17 0x17 0x25 0x25 0x25 0x1F 0x20 0x21 0x25 0x25
				0x29 0x00 0x0a 0x00 0x02 0x00 0x89
				0x29 0x00 0x0a 0x00 0x02 0xF3 0x5A
				0x29 0x00 0x0a 0x00 0x02 0x00 0x90
				0x29 0x00 0x0a 0x00 0x02 0xF3 0x01
				0x29 0x00 0x0a 0x00 0x02 0x00 0x82
				0x29 0x00 0x0a 0x00 0x02 0xA5 0x1F
				0x29 0x00 0x0a 0x00 0x02 0x00 0xC2
				0x29 0x00 0x0a 0x00 0x02 0xC5 0x1C
				0x29 0x00 0x0a 0x00 0x02 0x00 0xDC
				0x29 0x00 0x0a 0x00 0x02 0xC0 0x04
				0x29 0x00 0x0a 0x00 0x02 0x00 0xAC
				0x29 0x00 0x0a 0x00 0x02 0xC0 0x04
				0x29 0x00 0x0a 0x00 0x02 0x00 0xC1
				0x29 0x00 0x0a 0x00 0x02 0xC5 0x77
				0x29 0x00 0x0a 0x00 0x02 0x00 0xCD
				0x29 0x00 0x0a 0x00 0x02 0xf5 0x19
				0x29 0x00 0x0a 0x00 0x02 0x00 0xDB
				0x29 0x00 0x0a 0x00 0x02 0xf5 0x19
				0x29 0x00 0x0a 0x00 0x02 0x00 0xF5
				0x29 0x00 0x0a 0x00 0x02 0xC1 0x40
				0x29 0x00 0x0a 0x00 0x02 0x00 0xB9
				0x29 0x00 0x0a 0x00 0x02 0xC0 0x11
				0x29 0x00 0x0a 0x00 0x02 0x00 0x8D
				0x29 0x00 0x0a 0x00 0x02 0xF5 0x20
				0x29 0x00 0x0a 0x00 0x02 0x00 0xF7
				0x29 0x00 0x0a 0x00 0x05 0xC3 0x02 0x10 0x00 0x00
				0x29 0x00 0x0a 0x00 0x02 0x00 0x80
				0x29 0x00 0x0a 0x00 0x02 0xC4 0x1C
				0x29 0x00 0x0a 0x00 0x02 0x00 0x83
				0x29 0x00 0x0a 0x00 0x02 0xC4 0x00
				0x29 0x00 0x0a 0x00 0x02 0x00 0x84
				0x29 0x00 0x0a 0x00 0x02 0xC4 0x20
				0x29 0x00 0x0a 0x00 0x02 0x00 0xA0
				0x29 0x00 0x0a 0x00 0x09 0xC2 0x86 0x01 0x03 0x8C 0x00 0x00 0x00 0x00
				0x29 0x00 0x0a 0x00 0x02 0x00 0x00
				0x29 0x00 0x0a 0x00 0x19 0xE1 0x0A 0x0F 0x14 0x1C 0x22 0x28 0x31 0x42 0x4B 0x60 0x6F 0x7A 0x7D 0x74 0x6E 0x5E 0x4B 0x3B 0x30 0x27 0x1E 0x18 0x12 0x03
				0x29 0x00 0x0a 0x00 0x02 0x00 0x00
				0x29 0x00 0x0a 0x00 0x19 0xE2 0x0A 0x0F 0x14 0x1C 0x22 0x28 0x31 0x42 0x4B 0x60 0x6F 0x7A 0x7D 0x74 0x6E 0x5E 0x4B 0x3B 0x30 0x27 0x1E 0x18 0x12 0x03
				0x29 0x00 0x0a 0x00 0x02 0x00 0x00
				0x29 0x00 0x0a 0x00 0x19 0xE3 0x0A 0x0F 0x14 0x1C 0x22 0x28 0x31 0x42 0x4B 0x60 0x6F 0x7A 0x7D 0x74 0x6E 0x5E 0x4B 0x3B 0x30 0x27 0x1E 0x18 0x12 0x03
				0x29 0x00 0x0a 0x00 0x02 0x00 0x00
				0x29 0x00 0x0a 0x00 0x19 0xE4 0x0A 0x0F 0x14 0x1C 0x22 0x28 0x31 0x42 0x4B 0x60 0x6F 0x7A 0x7D 0x74 0x6E 0x5E 0x4B 0x3B 0x30 0x27 0x1E 0x18 0x12 0x03
				0x29 0x00 0x0a 0x00 0x02 0x00 0x00
				0x29 0x00 0x0a 0x00 0x19 0xE5 0x0A 0x0F 0x14 0x1C 0x22 0x28 0x31 0x42 0x4B 0x60 0x6F 0x7A 0x7D 0x74 0x6E 0x5E 0x4B 0x3B 0x30 0x27 0x1E 0x18 0x12 0x03
				0x29 0x00 0x0a 0x00 0x02 0x00 0x00
				0x29 0x00 0x0a 0x00 0x19 0xE6 0x0A 0x0F 0x14 0x1C 0x22 0x28 0x31 0x42 0x4B 0x60 0x6F 0x7A 0x7D 0x74 0x6E 0x5E 0x4B 0x3B 0x30 0x27 0x1E 0x18 0x12 0x03
				0x29 0x00 0x0a 0x00 0x02 0x00 0xB0
				0x29 0x00 0x0a 0x00 0x02 0xCA 0x01
				0x29 0x00 0x0a 0x00 0x02 0x00 0xB1
				0x29 0x00 0x0a 0x00 0x02 0xCA 0x01
				0x29 0x00 0x0a 0x00 0x02 0x00 0xB3
				0x29 0x00 0x0a 0x00 0x02 0xCA 0x40
				0x29 0x00 0x0a 0x00 0x02 0x00 0xA0
				0x29 0x00 0x0a 0x00 0x09 0xc2 0x86 0x01 0x03 0x8c 0x00 0x00 0x00 0x00
				0x29 0x00 0x0a 0x00 0x02 0x00 0xA8
				0x29 0x00 0x0a 0x00 0x02 0xCC 0x0B
				0x29 0x00 0x0a 0x00 0x02 0x00 0xB8
				0x29 0x00 0x0a 0x00 0x02 0xCB 0x15
				0x29 0x00 0x0a 0x00 0x02 0x00 0x00
				0x29 0x00 0x0a 0x00 0x04 0xff 0xff 0xff 0xff
				0x15 0x00 0x0a 0x00 0x02 0x51 0x00
				0x15 0x00 0x0a 0x00 0x02 0x53 0x24
				0x15 0x00 0x0a 0x00 0x02 0x55 0x01
				0x15 0x00 0x0a 0x00 0x02 0x5E 0x28
				0x05 0x00 0x78 0x01 0x02 0x11 0x00
				0x05 0x00 0x14 0x01 0x02 0x29 0x00>;
		hisilicon,dss-off-cmds = <
					0x05 0x00 0x14 0x01 0x02 0x28 0x00
				0x05 0x00 0x78 0x01 0x02 0x10 0x00>;
		hisilicon,dss-esd-reg = <
					0x0a 0x0d>;
		hisilicon,dss-esd-value = <
					0x9c 0x00>;
		hisilicon,dss-mipi-check-reg = <
					0x0a 0x0b 0x0c 0x0d>;
		hisilicon,dss-mipi-check-value = <
					0x9c 0x00 0x07 0x00>;
		hisilicon,dss-cabc-off-mode = <
					0x15 0x00 0x0a 0x00 0x02 0x55 0x00>;
		hisilicon,dss-cabc-ui-mode = <
					0x15 0x00 0x0a 0x00 0x02 0x55 0x01>;
		hisilicon,dss-cabc-still-mode = <
					0x15 0x00 0x0a 0x00 0x02 0x55 0x02>;
		hisilicon,dss-cabc-moving-mode = <
					0x15 0x00 0x0a 0x00 0x02 0x55 0x03>;
		hisilicon,dss-dot-inversion = <
					0x29 0x00 0x0a 0x00 0x02 0x00 0x00
				0x29 0x00 0x0a 0x00 0x04 0xFF 0x19 0x01 0x01
				0x29 0x00 0x0a 0x00 0x02 0x00 0x80
				0x29 0x00 0x0a 0x00 0x03 0xFF 0x19 0x01
				0x29 0x00 0x0a 0x00 0x02 0x00 0xB3
				0x29 0x00 0x0a 0x00 0x02 0xC0 0xDD
				0x29 0x00 0x0a 0x00 0x02 0x00 0xBC
				0x29 0x00 0x0a 0x00 0x02 0xC0 0x11
				0x29 0x00 0x0a 0x00 0x02 0x00 0x00
				0x29 0x00 0x0a 0x00 0x02 0xFB 0x01
				0x29 0x00 0x0a 0x00 0x02 0x00 0x00
				0x29 0x00 0x0a 0x00 0x04 0xFF 0xFF 0xFF 0xFF>;
		hisilicon,dss-column-inversion = <
					0x29 0x00 0x0a 0x00 0x02 0x00 0x00
				0x29 0x00 0x0a 0x00 0x04 0xFF 0x19 0x01 0x01
				0x29 0x00 0x0a 0x00 0x02 0x00 0x80
				0x29 0x00 0x0a 0x00 0x03 0xFF 0x19 0x01
				0x29 0x00 0x0a 0x00 0x02 0x00 0xB3
				0x29 0x00 0x0a 0x00 0x02 0xC0 0xCC
				0x29 0x00 0x0a 0x00 0x02 0x00 0xBC
				0x29 0x00 0x0a 0x00 0x02 0xC0 0x00
				0x29 0x00 0x0a 0x00 0x02 0x00 0x00
				0x29 0x00 0x0a 0x00 0x02 0xFB 0x01
				0x29 0x00 0x0a 0x00 0x02 0x00 0x00
				0x29 0x00 0x0a 0x00 0x04 0xFF 0xFF 0xFF 0xFF>;
		hisilicon,dss-forword-scan = <
					0x29 0x00 0x0a 0x00 0x02 0x00 0x00
				0x29 0x00 0x0a 0x00 0x04 0xFF 0x19 0x01 0x01
				0x29 0x00 0x0a 0x00 0x02 0x00 0x80
				0x29 0x00 0x0a 0x00 0x03 0xFF 0x19 0x01
				0x29 0x00 0x0a 0x00 0x02 0x00 0xB4
				0x29 0x00 0x0a 0x00 0x02 0xC0 0x80
				0x29 0x00 0x0a 0x00 0x02 0x00 0x00
				0x29 0x00 0x0a 0x00 0x02 0xFB 0x01
				0x29 0x00 0x0a 0x00 0x02 0x00 0x00
				0x29 0x00 0x0a 0x00 0x04 0xFF 0xFF 0xFF 0xFF>;
		hisilicon,dss-revert-scan = <
					0x29 0x00 0x0a 0x00 0x02 0x00 0x00
				0x29 0x00 0x0a 0x00 0x04 0xFF 0x19 0x01 0x01
				0x29 0x00 0x0a 0x00 0x02 0x00 0x80
				0x29 0x00 0x0a 0x00 0x03 0xFF 0x19 0x01
				0x29 0x00 0x0a 0x00 0x02 0x00 0xB4
				0x29 0x00 0x0a 0x00 0x02 0xC0 0xD0
				0x29 0x00 0x0a 0x00 0x02 0x00 0x00
				0x29 0x00 0x0a 0x00 0x02 0xFB 0x01
				0x29 0x00 0x0a 0x00 0x02 0x00 0x00
				0x29 0x00 0x0a 0x00 0x04 0xFF 0xFF 0xFF 0xFF>;
		gpios = <&gpio1 7 0>, <&gpio2 4 0>, <&gpio2 5 0>, <&gpio3 0 0>;
		lcdanalog-vcc = <3100000>;
		lcdio-vcc = <1800000>;
		lcd-bias = <5400000>;
		lcd-vsp = <5400000>;
		lcd-vsn = <5400000>;
		lcd-rst-first-high = <15>;
		lcd-rst-low = <5>;
		lcd-rst-second-hight = <15>;
		lcdio-vcc-supply = <&ldo4>;
		lcdanalog-vcc-supply = <&ldo17>;
		lcd_backlight-supply = <&schg_boost2>;
		vcc_lcdbias-supply = <&schg_boost4>;
		lcd_vsp-supply = <&schg_ldo3>;
		lcd_vsn-supply = <&schg_cpn1>;
		pinctrl-names = "default","idle";
		pinctrl-0 = <&gpio015_pmx_func &gpio020_pmx_func &gpio021_pmx_func &gpio024_pmx_func &gpio015_cfg_func &gpio020_cfg_func &gpio021_cfg_func &gpio024_cfg_func>;
		pinctrl-1 = <&gpio015_pmx_idle &gpio020_pmx_idle &gpio021_pmx_idle &gpio024_pmx_idle &gpio015_cfg_idle &gpio020_cfg_idle &gpio021_cfg_idle &gpio024_cfg_idle>;
		status = "disabled";
	};
};
