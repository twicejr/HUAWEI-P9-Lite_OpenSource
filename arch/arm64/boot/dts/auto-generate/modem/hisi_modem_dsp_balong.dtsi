/*
 * Hisilicon Ltd Balong SOC
 */

/include/ "skeleton.dtsi"

/{
	dsp_dtcm_mdm:dsp@49000000 {
		compatible = "hisilicon,dsp_balong_dtcm";
		bbe16_pd_clk_stat = <0xe0200000 0x8 0 0>;
        bbe16_core_clk_stat = <0xe0200000 0x8 1 1>;
        bbe16_pd_srst_stat = <0xe0200000 0x28 0 0>;
        bbe16_core_srst_stat =<0xe0200000 0x28 1 1>;
        bbe16_mtcmos_rdy_stat = <0xe0200000 0xe04 1 1>;
        bbe16_iso_ctrl_stat = <0xe0200000 0xc14 1 1>;
		status = "ok";
	};
};