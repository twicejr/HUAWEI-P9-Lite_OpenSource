/* DO NOT EDIT - Automatically generated by python */
/ {
		scudatl_3400_39k_4400:scudatl_3400_39k_4400 {
			fcc = <3400>;
			default_rbatt_mohm = <100>;
			id_identify_min = <1235>;
			id_identify_max = <1759>;
			id_voltage_min = <1420>;
			id_voltage_max = <1562>;
			vbat_max = <4400>;
			temp_para = 
						"-32767","0","-1","0","4100","0",
						"0","10","-1","1020","4400","3",
						"10","45","-1","-1","4400","3",
						"45","50","-1","1190","4400","3",
						"50","32767","-1","0","4400","0";
			vbat_para = 
						"-32767","3400","-1","820","0",
						"3400","32767","-1","-1","0";
			segment_para = 
						"-32767","4150","3400","4208","50",
						"4150","4450","2380","4400","0";
			batt_brand = "scudatl";
			fcc_temp = <3467 3464 3461 3485 3474 3452>;
			fcc_sf_x = <0 100 200 300 400 500>;
			fcc_sf_y = <100 96 94 92 90 88>;
			fcc_sf_cols = <6>;
			pc_sf_rows = <1>;
			pc_sf_cols = <1>;
			pc_sf_row_entries = <0>;
			pc_sf_percent = <100>;
			pc_sf_sf = <100>;
			rbatt_sf_rows = <28>;
			rbatt_sf_cols = <6>;
			rbatt_sf_percent = <100 95 90 85 80 75 70 65 60 55 50 45 40 35 30 25 20 15 10 9 8 7 6 5 4 3 2 1>;
			rbatt_sf_sf = <
			               1939 983 428 113 94 85
			               1936 983 428 113 94 85
			               1751 968 424 114 95 86
			               1617 948 424 117 96 87
			               1512 923 431 120 99 88
			               1489 947 444 125 102 90
			               1321 891 475 134 107 93
			               1309 804 407 146 114 97
			               1310 814 395 150 122 102
			               1307 802 381 119 100 89
			               1325 806 380 111 94 86
			               1365 827 383 112 95 87
			               1422 886 389 115 98 89
			               1493 959 420 119 103 93
			               1574 1050 462 119 103 93
			               1669 1156 518 114 95 87
			               1783 1290 588 113 95 87
			               1936 1427 687 114 95 86
			               2434 1137 554 113 97 88
			               2774 1261 581 114 97 91
			               3158 1417 616 114 97 89
			               3576 1592 674 118 98 91
			               4073 1813 758 117 98 90
			               4662 2092 851 117 97 88
			               5329 2428 951 116 96 90
			               6178 2876 1110 119 99 91
			               7310 3557 1416 128 101 91
			               8996 4696 1978 169 117 109
			              >;
			pc_temp_ocv_rows = <29>;
			pc_temp_ocv_cols = <6>;
			pc_temp_ocv_percent = <100 95 90 85 80 75 70 65 60 55 50 45 40 35 30 25 20 15 10 9 8 7 6 5 4 3 2 1>;
			pc_temp_ocv_ocv = <
			                   4387 4384 4381 4376 4371 4366
			                   4299 4309 4312 4314 4311 4306
			                   4233 4244 4251 4255 4252 4249
			                   4173 4185 4193 4197 4195 4191
			                   4113 4126 4139 4141 4139 4136
			                   4070 4083 4088 4087 4085 4083
			                   3974 4017 4036 4038 4036 4033
			                   3929 3945 3964 3988 3988 3988
			                   3893 3909 3923 3944 3946 3945
			                   3858 3871 3882 3891 3891 3891
			                   3832 3838 3849 3856 3856 3857
			                   3813 3814 3822 3831 3831 3831
			                   3799 3801 3801 3810 3811 3810
			                   3786 3791 3790 3793 3794 3792
			                   3774 3781 3780 3777 3776 3772
			                   3761 3769 3769 3760 3753 3742
			                   3747 3752 3752 3740 3732 3720
			                   3730 3727 3725 3715 3707 3695
			                   3704 3698 3695 3691 3684 3672
			                   3697 3693 3692 3690 3683 3671
			                   3691 3690 3689 3688 3681 3669
			                   3685 3686 3685 3686 3678 3667
			                   3675 3679 3679 3681 3673 3661
			                   3658 3666 3666 3666 3656 3641
			                   3627 3636 3635 3629 3619 3602
			                   3578 3585 3584 3576 3568 3551
			                   3507 3515 3516 3506 3500 3483
			                   3403 3415 3418 3405 3400 3383
			                   3200 3200 3200 3200 3200 3200
			                  >;
		};
};
