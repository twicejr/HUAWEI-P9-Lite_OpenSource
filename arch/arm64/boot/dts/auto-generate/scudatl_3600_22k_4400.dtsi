/* DO NOT EDIT - Automatically generated by python */
/ {
		scudatl_3600_22k_4400:scudatl_3600_22k_4400 {
			fcc = <3600>;
			default_rbatt_mohm = <100>;
			id_identify_min = <751>;
			id_identify_max = <1235>;
			id_voltage_min = <949>;
			id_voltage_max = <1051>;
			vbat_max = <4400>;
			temp_para = 
						"-32767","0","-1","0","4100","0",
						"0","10","-1","1080","4400","3",
						"10","45","-1","-1","4400","3",
						"45","50","-1","1260","4400","3",
						"50","32767","-1","0","4400","0";
			vbat_para = 
						"-32767","3400","-1","820","0",
						"3400","32767","-1","-1","0";
			segment_para = 
						"-32767","4150","3600","4208","50",
						"4150","4450","2520","4400","0";
			batt_brand = "scudatl";
			fcc_temp = <3647 3647 3646 3669 3648 3631>;
			fcc_sf_x = <0 100 200 300 400 500>;
			fcc_sf_y = <100 96 94 92 90 88>;
			fcc_sf_cols = <6>;
			pc_sf_rows = <1>;
			pc_sf_cols = <1>;
			pc_sf_row_entries = <0>;
			pc_sf_percent = <100>;
			pc_sf_sf = <100>;
			rbatt_sf_rows = <28>;
			rbatt_sf_cols = <6>;
			rbatt_sf_percent = <100 95 90 85 80 75 70 65 60 55 50 45 40 35 30 25 20 15 10 9 8 7 6 5 4 3 2 1>;
			rbatt_sf_sf = <
			               1732 774 351 117 96 89
			               1730 774 351 117 96 89
			               1600 768 350 119 97 90
			               1481 755 353 122 100 91
			               1423 745 359 126 102 93
			               1398 774 377 132 105 95
			               1231 740 403 142 111 98
			               1221 666 355 154 119 103
			               1218 676 335 157 128 111
			               1190 668 324 123 105 95
			               1208 657 322 116 96 91
			               1256 678 319 117 98 91
			               1307 730 323 121 101 94
			               1366 793 337 125 107 97
			               1436 868 367 126 107 99
			               1527 960 404 121 98 92
			               1642 1082 444 117 97 91
			               1805 1268 508 117 98 91
			               2110 1069 458 119 99 94
			               2449 1167 453 120 99 93
			               2767 1288 479 121 100 95
			               3154 1474 518 121 102 95
			               3524 1671 573 122 102 95
			               4060 1914 635 118 100 92
			               4651 2269 675 122 99 93
			               5450 2685 759 129 102 95
			               6613 3455 937 135 105 95
			               8835 4863 1471 270 119 107
			              >;
			pc_temp_ocv_rows = <29>;
			pc_temp_ocv_cols = <6>;
			pc_temp_ocv_percent = <100 95 90 85 80 75 70 65 60 55 50 45 40 35 30 25 20 15 10 9 8 7 6 5 4 3 2 1>;
			pc_temp_ocv_ocv = <
			                   4389 4386 4383 4376 4371 4364
			                   4306 4315 4318 4317 4312 4306
			                   4236 4254 4258 4258 4254 4248
			                   4170 4194 4200 4200 4196 4191
			                   4119 4135 4144 4143 4140 4135
			                   4078 4089 4093 4089 4086 4082
			                   3979 4023 4040 4040 4037 4032
			                   3932 3948 3967 3988 3989 3987
			                   3895 3913 3924 3942 3946 3944
			                   3852 3875 3885 3889 3891 3889
			                   3822 3837 3852 3855 3856 3854
			                   3805 3811 3823 3830 3830 3829
			                   3790 3796 3801 3809 3810 3808
			                   3776 3785 3787 3792 3793 3790
			                   3762 3773 3778 3776 3776 3772
			                   3749 3759 3768 3759 3754 3742
			                   3737 3739 3750 3738 3732 3720
			                   3725 3718 3724 3712 3707 3695
			                   3703 3701 3698 3690 3683 3672
			                   3696 3696 3694 3689 3682 3671
			                   3687 3691 3692 3687 3681 3670
			                   3678 3686 3689 3684 3679 3667
			                   3662 3677 3684 3676 3674 3662
			                   3641 3659 3671 3650 3659 3642
			                   3609 3628 3639 3605 3625 3603
			                   3560 3576 3586 3546 3574 3551
			                   3493 3505 3513 3466 3507 3482
			                   3394 3403 3408 3345 3408 3382
			                   3200 3200 3200 3200 3200 3200
			                  >;
		};
};
