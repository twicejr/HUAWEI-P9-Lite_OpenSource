/* DO NOT EDIT - Automatically generated by python */
/ {
		scudsdi_4000_470k_4400:scudsdi_4000_470k_4400 {
			fcc = <4000>;
			default_rbatt_mohm = <100>;
			id_identify_min = <3312>;
			id_identify_max = <3767>;
			id_voltage_min = <3457>;
			id_voltage_max = <3696>;
			vbat_max = <4400>;
			temp_para = 
						"-32767","0","-1","0","4100","0",
						"0","10","-1","1200","4400","3",
						"10","45","-1","-1","4400","3",
						"45","50","-1","1400","4400","3",
						"50","32767","-1","0","4400","0";
			vbat_para = 
						"-32767","3400","-1","820","0",
						"3400","32767","-1","-1","0";
			segment_para = 
						"-32767","4150","4000","4208","50",
						"4150","4450","2800","4400","0";
			batt_brand = "scudsdi";
			fcc_temp = <4015 4012 4013 4041 4022 3992>;
			fcc_sf_x = <0 100 200 300 400 500>;
			fcc_sf_y = <100 96 94 92 90 88>;
			fcc_sf_cols = <6>;
			pc_sf_rows = <1>;
			pc_sf_cols = <1>;
			pc_sf_row_entries = <0>;
			pc_sf_percent = <100>;
			pc_sf_sf = <100>;
			rbatt_sf_rows = <28>;
			rbatt_sf_cols = <6>;
			rbatt_sf_percent = <100 95 90 85 80 75 70 65 60 55 50 45 40 35 30 25 20 15 10 9 8 7 6 5 4 3 2 1>;
			rbatt_sf_sf = <
			               1644 928 429 124 94 86
			               1641 928 429 124 94 86
			               1543 924 431 127 96 87
			               1460 916 434 130 98 88
			               1384 890 442 135 101 89
			               1331 898 466 144 106 91
			               1162 808 470 158 114 94
			               1162 729 390 163 116 98
			               1153 723 388 168 124 103
			               1151 710 373 134 113 99
			               1197 704 363 121 95 87
			               1259 748 361 122 97 88
			               1329 812 368 126 100 90
			               1404 889 402 130 104 94
			               1485 966 456 132 105 93
			               1575 1044 521 130 99 88
			               1684 1133 582 128 98 89
			               1816 1251 656 126 98 88
			               2448 1115 539 120 100 89
			               2557 1194 555 122 97 90
			               2705 1239 599 126 99 92
			               2872 1372 662 127 100 93
			               2991 1456 720 128 101 93
			               3193 1555 800 125 99 90
			               3364 1632 827 124 98 89
			               3593 1734 836 130 100 91
			               3842 1890 901 135 102 90
			               4291 2162 1017 152 108 92
			              >;
			pc_temp_ocv_rows = <29>;
			pc_temp_ocv_cols = <6>;
			pc_temp_ocv_percent = <100 95 90 85 80 75 70 65 60 55 50 45 40 35 30 25 20 15 10 9 8 7 6 5 4 3 2 1>;
			pc_temp_ocv_ocv = <
			                   4392 4388 4385 4374 4366 4359
			                   4284 4293 4305 4309 4306 4300
			                   4214 4226 4242 4250 4248 4243
			                   4158 4170 4187 4194 4191 4187
			                   4103 4113 4133 4139 4136 4132
			                   4051 4072 4085 4088 4084 4080
			                   3953 3998 4029 4042 4038 4031
			                   3913 3930 3949 3977 3981 3986
			                   3873 3892 3910 3942 3946 3944
			                   3835 3857 3874 3892 3897 3896
			                   3815 3823 3842 3855 3856 3855
			                   3801 3806 3816 3829 3829 3829
			                   3786 3793 3795 3808 3808 3807
			                   3769 3780 3783 3790 3791 3790
			                   3753 3764 3772 3776 3774 3769
			                   3738 3746 3759 3761 3755 3743
			                   3725 3730 3740 3742 3734 3721
			                   3707 3715 3715 3710 3704 3692
			                   3689 3698 3695 3689 3682 3669
			                   3680 3694 3691 3687 3680 3668
			                   3671 3688 3688 3686 3679 3667
			                   3662 3684 3684 3684 3677 3665
			                   3647 3676 3676 3679 3673 3660
			                   3629 3662 3663 3666 3661 3644
			                   3601 3636 3637 3630 3630 3609
			                   3562 3592 3594 3576 3579 3558
			                   3500 3525 3531 3501 3510 3488
			                   3401 3423 3432 3391 3408 3386
			                   3200 3200 3200 3200 3200 3200
			                  >;
		};
};
