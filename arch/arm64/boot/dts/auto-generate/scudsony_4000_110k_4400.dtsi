/* DO NOT EDIT - Automatically generated by python */
/ {
		scudsony_4000_110k_4400:scudsony_4000_110k_4400 {
			fcc = <4000>;
			default_rbatt_mohm = <100>;
			id_identify_min = <2281>;
			id_identify_max = <2786>;
			id_voltage_min = <2426>;
			id_voltage_max = <2631>;
			vbat_max = <4400>;
			temp_para = 
						"-32767","0","-1","0","4100","0",
						"0","10","-1","1200","4400","3",
						"10","45","-1","-1","4400","3",
						"45","50","-1","1400","4400","3",
						"50","32767","-1","0","4400","0";
			vbat_para = 
						"-32767","3400","-1","820","0",
						"3400","32767","-1","-1","0";
			segment_para = 
						"-32767","4150","4000","4208","50",
						"4150","4450","2800","4400","0";
			batt_brand = "scudsony";
			fcc_temp = <3951 3975 3999 4041 4023 3997>;
			fcc_sf_x = <0 100 200 300 400 500>;
			fcc_sf_y = <100 96 94 92 90 88>;
			fcc_sf_cols = <6>;
			pc_sf_rows = <1>;
			pc_sf_cols = <1>;
			pc_sf_row_entries = <0>;
			pc_sf_percent = <100>;
			pc_sf_sf = <100>;
			rbatt_sf_rows = <28>;
			rbatt_sf_cols = <6>;
			rbatt_sf_percent = <100 95 90 85 80 75 70 65 60 55 50 45 40 35 30 25 20 15 10 9 8 7 6 5 4 3 2 1>;
			rbatt_sf_sf = <
			               1075 510 286 115 96 88
			               1075 510 286 115 96 88
			               1092 530 298 118 98 89
			               1088 542 311 123 100 91
			               1084 541 325 128 104 92
			               1118 557 333 135 107 94
			               1088 552 345 145 113 97
			               1110 519 313 154 121 102
			               1133 538 306 146 123 105
			               1152 552 306 127 106 94
			               1184 569 315 122 100 92
			               1215 585 325 124 102 93
			               1253 618 333 128 105 95
			               1327 656 353 132 109 98
			               1424 702 377 133 109 98
			               1564 754 407 130 105 95
			               1757 829 440 129 105 96
			               2028 962 487 131 105 96
			               3202 1189 504 130 106 97
			               3530 1318 519 130 105 97
			               3961 1463 551 132 107 98
			               4383 1627 600 137 108 99
			               4936 1831 659 140 108 99
			               5598 2119 708 137 108 97
			               6396 2448 803 139 108 98
			               7392 2953 953 144 110 101
			               8832 3757 1235 169 124 103
			               13890 5178 1779 325 218 203
			              >;
			pc_temp_ocv_rows = <29>;
			pc_temp_ocv_cols = <6>;
			pc_temp_ocv_percent = <100 95 90 85 80 75 70 65 60 55 50 45 40 35 30 25 20 15 10 9 8 7 6 5 4 3 2 1>;
			pc_temp_ocv_ocv = <
			                   4388 4386 4383 4376 4370 4363
			                   4309 4314 4315 4312 4308 4303
			                   4239 4252 4254 4252 4250 4246
			                   4171 4190 4194 4194 4192 4188
			                   4105 4128 4137 4137 4136 4133
			                   4054 4075 4080 4083 4082 4080
			                   3985 4019 4029 4033 4033 4031
			                   3933 3955 3967 3985 3987 3985
			                   3889 3913 3920 3935 3939 3939
			                   3849 3874 3880 3888 3890 3890
			                   3817 3840 3848 3854 3856 3855
			                   3788 3810 3820 3828 3829 3829
			                   3761 3790 3796 3806 3808 3807
			                   3740 3773 3780 3788 3791 3789
			                   3721 3759 3767 3771 3770 3765
			                   3705 3740 3752 3751 3746 3735
			                   3691 3715 3729 3730 3723 3711
			                   3673 3682 3691 3699 3693 3682
			                   3645 3649 3659 3673 3668 3658
			                   3633 3642 3654 3669 3665 3655
			                   3623 3636 3648 3665 3661 3650
			                   3608 3627 3642 3659 3655 3644
			                   3590 3614 3633 3648 3643 3630
			                   3567 3595 3614 3621 3616 3600
			                   3534 3558 3577 3578 3572 3556
			                   3485 3503 3522 3522 3516 3501
			                   3417 3430 3452 3449 3445 3431
			                   3324 3339 3364 3356 3351 3341
			                   3200 3200 3200 3200 3200 3200
			                  >;
		};
};
