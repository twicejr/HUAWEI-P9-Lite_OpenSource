/* DO NOT EDIT - Automatically generated by python */
/ {
		scudsony_4230_470k_4352:scudsony_4230_470k_4352 {
			fcc = <4230>;
			default_rbatt_mohm = <100>;
			id_identify_min = <3312>;
			id_identify_max = <3767>;
			id_voltage_min = <3457>;
			id_voltage_max = <3696>;
			vbat_max = <4352>;
			temp_para = 
						"-32767","0","-1","0","4100","0",
						"0","10","-1","1269","4352","3",
						"10","45","-1","-1","4352","3",
						"45","50","-1","1480","4352","3",
						"50","32767","-1","0","4352","0";
			vbat_para = 
						"-32767","3400","-1","820","0",
						"3400","32767","-1","-1","0";
			segment_para = 
						"-32767","4150","4230","4208","50",
						"4150","4450","2961","4352","0";
			batt_brand = "scudsony";
			fcc_temp = <4194 4229 4277 4361 4307 4249>;
			fcc_sf_x = <0 100 200 300 400 500>;
			fcc_sf_y = <100 96 94 92 90 88>;
			fcc_sf_cols = <6>;
			pc_sf_rows = <1>;
			pc_sf_cols = <1>;
			pc_sf_row_entries = <0>;
			pc_sf_percent = <100>;
			pc_sf_sf = <100>;
			rbatt_sf_rows = <28>;
			rbatt_sf_cols = <6>;
			rbatt_sf_percent = <100 95 90 85 80 75 70 65 60 55 50 45 40 35 30 25 20 15 10 9 8 7 6 5 4 3 2 1>;
			rbatt_sf_sf = <
			               832 377 208 101 85 80
			               832 377 208 101 85 80
			               818 395 225 107 88 81
			               819 379 237 113 92 83
			               830 373 246 119 95 85
			               851 377 247 127 99 87
			               871 389 220 136 104 89
			               884 399 214 140 111 95
			               915 405 216 125 113 98
			               928 414 220 106 93 84
			               944 422 229 104 88 83
			               958 432 236 107 89 83
			               1026 440 241 110 92 84
			               1090 447 246 113 95 86
			               1161 460 254 114 95 84
			               1261 469 264 111 89 83
			               1406 460 261 107 88 83
			               1626 521 253 104 87 82
			               2139 671 261 103 87 83
			               2093 593 263 104 88 84
			               1661 618 269 104 88 84
			               1799 647 278 107 90 83
			               1992 678 291 107 90 83
			               2287 705 296 107 87 81
			               2658 746 304 105 87 81
			               3498 880 328 106 89 83
			               5073 1189 399 107 92 84
			               9013 1936 534 106 96 88
			              >;
			pc_temp_ocv_rows = <29>;
			pc_temp_ocv_cols = <6>;
			pc_temp_ocv_percent = <100 95 90 85 80 75 70 65 60 55 50 45 40 35 30 25 20 15 10 9 8 7 6 5 4 3 2 1>;
			pc_temp_ocv_ocv = <
			                   4339 4337 4334 4329 4320 4310
			                   4258 4264 4265 4265 4257 4250
			                   4188 4206 4207 4208 4201 4195
			                   4128 4140 4152 4153 4147 4142
			                   4072 4082 4099 4100 4095 4091
			                   4019 4030 4046 4051 4047 4043
			                   3969 3983 3987 4006 4003 4000
			                   3923 3940 3941 3961 3962 3961
			                   3885 3900 3902 3914 3920 3920
			                   3850 3866 3869 3873 3874 3873
			                   3816 3837 3841 3843 3844 3844
			                   3779 3813 3817 3821 3821 3821
			                   3758 3792 3797 3802 3803 3802
			                   3742 3774 3780 3786 3787 3785
			                   3730 3761 3767 3771 3770 3764
			                   3717 3745 3756 3754 3747 3735
			                   3705 3714 3736 3732 3723 3712
			                   3688 3695 3705 3701 3694 3682
			                   3663 3674 3674 3675 3669 3658
			                   3658 3670 3670 3672 3666 3656
			                   3649 3663 3665 3667 3662 3652
			                   3638 3655 3659 3662 3657 3646
			                   3621 3643 3649 3652 3644 3631
			                   3600 3621 3629 3630 3615 3601
			                   3564 3581 3589 3589 3571 3558
			                   3517 3525 3534 3536 3516 3504
			                   3448 3451 3466 3466 3446 3435
			                   3344 3354 3370 3366 3350 3343
			                   3200 3200 3200 3200 3200 3200
			                  >;
		};
};
