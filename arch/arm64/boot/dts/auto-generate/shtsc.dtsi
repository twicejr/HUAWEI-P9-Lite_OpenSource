/* Copyright (c) 2013, The Linux Foundation. All rights reserved.
 *
 * This program is free software; you can redistribute it and/or modify
 * it under the terms of the GNU General Public License version 2 and
 * only version 2 as published by the Free Software Foundation.
 *
 * This program is distributed in the hope that it will be useful,
 * but WITHOUT ANY WARRANTY; without even the implied warranty of
 * MERCHANTABILITY or FITNESS FOR A PARTICULAR PURPOSE.  See the
 * GNU General Public License for more details.
 */
/ {
	amba{
		i2c2: i2c@FFD73000 { // for 5.5" FHD
			shtsc@18 {
				compatible = "sharp,shtsc_i2c";
				status = "disabled";
				reg = <0x18>;
				vdd-supply = <&ldo17>;
				vcc_i2c-supply = <&ldo4>;
				sharp,reset-gpio = <&gpio24 7 0>;
				sharp,irq-gpio = <&gpio24 0 0>;
				sharp,panel-coords = <0 0 1439 2559>; // depends on an LCD resolution (0 0 Xmax-1 Ymax-1)
				sharp,display-coords = <0 0 1439 2559>; // depends on an LCD resolution (0 0 Xmax-1 Ymax-1)
				sharp,i2c-pull-up;
				ts_touch_num_max = <10>;
				ts_pressure_max = <65535>;
				ts_flip_x = <0>;
				ts_flip_y = <0>;
				ts_swap_xy = <0>;
			};
		};
	};
};