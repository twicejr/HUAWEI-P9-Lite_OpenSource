/* DO NOT EDIT - Automatically generated by python */
/ {
		sunwodaatl_4000_200k_4400:sunwodaatl_4000_200k_4400 {
			fcc = <4000>;
			default_rbatt_mohm = <100>;
			id_identify_min = <2786>;
			id_identify_max = <3312>;
			id_voltage_min = <2941>;
			id_voltage_max = <3167>;
			vbat_max = <4400>;
			temp_para = 
						"-32767","0","-1","0","4100","0",
						"0","10","-1","1200","4400","3",
						"10","45","-1","-1","4400","3",
						"45","50","-1","1400","4400","3",
						"50","32767","-1","0","4400","0";
			vbat_para = 
						"-32767","3400","-1","820","0",
						"3400","32767","-1","-1","0";
			segment_para = 
						"-32767","4150","4000","4208","50",
						"4150","4450","2800","4400","0";
			batt_brand = "sunwodaatl";
			fcc_temp = <4009 4007 4009 4027 4014 3979>;
			fcc_sf_x = <0 100 200 300 400 500>;
			fcc_sf_y = <100 96 94 92 90 88>;
			fcc_sf_cols = <6>;
			pc_sf_rows = <1>;
			pc_sf_cols = <1>;
			pc_sf_row_entries = <0>;
			pc_sf_percent = <100>;
			pc_sf_sf = <100>;
			rbatt_sf_rows = <28>;
			rbatt_sf_cols = <6>;
			rbatt_sf_percent = <100 95 90 85 80 75 70 65 60 55 50 45 40 35 30 25 20 15 10 9 8 7 6 5 4 3 2 1>;
			rbatt_sf_sf = <
			               1825 1047 443 125 97 87
			               1821 1046 443 125 97 87
			               1661 1029 444 128 98 87
			               1544 989 440 132 100 88
			               1456 952 442 137 103 90
			               1401 939 447 143 107 92
			               1267 855 451 154 111 95
			               1256 804 393 162 118 100
			               1240 799 391 156 120 102
			               1234 788 376 126 101 90
			               1248 785 373 122 96 88
			               1284 810 376 124 98 88
			               1331 854 384 128 102 91
			               1397 914 406 132 106 94
			               1486 995 442 133 105 94
			               1582 1085 494 128 98 88
			               1689 1178 564 126 98 88
			               1816 1277 649 128 98 87
			               2429 1139 521 122 97 87
			               2593 1217 544 123 97 89
			               2826 1303 569 123 97 91
			               3026 1423 615 127 100 92
			               3244 1554 683 129 100 92
			               3484 1695 747 125 98 90
			               3720 1828 800 129 98 89
			               4084 1979 826 132 99 92
			               4488 2260 956 139 101 92
			               5234 2723 1170 188 112 94
			              >;
			pc_temp_ocv_rows = <29>;
			pc_temp_ocv_cols = <6>;
			pc_temp_ocv_percent = <100 95 90 85 80 75 70 65 60 55 50 45 40 35 30 25 20 15 10 9 8 7 6 5 4 3 2 1>;
			pc_temp_ocv_ocv = <
			                   4390 4386 4384 4375 4369 4362
			                   4287 4300 4309 4313 4309 4302
			                   4212 4231 4246 4254 4251 4244
			                   4152 4169 4187 4196 4193 4187
			                   4096 4112 4133 4139 4137 4132
			                   4043 4064 4080 4085 4083 4079
			                   3959 3993 4027 4036 4033 4030
			                   3918 3935 3957 3985 3987 3984
			                   3878 3895 3916 3939 3940 3939
			                   3844 3858 3876 3887 3889 3887
			                   3820 3827 3843 3853 3854 3853
			                   3804 3808 3817 3828 3828 3827
			                   3789 3795 3797 3807 3808 3806
			                   3774 3782 3784 3789 3790 3788
			                   3761 3770 3773 3773 3772 3767
			                   3748 3755 3761 3756 3749 3738
			                   3732 3737 3743 3737 3729 3716
			                   3714 3717 3719 3710 3704 3691
			                   3689 3694 3692 3688 3681 3670
			                   3680 3688 3688 3687 3680 3668
			                   3673 3682 3684 3685 3678 3667
			                   3664 3676 3679 3682 3675 3664
			                   3651 3667 3672 3675 3670 3658
			                   3633 3652 3658 3654 3653 3639
			                   3603 3624 3630 3613 3615 3601
			                   3562 3577 3582 3558 3563 3551
			                   3498 3509 3514 3484 3495 3484
			                   3402 3410 3414 3372 3393 3386
			                   3200 3200 3200 3200 3200 3200
			                  >;
		};
};
