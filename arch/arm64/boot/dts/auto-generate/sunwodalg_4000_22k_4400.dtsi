/* DO NOT EDIT - Automatically generated by python */
/ {
		sunwodalg_4000_22k_4400:sunwodalg_4000_22k_4400 {
			fcc = <4000>;
			default_rbatt_mohm = <100>;
			id_identify_min = <751>;
			id_identify_max = <1235>;
			id_voltage_min = <949>;
			id_voltage_max = <1051>;
			vbat_max = <4400>;
			temp_para = 
						"-32767","0","-1","0","4100","0",
						"0","10","-1","1200","4400","3",
						"10","45","-1","-1","4400","3",
						"45","50","-1","1400","4400","3",
						"50","32767","-1","0","4400","0";
			vbat_para = 
						"-32767","3400","-1","820","0",
						"3400","32767","-1","-1","0";
			segment_para = 
						"-32767","4150","4000","4208","50",
						"4150","4450","2800","4400","0";
			batt_brand = "sunwodalg";
			fcc_temp = <3977 3978 3978 4003 3989 3959>;
			fcc_sf_x = <0 100 200 300 400 500>;
			fcc_sf_y = <100 96 94 92 90 88>;
			fcc_sf_cols = <6>;
			pc_sf_rows = <1>;
			pc_sf_cols = <1>;
			pc_sf_row_entries = <0>;
			pc_sf_percent = <100>;
			pc_sf_sf = <100>;
			rbatt_sf_rows = <28>;
			rbatt_sf_cols = <6>;
			rbatt_sf_percent = <100 95 90 85 80 75 70 65 60 55 50 45 40 35 30 25 20 15 10 9 8 7 6 5 4 3 2 1>;
			rbatt_sf_sf = <
			               1705 952 411 101 75 65
			               1703 952 411 101 75 65
			               1585 932 416 103 77 66
			               1496 920 413 105 78 67
			               1460 907 423 110 81 69
			               1447 942 449 118 85 70
			               1283 860 478 131 92 74
			               1284 773 385 134 96 77
			               1278 779 378 135 102 83
			               1285 769 367 111 88 74
			               1307 773 364 101 76 66
			               1357 800 365 102 78 68
			               1417 850 372 104 81 71
			               1488 908 395 109 84 74
			               1575 982 432 110 83 73
			               1686 1070 477 107 78 67
			               1830 1181 535 103 76 66
			               1993 1338 630 103 76 66
			               2843 1255 545 104 79 68
			               3065 1339 578 104 79 68
			               3262 1455 623 104 79 68
			               3463 1567 679 105 79 67
			               3633 1682 734 105 79 68
			               3867 1797 785 106 78 68
			               4078 1890 822 113 81 69
			               4349 2026 866 130 84 71
			               4666 2194 925 264 93 76
			               5105 2454 1067 279 155 94
			              >;
			pc_temp_ocv_rows = <29>;
			pc_temp_ocv_cols = <6>;
			pc_temp_ocv_percent = <100 95 90 85 80 75 70 65 60 55 50 45 40 35 30 25 20 15 10 9 8 7 6 5 4 3 2 1>;
			pc_temp_ocv_ocv = <
			                   4394 4391 4389 4378 4371 4364
			                   4292 4301 4309 4320 4315 4308
			                   4221 4231 4248 4262 4257 4252
			                   4158 4173 4190 4206 4201 4196
			                   4108 4117 4137 4152 4146 4142
			                   4064 4080 4089 4101 4094 4089
			                   3963 4005 4036 4057 4048 4040
			                   3922 3931 3952 3988 3991 3995
			                   3883 3896 3913 3946 3952 3951
			                   3851 3861 3876 3898 3900 3900
			                   3826 3832 3845 3861 3861 3861
			                   3810 3812 3819 3834 3834 3833
			                   3793 3798 3799 3812 3812 3812
			                   3776 3784 3784 3794 3794 3793
			                   3757 3769 3770 3778 3775 3771
			                   3740 3753 3754 3760 3754 3744
			                   3722 3735 3735 3737 3731 3719
			                   3702 3717 3716 3706 3700 3689
			                   3678 3696 3695 3688 3680 3669
			                   3671 3688 3690 3687 3679 3668
			                   3663 3680 3683 3685 3678 3667
			                   3654 3671 3673 3681 3674 3663
			                   3640 3659 3658 3668 3666 3653
			                   3622 3643 3637 3637 3641 3628
			                   3593 3615 3605 3591 3600 3587
			                   3553 3573 3562 3533 3546 3535
			                   3491 3507 3498 3462 3475 3466
			                   3395 3405 3400 3355 3376 3366
			                   3200 3200 3200 3200 3200 3200
			                  >;
		};
};
