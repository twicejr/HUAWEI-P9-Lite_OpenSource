/* DO NOT EDIT - Automatically generated by python */
/ {
		sunwodalg_4230_110k_4352:sunwodalg_4230_110k_4352 {
			fcc = <4230>;
			default_rbatt_mohm = <100>;
			id_identify_min = <2281>;
			id_identify_max = <2786>;
			id_voltage_min = <2426>;
			id_voltage_max = <2631>;
			vbat_max = <4352>;
			temp_para = 
						"-32767","0","-1","0","4100","0",
						"0","10","-1","1269","4352","3",
						"10","45","-1","-1","4352","3",
						"45","50","-1","1480","4352","3",
						"50","32767","-1","0","4352","0";
			vbat_para = 
						"-32767","3400","-1","820","0",
						"3400","32767","-1","-1","0";
			segment_para = 
						"-32767","4150","4230","4208","50",
						"4150","4450","2961","4352","0";
			batt_brand = "sunwodalg";
			fcc_temp = <4340 4339 4336 4365 4353 4314>;
			fcc_sf_x = <0 100 200 300 400 500>;
			fcc_sf_y = <100 96 94 92 90 88>;
			fcc_sf_cols = <6>;
			pc_sf_rows = <1>;
			pc_sf_cols = <1>;
			pc_sf_row_entries = <0>;
			pc_sf_percent = <100>;
			pc_sf_sf = <100>;
			rbatt_sf_rows = <28>;
			rbatt_sf_cols = <6>;
			rbatt_sf_percent = <100 95 90 85 80 75 70 65 60 55 50 45 40 35 30 25 20 15 10 9 8 7 6 5 4 3 2 1>;
			rbatt_sf_sf = <
			               1667 1021 500 113 89 80
			               1664 1019 500 113 89 80
			               1539 963 496 115 92 81
			               1478 924 491 118 93 82
			               1408 921 512 122 96 84
			               1370 865 498 127 98 86
			               1362 861 493 134 103 88
			               1354 850 487 146 110 92
			               1379 848 471 142 113 95
			               1417 866 471 118 100 87
			               1463 909 493 114 91 82
			               1519 958 532 117 93 83
			               1585 1013 581 120 97 86
			               1661 1079 642 124 101 89
			               1751 1155 714 127 100 89
			               1861 1236 793 129 95 84
			               2007 1328 881 131 94 83
			               2209 1444 998 136 95 83
			               4572 2321 1192 135 97 86
			               4951 2563 1315 139 98 85
			               5353 2793 1452 143 98 84
			               5763 3034 1619 149 100 86
			               6171 3289 1784 157 100 85
			               6574 3535 1917 163 99 85
			               7038 3784 2051 164 102 87
			               7499 4075 2254 178 105 89
			               8058 4476 2561 224 110 91
			               9319 5034 3006 407 143 98
			              >;
			pc_temp_ocv_rows = <29>;
			pc_temp_ocv_cols = <6>;
			pc_temp_ocv_percent = <100 95 90 85 80 75 70 65 60 55 50 45 40 35 30 25 20 15 10 9 8 7 6 5 4 3 2 1>;
			pc_temp_ocv_ocv = <
			                   4337 4335 4334 4328 4319 4311
			                   4231 4239 4248 4264 4259 4253
			                   4157 4168 4181 4207 4204 4199
			                   4098 4107 4121 4154 4150 4146
			                   4027 4058 4073 4102 4099 4095
			                   3966 3989 4014 4055 4051 4047
			                   3920 3943 3963 4007 4006 4003
			                   3876 3897 3917 3966 3966 3963
			                   3849 3857 3872 3919 3923 3923
			                   3828 3829 3836 3872 3876 3875
			                   3812 3813 3813 3841 3842 3842
			                   3797 3801 3799 3817 3819 3819
			                   3783 3789 3788 3798 3800 3800
			                   3770 3777 3778 3782 3784 3783
			                   3755 3764 3766 3770 3767 3763
			                   3740 3748 3750 3755 3749 3737
			                   3724 3728 3727 3731 3725 3712
			                   3700 3706 3702 3698 3694 3683
			                   3669 3678 3675 3681 3675 3665
			                   3658 3672 3667 3678 3674 3663
			                   3648 3665 3658 3675 3672 3661
			                   3636 3655 3647 3668 3668 3657
			                   3619 3639 3633 3654 3659 3646
			                   3593 3616 3609 3623 3632 3616
			                   3560 3580 3575 3575 3588 3574
			                   3513 3528 3526 3514 3533 3520
			                   3447 3460 3458 3434 3459 3451
			                   3351 3365 3363 3329 3359 3355
			                   3200 3200 3200 3200 3200 3200
			                  >;
		};
};
