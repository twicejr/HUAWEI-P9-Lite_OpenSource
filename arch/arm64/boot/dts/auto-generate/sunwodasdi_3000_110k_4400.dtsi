/* DO NOT EDIT - Automatically generated by python */
/ {
		sunwodasdi_3000_110k_4400:sunwodasdi_3000_110k_4400 {
			fcc = <3000>;
			default_rbatt_mohm = <100>;
			id_identify_min = <2281>;
			id_identify_max = <2786>;
			id_voltage_min = <2426>;
			id_voltage_max = <2631>;
			vbat_max = <4400>;
			temp_para = 
						"-32767","0","-1","0","4100","0",
						"0","10","-1","900","4400","3",
						"10","45","-1","-1","4400","3",
						"45","50","-1","1050","4400","3",
						"50","32767","-1","0","4400","0";
			vbat_para = 
						"-32767","3400","-1","820","0",
						"3400","32767","-1","-1","0";
			segment_para = 
						"-32767","4150","3000","4208","50",
						"4150","4450","2100","4400","0";
			batt_brand = "sunwodasdi";
			fcc_temp = <3004 2999 2994 3030 3017 2989>;
			fcc_sf_x = <0 100 200 300 400 500>;
			fcc_sf_y = <100 96 94 92 90 88>;
			fcc_sf_cols = <6>;
			pc_sf_rows = <1>;
			pc_sf_cols = <1>;
			pc_sf_row_entries = <0>;
			pc_sf_percent = <100>;
			pc_sf_sf = <100>;
			rbatt_sf_rows = <28>;
			rbatt_sf_cols = <6>;
			rbatt_sf_percent = <100 95 90 85 80 75 70 65 60 55 50 45 40 35 30 25 20 15 10 9 8 7 6 5 4 3 2 1>;
			rbatt_sf_sf = <
			               2069 1471 886 156 119 107
			               2068 1471 886 156 119 107
			               1868 1360 873 160 122 109
			               1728 1249 857 163 125 110
			               1712 1177 819 171 130 113
			               1675 1179 854 178 135 117
			               1423 997 725 198 147 121
			               1414 903 668 196 150 126
			               1408 901 635 217 159 134
			               1427 894 590 169 145 123
			               1509 878 576 150 120 108
			               1599 952 575 153 122 110
			               1691 1046 646 157 128 115
			               1779 1154 738 164 135 120
			               1858 1254 852 167 135 121
			               1968 1323 956 163 125 112
			               2149 1386 1025 156 122 109
			               2462 1520 1108 157 124 110
			               3023 1746 1168 160 126 110
			               3423 1644 850 157 126 114
			               3656 1601 864 155 126 115
			               3888 1710 943 158 126 113
			               4078 1852 1033 159 127 114
			               4275 1929 1123 158 123 109
			               4529 2018 1179 159 124 111
			               4712 2146 1186 163 125 115
			               4981 2256 1261 169 131 114
			               5421 2538 1389 272 136 118
			              >;
			pc_temp_ocv_rows = <29>;
			pc_temp_ocv_cols = <6>;
			pc_temp_ocv_percent = <100 95 90 85 80 75 70 65 60 55 50 45 40 35 30 25 20 15 10 9 8 7 6 5 4 3 2 1>;
			pc_temp_ocv_ocv = <
			                   4383 4378 4374 4369 4362 4354
			                   4271 4281 4286 4305 4301 4296
			                   4200 4217 4221 4248 4244 4239
			                   4139 4161 4166 4193 4189 4184
			                   4103 4111 4110 4139 4135 4131
			                   4062 4079 4078 4088 4083 4080
			                   3951 3992 4002 4048 4041 4033
			                   3905 3927 3948 3978 3984 3989
			                   3864 3890 3907 3949 3950 3949
			                   3832 3858 3869 3895 3900 3898
			                   3816 3821 3837 3857 3858 3857
			                   3803 3806 3807 3831 3831 3831
			                   3787 3796 3794 3810 3810 3810
			                   3767 3784 3785 3793 3793 3792
			                   3744 3767 3774 3778 3776 3774
			                   3726 3741 3760 3762 3755 3744
			                   3711 3718 3734 3741 3733 3721
			                   3698 3708 3713 3712 3705 3692
			                   3681 3700 3697 3688 3680 3669
			                   3675 3698 3695 3687 3679 3668
			                   3666 3694 3689 3685 3677 3666
			                   3657 3686 3685 3682 3675 3664
			                   3643 3677 3680 3677 3671 3660
			                   3625 3660 3670 3659 3659 3646
			                   3602 3634 3647 3620 3623 3608
			                   3564 3594 3605 3563 3571 3557
			                   3508 3530 3539 3482 3500 3486
			                   3417 3432 3437 3359 3394 3383
			                   3200 3200 3200 3200 3200 3200
			                  >;
		};
};
