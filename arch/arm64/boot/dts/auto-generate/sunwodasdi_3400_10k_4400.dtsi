/* DO NOT EDIT - Automatically generated by python */
/ {
		sunwodasdi_3400_10k_4400:sunwodasdi_3400_10k_4400 {
			fcc = <3400>;
			default_rbatt_mohm = <100>;
			id_identify_min = <0>;
			id_identify_max = <751>;
			id_voltage_min = <496>;
			id_voltage_max = <553>;
			vbat_max = <4400>;
			temp_para = 
						"-32767","0","-1","0","4100","0",
						"0","10","-1","1020","4400","3",
						"10","45","-1","-1","4400","3",
						"45","50","-1","1190","4400","3",
						"50","32767","-1","0","4400","0";
			vbat_para = 
						"-32767","3400","-1","820","0",
						"3400","32767","-1","-1","0";
			segment_para = 
						"-32767","4150","3400","4208","50",
						"4150","4450","2380","4400","0";
			batt_brand = "sunwodasdi";
			fcc_temp = <3485 3483 3480 3493 3480 3459>;
			fcc_sf_x = <0 100 200 300 400 500>;
			fcc_sf_y = <100 96 94 92 90 88>;
			fcc_sf_cols = <6>;
			pc_sf_rows = <1>;
			pc_sf_cols = <1>;
			pc_sf_row_entries = <0>;
			pc_sf_percent = <100>;
			pc_sf_sf = <100>;
			rbatt_sf_rows = <28>;
			rbatt_sf_cols = <6>;
			rbatt_sf_percent = <100 95 90 85 80 75 70 65 60 55 50 45 40 35 30 25 20 15 10 9 8 7 6 5 4 3 2 1>;
			rbatt_sf_sf = <
			               2002 1250 638 155 108 95
			               1998 1249 638 155 108 95
			               1864 1223 638 155 108 95
			               1757 1182 627 157 109 95
			               1689 1141 638 161 111 97
			               1628 1144 676 170 115 98
			               1421 993 643 189 125 100
			               1415 915 549 188 125 105
			               1402 916 537 199 136 110
			               1411 900 513 162 128 110
			               1479 901 500 145 106 96
			               1546 977 498 145 106 95
			               1615 1054 540 149 109 97
			               1689 1138 616 151 114 100
			               1775 1219 703 154 115 101
			               1881 1295 790 152 109 95
			               2010 1382 877 151 107 96
			               2172 1513 988 154 107 96
			               3212 1492 849 145 109 97
			               3384 1601 896 148 109 99
			               3606 1725 969 150 110 100
			               3787 1872 1097 152 111 101
			               3954 2018 1202 155 114 103
			               4175 2115 1275 156 112 99
			               4464 2258 1320 158 110 98
			               4784 2424 1381 166 110 98
			               5078 2659 1524 229 120 100
			               5676 3145 1810 519 201 132
			              >;
			pc_temp_ocv_rows = <29>;
			pc_temp_ocv_cols = <6>;
			pc_temp_ocv_percent = <100 95 90 85 80 75 70 65 60 55 50 45 40 35 30 25 20 15 10 9 8 7 6 5 4 3 2 1>;
			pc_temp_ocv_ocv = <
			                   4400 4397 4394 4382 4375 4368
			                   4284 4296 4305 4316 4313 4309
			                   4210 4226 4242 4257 4255 4251
			                   4153 4167 4183 4200 4197 4194
			                   4105 4113 4131 4146 4142 4139
			                   4055 4074 4087 4094 4090 4086
			                   3952 3989 4025 4049 4044 4037
			                   3911 3926 3948 3980 3986 3993
			                   3870 3891 3908 3945 3951 3950
			                   3835 3854 3870 3896 3903 3902
			                   3818 3822 3838 3858 3860 3860
			                   3801 3808 3810 3831 3832 3832
			                   3784 3794 3794 3809 3811 3810
			                   3766 3779 3783 3791 3793 3792
			                   3750 3763 3772 3776 3776 3772
			                   3737 3745 3758 3760 3755 3744
			                   3724 3729 3739 3741 3734 3721
			                   3708 3717 3718 3711 3705 3694
			                   3686 3702 3697 3688 3681 3669
			                   3677 3697 3692 3687 3680 3668
			                   3669 3691 3686 3685 3678 3667
			                   3658 3686 3682 3683 3676 3665
			                   3641 3678 3675 3679 3672 3661
			                   3620 3661 3660 3664 3661 3648
			                   3593 3633 3635 3626 3628 3611
			                   3558 3589 3594 3570 3576 3560
			                   3503 3525 3532 3496 3506 3490
			                   3420 3439 3437 3400 3406 3388
			                   3200 3200 3200 3200 3200 3200
			                  >;
		};
};
