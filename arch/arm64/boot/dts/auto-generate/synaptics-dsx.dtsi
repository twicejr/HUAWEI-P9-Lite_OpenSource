/* Copyright (C) 2014 Synaptics Incorporated
 *
 * Copyright (C) 2014 Alexandra Chin <alexandra.chin@tw.synaptics.com>
 * Copyright (C) 2014 Scott Lin <scott.lin@tw.synaptics.com>
 *
 * This program is free software; you can redistribute it and/or modify
 * it under the terms of the GNU General Public License as published by
 * the Free Software Foundation; either version 2 of the License, or
 * (at your option) any later version.
 *
 * This program is distributed in the hope that it will be useful,
 * but WITHOUT ANY WARRANTY; without even the implied warranty of
 * MERCHANTABILITY or FITNESS FOR A PARTICULAR PURPOSE. See the
 * GNU General Public License for more details.
 */

/{
	amba {
		i2c2: i2c@FFD73000 {
			synaptics_dsx@20 {
				compatible = "synaptics,dsx";
				status = "disabled";
				reg = <0x20>;
				vdd_ana-supply = <&ldo17>;
				vcc_i2c-supply = <&ldo4>;
				synaptics,pwr-reg-name = "vdd_ana";
				synaptics,bus-reg-name = "vcc_i2c";
				synaptics,irq-gpio = <&gpio24 0 0>;
				/*synaptics,reset-gpio = <&gpio10 4 0>;*/
				synaptics,reset-active-ms = <100>;
				synaptics,reset-on-state = <1>;
				synaptics,irq-on-state = <0>;
				synaptics,irq-flags = <0x2002>; /* IRQF_ONESHOT | IRQF_TRIGGER_FALLING */
				synaptics,power-delay-ms = <160>;
				synaptics,reset-delay-ms = <100>;
				/*synaptics,max-y-for-2d = <800>; *//* remove if no virtual buttons */
				/*synaptics,vir-button-codes = <102 100 900 100 60 158 300 900 100 60>;*/
				synaptics,cap-button-codes = <0 0>;
			};
		};
	};
};
