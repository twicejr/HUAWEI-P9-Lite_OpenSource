## drivers/gpu/arm/r6p0-01dev0/platform/Kconfig
```kconfig
#
# (C) COPYRIGHT 2012 ARM Limited. All rights reserved.
#
# This program is free software and is provided to you under the terms of the
# GNU General Public License version 2 as published by the Free Software
# Foundation, and any use by you of this program is subject to the terms
# of such GNU licence.
#
# A copy of the licence is included with the program, and can also be obtained
# from Free Software Foundation, Inc., 51 Franklin Street, Fifth Floor,
# Boston, MA  02110-1301, USA.
#
#




# Add your platform specific Kconfig file here
#
# "drivers/gpu/arm/midgard/platform/xxx/Kconfig"
#
# Where xxx is the platform name is the name set in MALI_PLATFORM_THIRDPARTY_NAME
#

if ARCH_HI6250
source "drivers/gpu/arm/malit6_64/r6p0-01dev0/platform/hi6250/Kconfig"
endif
```

## drivers/hisi/Kconfig
```kconfig
menuconfig HISILICON_PLATFORM
	bool "Hisilicon platform support"
	default n
	help
	  Say yes here to support the hisilicon platform


if HISILICON_PLATFORM

source "drivers/hisi/adc/Kconfig"
source "drivers/hisi/ddrc/Kconfig"
source "drivers/hisi/hifidsp/Kconfig"
source "drivers/hisi/soundtrigger/Kconfig"
source "drivers/hisi/hi6xxx/Kconfig"
source "drivers/hisi/efuse/Kconfig"
source "drivers/hisi/mntn/Kconfig"
source "drivers/hisi/modem/Kconfig"
source "drivers/hisi/hifi_mailbox/Kconfig"
source "drivers/hisi/mailbox/Kconfig"
source "drivers/hisi/mutex_service/Kconfig"
source "drivers/hisi/noc/Kconfig"
source "drivers/hisi/socp/Kconfig"
source "drivers/hisi/tele_mntn/Kconfig"
source "drivers/hisi/mcushell/Kconfig"
source "drivers/hisi/hi3xxx/Kconfig"
source "drivers/hisi/axi/Kconfig"
source "drivers/hisi/hi6421_spk/Kconfig"
source "drivers/hisi/perf_stat/Kconfig"
source "drivers/hisi/hi64xx/Kconfig"
source "drivers/hisi/hi6402dsp/Kconfig"
source "drivers/hisi/slimbus/Kconfig"
source "drivers/hisi/pm_common/Kconfig"
source "drivers/hisi/watchpoint/Kconfig"
source "drivers/hisi/misc/Kconfig"
source "drivers/hisi/hmpthresholds/Kconfig"
source "drivers/hisi/memory_dump/Kconfig"
source "drivers/hisi/exmbist/Kconfig"
source "drivers/hisi/ivp/Kconfig"
source "drivers/hisi/hiperfdump/Kconfig"
source "drivers/hisi/flp/Kconfig"
source "drivers/hisi/fpga_touchscreen/Kconfig"
source "drivers/hisi/load_image/Kconfig"
source "drivers/hisi/perfhub/Kconfig"
source "drivers/hisi/freqdump/Kconfig"
endif #HISILICON_PLATFORM

if HISI_BALONG_MODEM_HI3XXX
source "drivers/hisi/efuse/Kconfig"
endif

source "drivers/hisi/hilog/Kconfig"

source "drivers/hisi/tzdriver/Kconfig"
source "drivers/hisi/cci_extra/Kconfig"
```

## drivers/hisi/adc/Kconfig
```kconfig
config HISILICON_PLATFORM_ADC
	bool "HISILICON PLATFORM ADC"
	default n

if HISILICON_PLATFORM_ADC
config HISI_HKADC
	bool "HISI ADC support"
	depends on HISI_MAILBOX
	default n
	help
	  Say yes here to support the HISI ADC device

config HISI_HKADC_DEBUG
	tristate "HISI ADC DEBUG"
	help
	  Say yes here to support this lock
endif
```

## drivers/hisi/axi/Kconfig
```kconfig
config HISI_AXI
	bool "Hisilicon axierr irq"
	default n
	help
	Hi3635 axierr irq support
```

## drivers/hisi/cci_extra/Kconfig
```kconfig
config HISI_CCI_EXTRA
	bool "Hisilicon CCI Extra Configuration Driver"
	default n
	select ARM_CCI
	help
	Hisilicon CCI Extra Configuration Driver support

config HISI_CCI_EXTRA_PMU
	bool "Hisilicon CCI Extra PMU Driver"
	default n
	select ARM_CCI
	help
	Hisilicon CCI Extra PMU support
```

## drivers/hisi/ddrc/Kconfig
```kconfig
config HISILICON_PLATFORM_DDRC
	bool "Hisilicon platform ddr controller support"
	default n
	help
	  Say yes here to support the hisilicon platform ddr controller

config HISI_DDRC_FLUX
	bool "Hisi ddr bandwith statstic "
       depends on ARCH_HI3650
       default n

config HI6250_DDRC_FLUX
        bool "Hisi ddr bandwith statstic "
       depends on ARCH_HI6250
       default n

config HI3660_DDRC_FLUX
    bool "Hisi ddr bandwith statstic "
        default n
       
config HISI_DDRC_SEC
       bool "hisi ddr secprotect"
       default n
```

## drivers/hisi/efuse/Kconfig
```kconfig
config HI6XXX_EFUSE
	bool "Support HiSilicon Hi6XXX EFUSE"
	default n
	help
	  This driver supports HiSilicon Kirin620 EFUSE,
	  including hisilicon efuse, etc.

config HI3XXX_EFUSE
	bool "Support Hisilicon Hi3XXX efuse"
    depends on ATFDRIVER
	default n
	help
	Hi3630 efuse driver support
```

## drivers/hisi/exmbist/Kconfig
```kconfig
config HISI_EXMBIST
	bool "hisi exmbist for DDR test"
	default n
	help
		User exmbist IP to verify DDR.
```

## drivers/hisi/flp/Kconfig
```kconfig
#
# FLP driver configuration
#

menu "HISI FLP configuration"

config HISI_FLP
	bool "HISI FLP support"
	default n
	---help---
	  Enable support for FLP driver

endmenu
```

## drivers/hisi/fpga_touchscreen/Kconfig
```kconfig
#
# huawei touchscreen driver configuration
#

config HISI_FPGA_TS
	bool "hisi_fpga touchscreen"
	default n
	help
	  If you say yes here you get support for hisi_fpga touchscreen.

config HISI_FPGA_TS_TEST
	bool "hisi_fpga touchscreen test"
	default n
	help
	  If you say yes here you get support for hisi_fpga touchscreen.

source "drivers/huawei_platform/touthscreen/panel/Kconfig"
source "drivers/huawei_platform/touthscreen/panel/cyttsp5/Kconfig"

#sensor unification for differ platform
menu "huawei linux device driver support package"
config HISI_FPGA_TP_COLOR_INFO
	bool "hisi_fpga tp color info"
	default n
	help
		get the hisi_fpga tp color information.
endmenu
```

## drivers/hisi/fpga_touchscreen/panel/Kconfig
```kconfig
#
# huawei touchscreen driver configuration
#

config SYNAPTICS_TS
	bool "synaptics touchscreen"
	default n
	help
	  If you say yes here you get support for synaptics touchscreen.
config SYNAPTICS_LCD_TYPE
	bool "synaptics touchscreen"
	default n
	help
	  If you say yes here you get support for synaptics touchscreen.
config CYPRESS_TS
	bool "cypress touchscreen"
	default n
	help
	  If you say yes here you get support for cypress touchscreen.
```

## drivers/hisi/freqdump/Kconfig
```kconfig
#
#Hisilicon freqdump support.
#
comment "kernel/driver/hisi/freqdump/freqdump_kernel.c"
config HISILICON_FREQDUMP
	bool "Hisilicon freqdump"
	default y
	help
	  Driver for kernel freqdump
```

## drivers/hisi/hi3xxx/Kconfig
```kconfig
config HISILICON_PLATFORM_HI3XXX
	bool "HISILICON PLATFORM HI3XXX"
	default n

if HISILICON_PLATFORM_HI3XXX
comment "kernel/driver/hisi/hi3xxx/irq_affinity_debugfs.c"
config HI3XXX_IRQ_AFFINITY
	bool "Hisilicon irq affinity"
	depends on SMP
	default n
	help
	  Driver for irq affinity recovery in smp system

comment "kernel/driver/hisi/hi3xxx/irq_affinity_debugfs.c"
config HI3XXX_IRQ_AFFINITY_DEBUGFS
	bool "Hisilicon irq affinity debugfs"
	depends on HI3XXX_IRQ_AFFINITY
	default n
	help
	  Debug code for HISI irq affinity recovery in smp system

config HI3XXX_POWER_OFF
	bool "Hisilicon hi3xxx platform power off and reset driver"
	default n
	help
	  Power off and reset support for the Hisilicon HI3xxx boards

config HISI_REBOOT_TYPE
	bool "Hisilicon hi3xxx reboot type driver"
	depends on HI3XXX_POWER_OFF
	default n
	help
	  Reboot type support for the Hisilicon HI3xxx boards

config HI3XXX_CMDLINE_PARSE
       bool "cmdline parse"
       default n

       help
          Say 'Y' here if you want to support the cmdline parse

config HISI_SR
	bool "support hi3xxx suspend and resume"
	depends on SUSPEND
	default n
	help
	   support hi3xxx suspend and resume

config HISI_SR_DEBUG
	bool "hisi suspend-resume debug interface"
	depends on PM
	default n
	help
	suspend-resume debug for hisi platform

config HISI_SR_DEBUG_SLEEP
	bool "hisi suspend-resume debug sleep"
	depends on PM
	default n
	help
	suspend-resume debug sleep for hisi platform

config HISI_LPM3_DEBUG
	depends on HISI_MAILBOX
	bool "Hisilicon LPM3 debug"
	default n
	help
	  Hi3xxx lpm3 debug driver

config HISI_HISEE
	depends on HISI_MAILBOX
	bool "Hisilicon hisee "
	default n
	help
	  Hi3xxx hisee driver

config HI3XXX_MODEM_ETB
	bool "hisi modem etb driver"
	default n
	help
	  enable etb trace for modem for hisi platform

config HISI_BOOST5V_CONTROL
	bool "support boost5v control function"
	default n
	help
	  Say 'Y' here if you want to support boost5v control enable.
endif
```

## drivers/hisi/hi6402dsp/Kconfig
```kconfig
config HI6402_HIFI_MISC
     tristate "hi6402 hifi misc device support"
     default n
     ---help---
	hi6402 hifi misc driver
```

## drivers/hisi/hi6421_spk/Kconfig
```kconfig
config HI6421_SPK
	tristate "Spk support for HI6421"
	default n
	---help---
	 Say Y here if you want to support HI6421's speaker
```

## drivers/hisi/hi64xx/Kconfig
```kconfig
config HI6402_CODEC
	tristate "Support HiSilicon Hi6402 Codec IC"
	default n
        help
          Enables the HI6402 core driver.

config HI6403_CODEC
	tristate "Support HiSilicon Hi6403 Codec IC"
	default n
	help
          Enables the HI6403 core driver.

config HI6402_MBHC_ANC
	tristate "Support ANC for Hi6402 Codec"
        default n
        help
          Enables support of ANC for Hi6402.

config HI64XX_TEST
	tristate "Enable UT test for Hi64xx modules"
	default n
	help
	  Unit test for Hi64xx modules.
```

## drivers/hisi/hi6xxx/Kconfig
```kconfig
config HISILICON_PLATFORM_HI6XXX
	bool "Support HiSilicon Hi6XXX SOC platform"
	depends on ARCH_HI6XXX
	default n 
	help
	  This driver supports HiSilicon HiXXX SOC,
	  including easy shell, etc.

if HISILICON_PLATFORM_HI6XXX
config HISILICON_PLATFORM_HI6XXX_SOC
	bool "Support HiSilicon Hi6XXX SOC"
	depends on HISILICON_PLATFORM_HI6XXX
	default n
	help
	  This driver supports HiSilicon Hi6XXX SOC,
	  including system controller configuration, etc.

config HISILICON_PLATFORM_HI6XXX_IOMAP
	bool "Support HiSilicon Hi6XXX I/O Mapping"
	depends on HISILICON_PLATFORM_HI6XXX
	default n
	help
	  This driver supports HiSilicon Hi6XXX SOC,
	  including io mapping, etc.

config HISILICON_PLATFORM_HI6XXX_BOARDID
	bool "Support HiSilicon Hi6XXX Board ID"
	depends on HISILICON_PLATFORM_HI6XXX
	default n
	help
	  This driver supports HiSilicon HiXXX SOC,
	  including board id configuration, etc.

config HISILICON_PLATFORM_HI6XXX_BOOTCMD
	bool "Support HiSilicon Hi6XXX Boot Comand"
	depends on HISILICON_PLATFORM_HI6XXX
	default n
	help
	  This driver supports HiSilicon HiXXX SOC,
	  including hisilicon platform boot command, etc.

config HISILICON_PLATFORM_HI6XXX_MODEM
	bool "Support HiSilicon Hi6XXX Modem"
	depends on HISILICON_PLATFORM_HI6XXX
	default n
	help
	  This driver supports HiSilicon HiXXX Modem,
	  including hisilicon hi6xxx modem driver, etc.

config HISILICON_PLATFORM_HI6XXX_IPC
	bool "Support HiSilicon Hi6XXX IPC"
	depends on HISILICON_PLATFORM_HI6XXX
	default n
	help
	  This driver supports HiSilicon HiXXX IPC,
	  including hisilicon hi6xxx IPC driver, etc.
	  
config HI6XXX_SR
	bool "Support HiSilicon Hi6XXX 64bit suspend/resume"
	depends on HISILICON_PLATFORM_HI6XXX
	default n
	help
	  This driver supports HiSilicon Hi6XXX 64bit SR,
	  including hisilicon hi6xxx suspend/resume driver, etc.	  
endif
```

## drivers/hisi/hifi_mailbox/Kconfig
```kconfig
source "drivers/hisi/hifi_mailbox/mailbox/Kconfig"
source "drivers/hisi/hifi_mailbox/ipcm/Kconfig"
```

## drivers/hisi/hifi_mailbox/ipcm/Kconfig
```kconfig
menu "Hifi mailbox driver"

config HIFI_IPC
     bool "k3 multicore ipc driver"
     default n
     help
          k3 multicore ipc driver.
config HIFI_IPC_3650
     bool "hifi 3650 mailbox driver base on ipc"
     default n
     help
          transplant 3650 mailbox driver.
config HIFI_IPC_3660
     bool "hifi 3660 mailbox driver base on ipc"
     default n
     help
          transplant 3660 mailbox driver.
config HIFI_IPC_6250
     bool "hifi 6250 mailbox driver base on ipc"
     default n
     help
          transplant 6250 mailbox driver.
endmenu
```

## drivers/hisi/hifi_mailbox/mailbox/Kconfig
```kconfig
menu "Hifi mailbox driver"

config HIFI_MAILBOX
     bool "hifi mailbox driver base on ipc"
     default n
     help
          transplant balong mailbox driver.
endmenu
```

## drivers/hisi/hifidsp/Kconfig
```kconfig
menu "Hifimisc driver serve HIFI dsp"

config HIFI_DSP_ONE_TRACK
     bool "hifi low power play device support"
     help
          hifi lpp device provide service for HIFI and AP, in case of HIFI ultra-low power audio play.

endmenu
```

## drivers/hisi/hilog/Kconfig
```kconfig
config HISI_HILOG
	bool "Hisilicon platform hisi log support"
	default n
	help
	Say yes here to support the hisilicon platform hisi log module
```

## drivers/hisi/hiperfdump/Kconfig
```kconfig
config HI3650_PMU_DUMP
       bool "hisi hi3650 pmu dump tool"
       depends on ARCH_HI3650
       default n
```

## drivers/hisi/hmpthresholds/Kconfig
```kconfig
#
# Huawei Set hmp thresholds policy
#

comment "set hmp thresholds policy"
config HISI_HMPTH_SET
	bool "Huawei Set hmp thresholds policy"
	depends on SCHED_HMP
	default n
	help
	  This module provides interfaces for user and kernel to set hmp threshold policy.
```

## drivers/hisi/ivp/Kconfig
```kconfig
menu "Hisilicon IVP"

config HISI_IVP
     bool "hisilicon ivp support"
     default n
     help
          ivp driver for hi3650.

config IVP_SMMU
	bool "Hisilicon IVP SMMU Support"
	depends on IOMMU_API
	depends on HISI_IODOMAIN_API
	help
	  Hisilicon IVP IOMMU Support.

config IVP_SMMU_TEST
	bool "Hisilicon IVP SMMU TEST Support"
	depends on IVP_SMMU
	help
	  Hisilicon IVP IOMMU TEST Support.

endmenu
```
