## drivers/hisi/load_image/Kconfig
```kconfig
config LOAD_IMAGE
	bool "Support HiSilicon load image"
	default n
	depends on TZDRIVER
	help
	  This driver supports HiSilicon LOAD IMAGE

config MODEMID_HI3650
	bool "Support HiSilicon GET MODEM ID"
	default n
	help
	  This driver supports HiSilicon GET MODEM ID
```

## drivers/hisi/mailbox/Kconfig
```kconfig
config HISILICON_PLATFORM_MAILBOX
	bool "HISILICON PLATFORM MAILBOX"
	default n

if HISILICON_PLATFORM_MAILBOX
source "drivers/hisi/mailbox/hisi_mailbox/Kconfig"
endif
```

## drivers/hisi/mailbox/hisi_mailbox/Kconfig
```kconfig
comment "hisi ipc MailBox driver"
config HISI_MAILBOX
	bool "hisi ipc MailBox driver"
	default n
	help
	  hisi ipc MailBox driver
	  
comment "hisi ipc mailboxes debugfs user"
config HISI_MAILBOX_DEBUGFS
	bool "hisi ipc mailboxes debugfs user"
	depends on (HISI_MAILBOX) && DEBUG_FS
	default n
	help
	  HiIPCV230 ipc mailboxes debugfs user

comment "hisi ipc MailBox driver performance debug"
config HISI_MAILBOX_PERFORMANCE_DEBUG
	bool "hisi ipc MailBox driver performance debug"
	depends on (HISI_MAILBOX)
	default n
	help
	  Print tts of sending task, if config is set y

comment "hisi kernel API about remote processor communication"
config HISI_RPROC
	bool "hisi ipc kernel API"
	default n
	help
	  hisi kernel API about remote processor communication
	  
comment "hisi rproc kernel API debugfs"
config HISI_RPROC_DEBUGFS
	bool "hisi rproc kernel API debugfs"
	depends on (HISI_RPROC) && DEBUG_FS
	default n
	help
	  debug for hisi_rproc
```

## drivers/hisi/mcushell/Kconfig
```kconfig
config HISILICON_PLATFORM_MCUSHELL
	bool "Hisilicon platform mcushell support"
    depends on HISILICON_PLATFORM_POWER_CONTROL
	default n
	help
	  Say yes here to support the hisilicon platform mcushell
```

## drivers/hisi/memory_dump/Kconfig
```kconfig
config HISILICON_PLATFORM_KERNELDUMP
	bool "Support HiSilicon KERNELDUMP"
	default n
	help
	  This driver supports HiSilicon HiXXX KERNELDUMP,
	  including hisilicon kerneldump driver.

config HISI_KERNELDUMP
	bool "Support HiSilicon Hisi KERNELDUMP"
	default n
	help
	  This driver supports HiSilicon HiXXX KERNELDUMP,
	  including hisilicon kerneldump driver.
	  
```

## drivers/hisi/misc/Kconfig
```kconfig
config HISILICON_PLATFORM_MISC
	bool "Support HiSilicon MISC Modules"
	depends on HISILICON_PLATFORM
	default n
	help
	  This driver supports HiSilicon MISC Modules,
	  including easy shell, etc.

if HISILICON_PLATFORM_MISC
config HISILICON_PLATFORM_RSVMAP_CHECK
	bool "Support HiSilicon HiXXXX Reserved Memory Check"
	depends on HISILICON_PLATFORM_MISC
	default n
	help
	  This driver supports Overlapping Reserved Memory Detector.
endif
```

## drivers/hisi/mntn/Kconfig
```kconfig
config HISILICON_PLATFORM_MAINTAIN
	bool "Hisilicon platform maintain module support"
	default n
	help
	  Say yes here to support the hisilicon platform maintain module 

config HISILICON_PLATFORM_HISI_EASYSHELL
	bool "Support HiSilicon Hi6XXX Easy Shell"
	default n
	help
	  This driver supports HiSilicon HiXXX SOC,
	  including easy shell, etc.
source "drivers/hisi/mntn/blackbox/Kconfig"

config HISI_VIRT_TO_PHYS
	bool "support converting virtual address to physical address"
	default n
	help
	  Say 'Y' here if you want to support virtual address to physical address enable.

config HISI_BOOT_TIME
	bool "support print all boot slice"
	default n
	help
	  Say 'Y' here if you want to print all boot slice.

config HISI_LOWMEM_DBG
	bool "Hisilicon Low Memory Killer debug"
	default n
	help
	  print processes info when lmk happen per several seconds

config HISI_BB_SYSCALL
     	bool "support print system call trace "
     	default n        
	help
    	  Say 'Y' here if you want to print system call trace.
```

## drivers/hisi/mntn/blackbox/Kconfig
```kconfig
menu "RDR - Running data recorder menu"

config HISI_BB
	bool "kernel run data recorder"
	depends on SYSFS
	default n
	help
	  This module can record some data about kernel internal info.
	  Include:
	  the task switch,
	  interrupts switch,
	  arm exception info,
	  etc ...

config HISI_BB_DEBUG
	bool "test unit for kernel run data recorder"
	depends on SYSFS && HISI_BB
	default n
	help
	  This module can test RDR function ...
	  Include:
	  dataabort,
	  etc

# need_other_module_clear
config HISI_LPMCU_BB
	bool "hisi lpmcu bbox"
	depends on  HISI_BB
	default n

config HISI_HIFI_BB
	bool "hisi hifi bbox"
	depends on  HISI_BB
	default n

# need_other_module_clear
config HISI_ISP_RDR
       bool "hisi isp rdr"
       depends on HISI_BB
       default n
endmenu
```

## drivers/hisi/modem/Kconfig
```kconfig
menu "Hisi Modem"

config BALONG_OAM_PS
        tristate "support tlmsp tlps gumsp gups taf"
        default n
        help
         tlmsp tlps gumsp gups taf acore image

source "drivers/hisi/modem/drv/Kconfig"
endmenu
```

## drivers/hisi/modem/config/product/hi3650/os/acore/hi3650_modem_defconfig
```kconfig
# balong modem
CONFIG_HISI_BALONG_MODEM=y
CONFIG_HISI_BALONG_MODEM_HI3650=y

#IPC
CONFIG_IPC_DRIVER=y

#ICC
CONFIG_ICC_BALONG=y
CONFIG_ICC_BALONG_TEST=n

#pmom
CONFIG_PM_OM_BALONG=y
CONFIG_PM_OM_BALONG_TEST=y

CONFIG_BALONG_EASY_SHELL=y

#IPF
CONFIG_IPF_SUPPORT=y
CONFIG_IPF_TEST=y

#DSP
CONFIG_DSP_BALONG=y

#HKADC
CONFIG_HKADC_BALONG=y

#nvim
CONFIG_NVIM=y
CONFIG_NVIM_TEST=y

#Loadm
CONFIG_IMAGE_LOAD=y

#OnOff
CONFIG_BALONG_ONOFF=n
CONFIG_BALONG_MODEM_ONOFF=y

# sync
CONFIG_SYNC_BALONG=y

#hwadp
CONFIG_HW_IP_BASE_ADDR=y

#rfile
CONFIG_RFILE_SUPPORT=y

#MEM
CONFIG_MEM_BALONG=y

#timer
CONFIG_HARD_TIMER=y
CONFIG_SOFT_TIMER=y
CONFIG_BBP_TIMER=y

#temperature
CONFIG_TEMPERATURE_SYS_BALONG=n

#UDI
CONFIG_UDI_SUPPORT=y

#RESET
CONFIG_BALONG_MODEM_RESET=y
CONFIG_BALONG_MODEM_RESET_TEST=n
CONFIG_BALONG_MODEM_POWER_MANAGE=n
CONFIG_HIFI_RESET=n

#S_MEMORY
CONFIG_S_MEMORY=y
CONFIG_S_MEMORY_TEST=n

#SYSCTRL
CONFIG_SYSCTRL=y
CONFIG_SYSCTRL_TEST=n

# efuse
CONFIG_EFUSE_BALONG=n
CONFIG_EFUSE_BALONG_AGENT=y

#---------------------------
#dual modem
CONFIG_DUAL_MODEM=n
CONFIG_BALONG_OAM_PS=y
CONFIG_FRAME_WARN=2048


#OM
CONFIG_HISI_DUMP=n

#PMIC OCP
CONFIG_PMIC_OCP=y
```

## drivers/hisi/modem/config/product/p532_asic/os/acore/balongv7r2_defconfig
```kconfig
CONFIG_CPU_FREQ=n
CONFIG_GENERIC_GPIO=y
CONFIG_GENERIC_CLOCKEVENTS=y
# CONFIG_ARM_PATCH_PHYS_VIRT is not set
CONFIG_PHYS_OFFSET=0x55F00000
CONFIG_EXPERIMENTAL=y
# CONFIG_LOCALVERSION_AUTO is not set
CONFIG_SYSVIPC=y
CONFIG_IKCONFIG=y
CONFIG_IKCONFIG_PROC=y
CONFIG_CGROUPS=y
CONFIG_CGROUP_DEBUG=y
CONFIG_CGROUP_FREEZER=y
CONFIG_CGROUP_CPUACCT=y
CONFIG_RESOURCE_COUNTERS=y
CONFIG_CGROUP_SCHED=y
# CONFIG_FAIR_GROUP_SCHED is not set
CONFIG_RT_GROUP_SCHED=y
CONFIG_NAMESPACES=y
# CONFIG_UTS_NS is not set
# CONFIG_IPC_NS is not set
# CONFIG_USER_NS is not set
# CONFIG_PID_NS is not set
CONFIG_RELAY=y
CONFIG_BLK_DEV_INITRD=y
CONFIG_RD_BZIP2=y
CONFIG_RD_LZMA=y
CONFIG_KALLSYMS_ALL=y
CONFIG_EMBEDDED=y
CONFIG_PROFILING=y
CONFIG_OPROFILE=y
CONFIG_CPU_V7=y
CONFIG_PERF_EVENTS=y
CONFIG_HAVE_OPROFILE=y
CONFIG_HAVE_HW_BREAKPOINT=y
CONFIG_MODULES=y
CONFIG_MODULE_UNLOAD=y
CONFIG_MODULE_FORCE_UNLOAD=y
CONFIG_PARTITION_ADVANCED=y
CONFIG_ARM_ERRATA_754322=y


CONFIG_SERIAL_BALONGV7R2_UART=n
CONFIG_SERIAL_BALONGV7R2_UART_CONSOLE=n
CONFIG_SERIAL_CORE=y
CONFIG_SERIAL_CORE_CONSOLE=y
CONFIG_SERIAL_AMBA_PL011=y
CONFIG_SERIAL_AMBA_PL011_CONSOLE=y

CONFIG_DECOMPRESS_GZIP=y

# CONFIG_MSM_STACKED_MEMORY is not set

# CONFIG_MSM_FIQ_SUPPORT is not set
# CONFIG_MSM_PROC_COMM is not set
CONFIG_ARCH_HI6930=y
CONFIG_ARCH_P532=y
CONFIG_MSM_DIRECT_SCLK_ACCESS=y
CONFIG_NO_HZ=y
CONFIG_HIGH_RES_TIMERS=y
CONFIG_GENERIC_CLOCKEVENTS_BUILD=y
CONFIG_ARM_ARCH_TIMER=y
CONFIG_PREEMPT=y
CONFIG_AEABI=y
CONFIG_OABI_COMPAT=y
CONFIG_VMALLOC_RESERVE=0x19000000
CONFIG_USE_OF=y
CONFIG_ARM_APPENDED_DTB=n
CONFIG_ARM_ATAG_DTB_COMPAT=n
# CONFIG_CORE_DUMP_DEFAULT_ELF_HEADERS is not set

CONFIG_WLAN=n
CONFIG_BCM_FLWCTL=n
CONFIG_WLAN_BCM_CHIP=n
CONFIG_WIRELESS_EXT=n
CONFIG_WEXT_CORE=n
CONFIG_WEXT_PROC=n
CONFIG_WEXT_PRIV=n
CONFIG_BALONG_WIFI=n
CONFIG_MTD=y
CONFIG_MTD_PARTITIONS=y
CONFIG_MTD_CMDLINE_PARTS=y
CONFIG_MTD_OF_PARTS=y
CONFIG_MTD_CHAR=y
CONFIG_MTD_BLKDEVS=y
CONFIG_MTD_BLOCK=y

CONFIG_MTD_NAND_IDS=y
CONFIG_MTD_NAND_ECC=y
CONFIG_MTD_NAND=y
CONFIG_MTD_NAND_BALONG_NANDC=y

# CONFIG_MTD_MSM_NAND is not set
CONFIG_MTD_MSM_QPIC_NAND=y
CONFIG_NET=y
CONFIG_PACKET=y
CONFIG_UNIX=y
CONFIG_INET=y
CONFIG_IPV6=y
# CONFIG_WIRELESS is not set
CONFIG_BLK_DEV_LOOP=y
CONFIG_BLK_DEV_RAM=y
# CONFIG_ANDROID_PMEM is not set

#
# SCSI device support
#
CONFIG_SCSI_MOD=y
CONFIG_SCSI=y
CONFIG_SCSI_DMA=y
CONFIG_SCSI_PROC_FS=y

#
# SCSI support type (disk, tape, CD-ROM)
#
CONFIG_BLK_DEV_SD=y
CONFIG_SCSI_MULTI_LUN=y
CONFIG_SCSI_CONSTANTS=y
CONFIG_SCSI_LOGGING=y
CONFIG_SCSI_WAIT_SCAN=m

#
# SCSI Transports
#
CONFIG_SCSI_LOWLEVEL=y
CONFIG_NETDEVICES=y
# CONFIG_NET_VENDOR_BROADCOM is not set
# CONFIG_NET_VENDOR_CIRRUS is not set
# CONFIG_NET_VENDOR_FARADAY is not set
# CONFIG_NET_VENDOR_INTEL is not set
# CONFIG_NET_VENDOR_MICROCHIP is not set
# CONFIG_MSM_RMNET is not set
# CONFIG_NET_VENDOR_NATSEMI is not set
# CONFIG_NET_VENDOR_SEEQ is not set
# CONFIG_NET_VENDOR_SMSC is not set
# CONFIG_NET_VENDOR_STMICRO is not set

# Input device support
#
CONFIG_INPUT=y

CONFIG_INPUT_EVDEV=y
CONFIG_INPUT_EVBUG=y

#
# Input Device Drivers
#
CONFIG_INPUT_KEYBOARD=y
CONFIG_BALONG_KEYBOARD_GPIO=y
CONFIG_KEYBOARD_ATKBD=y
CONFIG_INPUT_MISC=y
CONFIG_INPUT_UINPUT=y
CONFIG_INPUT_GPIO=m
# CONFIG_LEGACY_PTYS is not set
CONFIG_SERIAL_MSM_HSL=y
CONFIG_SERIAL_MSM_HSL_CONSOLE=y
CONFIG_HW_RANDOM=y
CONFIG_OF_I2C=y
CONFIG_I2C=y
CONFIG_I2C_BOARDINFO=y
CONFIG_I2C_COMPAT=y
CONFIG_I2C_HELPER_AUTO=y
CONFIG_I2C_DESIGNWARE=y
CONFIG_ENABLE_TEST_CODE=y
CONFIG_I2C_DESIGNWARE_HI6930=y

CONFIG_SPI=n
CONFIG_SPI_QUP=n
CONFIG_SPI_BALONG=n
CONFIG_SPI_SPIDEV=n

CONFIG_ARCH_WANT_OPTIONAL_GPIOLIB=y
CONFIG_GPIOLIB=y
CONFIG_GPIO_SYSFS=y
CONFIG_DEBUG_GPIO=n
CONFIG_GPIO_BALONG=y
# CONFIG_HWMON is not set
CONFIG_REGULATOR=y
CONFIG_REGULATOR_DUMMY=n
CONFIG_REGULATOR_VIRTUAL_CONSUMER=y
CONFIG_REGULATOR_USERSPACE_CONSUMER=y
CONFIG_REGULATOR_BALONG=y
CONFIG_SOUND=y
CONFIG_SND=y
CONFIG_SND_TIMER=y
CONFIG_SND_PCM=y
CONFIG_SND_JACK=y
CONFIG_SND_VERBOSE_PROCFS=y
CONFIG_SND_VERBOSE_PRINTK=y
CONFIG_SND_DEBUG=y
CONFIG_SND_DEBUG_VERBOSE=y
CONFIG_SND_PCM_XRUN_DEBUG=y
CONFIG_SND_DRIVERS=y
CONFIG_SND_ARM=y
CONFIG_SND_SOC=y
# CONFIG_SND_SOC_BALONG is not set
CONFIG_SND_SOC_I2C_AND_SPI=y
CONFIG_SND_SOC_ALL_CODECS=y
CONFIG_SND_SOC_WM_HUBS=y

CONFIG_SND_SOC_WM8990=y

# CONFIG_SOUND_PRIME is not set
# CONFIG_HID_SUPPORT is not set
# CONFIG_USB_SUPPORT is not set
CONFIG_USB_ARCH_HAS_XHCI=y
CONFIG_USB_SUPPORT=y
CONFIG_USB_COMMON=y
CONFIG_USB_ARCH_HAS_HCD=y
CONFIG_USB=y
CONFIG_USB_DEBUG=y
CONFIG_USB_ANNOUNCE_NEW_DEVICES=y

CONFIG_USB_DEVICE_CLASS=y
CONFIG_USB_SUSPEND=n
CONFIG_USB_OTG=n
CONFIG_USB_OTG_DWC=n
CONFIG_USB_OTG_VBUS_BYCHARGER=n
CONFIG_USB_OTG_USBID_BYGPIO=n
CONFIG_USB_DWC3=y
CONFIG_USB_DWC3_DEBUG=y
CONFIG_DWC3_DBG=y
CONFIG_USB_DWC3_VERBOSE=y
CONFIG_DWC3_INTERRUPT_GATHER=n
CONFIG_USB_DWC3_FORCE_DEVICE=y
#CONFIG_USB_DWC3_FORCE_HOST=y

#
# USB Host Controller Drivers
#
CONFIG_USB_XHCI_HCD=y
CONFIG_USB_XHCI_PLATFORM=y
CONFIG_USB_XHCI_HCD_DEBUGGING=y
#
# also be needed; see USB_STORAGE Help for more info
#
CONFIG_USB_STORAGE=y
CONFIG_USB_STORAGE_DEBUG=y
CONFIG_USB_UAS=y
CONFIG_USB_GADGET=y
CONFIG_USB_GADGET_DEBUG=y
CONFIG_USB_GADGET_DEBUG_FILES=y
CONFIG_USB_GADGET_DEBUG_FS=y
CONFIG_USB_GADGET_VBUS_DRAW=2
CONFIG_USB_GADGET_STORAGE_NUM_BUFFERS=2
CONFIG_USB_GADGET_DUALSPEED=y
CONFIG_USB_GADGET_SUPERSPEED=y
CONFIG_USB_BALONG_UDC=y
CONFIG_ETH_BYPASS_MODE=y
# CONFIG_NCM_TEST_SUPPORT is not set
# CONFIG_NCM_MBIM_SUPPORT is not set
CONFIG_BALONG_GNET=y
CONFIG_BALONG_NCM=y
CONFIG_USB_FSG=n
#CONFIG_BALONG_ECM=y
#CONFIG_BALONG_RNDIS=y
CONFIG_GNET_DEBUG=y
CONFIG_GNET_PREALLOC_RX_MEM=y
CONFIG_GNET_PREALLOC_TX_MEM=y
CONFIG_USB_OTG_UTILS=y
CONFIG_USB_CHARGER_DETECT=n
CONFIG_USB_PMU_DETECT=y

#HSIC DRIVER
CONFIG_USB_DWC=n
CONFIG_USB_GADGET_SNPS_DWC_OTG=n
CONFIG_USB_DWC_OTG_LPM=n

CONFIG_SPS=y
CONFIG_SPS_SUPPORT_BAMDMA=y
CONFIG_MMC=n
CONFIG_MMC_DEBUG=n
CONFIG_MMC_CLKGATE=y
CONFIG_MMC_BLOCK=y
CONFIG_MMC_BLOCK_MINORS=8
CONFIG_MMC_BLOCK_BOUNCE=y
CONFIG_MMC_UNSAFE_RESUME=n
CONFIG_MMC_TEST=y
CONFIG_MMC_MSHCI=y
CONFIG_MMC_MSHCI_BALONG=y
#CONFIG_MMC_EMBEDDED_SDIO=y
CONFIG_MMC_MSHCI_USE_HOLD_REG=y
CONFIG_MMC_ADP=y
CONFIG_GPIO_EXPANDER_BALONG=n
CONFIG_IOS_BALONG=y
CONFIG_EFUSE_BALONG=y
CONFIG_FUSE_FS=y
CONIFG_CUSE=y
CONFIG_HOTPLUG=y
#CONFIG_SDIO_ARASAN=n
#CONFIG_SDIO_ARASAN_DEBUG=n
#CONFIG_WLAN_IF=y
CONFIG_SPS_SUPPORT_NDP_BAM=y

CONFIG_MISC_FILESYSTEMS=y
CONFIG_PROC_FS=y
CONFIG_VFAT_FS=y
CONFIG_TMPFS=y
CONFIG_YAFFS_FS=y
CONFIG_YAFFS_YAFFS2=y
CONFIG_YAFFS_AUTO_YAFFS2=y
CONFIG_YAFFS_DISABLE_TAGS_ECC=y
CONFIG_YAFFS_XATTR=y
CONFIG_BALONG_EARLY_FS=y
# CONFIG_BALONG_EARLY_FS_TEST is not set
CONFIG_NLS_CODEPAGE_437=y
CONFIG_NLS_ASCII=y
CONFIG_NLS_ISO8859_1=y
CONFIG_PRINTK_TIME=y
CONFIG_MAGIC_SYSRQ=y
CONFIG_DEBUG_FS=y
# CONFIG_SCHED_DEBUG is not set
CONFIG_DEBUG_KERNEL=y
CONFIG_TIMER_STATS=y
# CONFIG_DEBUG_PREEMPT is not set
CONFIG_DEBUG_INFO=y
CONFIG_IMAGE_LOAD=y
CONFIG_ICC_BALONG=y
CONFIG_ICC_BALONG_TEST=n
CONFIG_EDMA_SUPPORT=y
CONFIG_EDMA_TEST=y
CONFIG_BALONG_OAM_PS=y
CONFIG_UDI_SUPPORT=y
CONFIG_NVIM=y
CONFIG_NVIM_TEST=y
CONFIG_DEBUG_MEMORY_INIT=y
CONFIG_DYNAMIC_DEBUG=y
CONFIG_DEBUG_USER=y
CONFIG_KEYS=y
CONFIG_CRYPTO_AUTHENC=y
CONFIG_CRYPTO_CBC=y
CONFIG_CRYPTO_HMAC=y
CONFIG_CRYPTO_MD4=y
CONFIG_CRYPTO_MD5=y
CONFIG_CRYPTO_SHA1=y
CONFIG_CRYPTO_SHA256=y
CONFIG_CRYPTO_AES=y
CONFIG_CRYPTO_ARC4=y
CONFIG_CRYPTO_DES=y
CONFIG_CRYPTO_TWOFISH=y
CONFIG_CRYPTO_DEFLATE=y
# CONFIG_CRYPTO_HW is not set
CONFIG_CRC_CCITT=y
CONFIG_LIBCRC32C=y
CONFIG_WATCHDOG=y
CONFIG_HI6930_WATCHDOG=y
CONFIG_DPM_BALONG=n
CONFIG_BALONG_RTC=n
CONFIG_HI6551_RTC=n
CONFIG_RTC_CLASS=y
CONFIG_BALONG_RTC_TEST=n
CONFIG_MEM_BALONG=y
CONFIG_HARD_TIMER=y
CONFIG_HARD_TIMER_TEST=y
CONFIG_TIMER_ADP=y
CONFIG_RFILE_SUPPORT=y
CONFIG_RFILE_TEST=y
CONFIG_SOFT_TIMER=y
CONFIG_SOFT_TIMER_TEST=y
CONFIG_BUSSTRESS=n

# Graphics support
CONFIG_FB=y
CONFIG_LEDS_CLASS=y
CONFIG_NEW_LEDS=y
CONFIG_EMI_SUPPORT=n

CONFIG_LEDS_TRIGGER_TIMER=n
CONFIG_LEDS_TRIGGERS=n
CONFIG_LEDS_BALONG=n
CONFIG_LEDS_TRIGGER_BREATH=n

CONFIG_IPC_DRIVER=y
CONFIG_IPC_TEST=y
CONFIG_IPC_ADP=y

#Pcie support
CONFIG_PCI=n
CONFIG_PCI_MSI=n
CONFIG_PCI_SYSCALL=n
CONFIG_PCIEPORTBUS=n
CONFIG_BALONG_PCIE=n
CONFIG_BALONG_PCIE_PM=n
CONFIG_BALONG_PCIE_L1SS=n
CONFIG_BALONG_PCIE_OUTPUT_CLK=n
CONFIG_BALONG_PCIE_FORCE_GEN1=n
CONFIG_BALONG_PCIE_TEST=n
CONFIG_PCIEASPM=n
CONFIG_PCIEASPM_DEFAULT=n
CONFIG_PCIEASPM_POWERSAVE=n
CONFIG_PCIEASPM_PERFORMANCE=n
CONFIG_PCIEASPM_DEBUG=n
CONFIG_PCIE_PME=n
CONFIG_PCIEAER=n
CONFIG_BALONG_PCIE_DOCKING_TEST=n
CONFIG_PCI_DEBUG=n

CONFIG_HW_IP_BASE_ADDR=y
#clk
CONFIG_BALONG_CLK=n

CONFIG_CHARGE_ADP=y
#
# Power management options
#
CONFIG_PM=n
CONFIG_PM_SLEEP=n
CONFIG_PM_RUNTIME=n
CONFIG_SUSPEND=n
CONFIG_HAVE_CPU_IDLE=n
CONFIG_HAS_WAKELOCK=n
CONFIG_WAKELOCK=n
CONFIG_WAKELOCK_STAT=n
CONFIG_USER_WAKELOCK=n
CONFIG_EARLYSUSPEND=n
CONFIG_EARLYSUSPEND_TEST=n
CONFIG_BALONG_PM_SUSPEND=n

# sync
CONFIG_SYNC_BALONG=y

# ONOFF
CONFIG_BALONG_ONOFF=y
CONFIG_BALONG_MODEM_BOOT=y

#PMIC
CONFIG_PMIC=y
CONFIG_POWER_PMIC_HI6451=n
CONFIG_POWER_PMIC_HI6551=y


#coul
CONFIG_HI6551_COUL=n

#DSP
CONFIG_DSP_BALONG=y

#HKADC
CONFIG_HKADC_BALONG=y
#sec check
CONFIG_KDF_HASH=y
CONFIG_SEC_CHECK=y

#PWM
CONFIG_PWM=n
CONFIG_PWM_BALONG=n
CONFIG_LEDS_PWM_BALONG=n
CONFIG_FRAME_WARN=2048
#VFP
CONFIG_VFP=y
CONFIG_VFPv3=y
```
