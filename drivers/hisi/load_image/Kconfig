## drivers/hisi/modem/drv/balong_timer/Kconfig
```kconfig
#
# timer driver
#
comment "timer driver"

config PRINTK_USE_HARDTIMER
	bool "use hardtimer stamp for printk"
	default n
	help
	  hard timer interface

config HARD_TIMER
	tristate "hard timer"
	select PRINTK_USE_HARDTIMER
	default n
	help
	  hard timer interface

config HARD_TIMER_TEST
	tristate "hard timer test"
	default n
	help
	  hard timer test
	  
config TIMER_ADP
	tristate "timer adaption"
	default n
	help
	  timer adaption for v7r1
	  
config SOFT_TIMER
	tristate "soft timer"
	default n
	help
	  soft timer interface
	   
config SOFT_TIMER_TEST
	tristate "soft timer test"
	default n
	help
	  soft timer test
	  
config BBP_TIMER
	tristate "bbp timer"
	default n
	help
	  bbp timer interface
	  
	  
```

## drivers/hisi/modem/drv/efuse/Kconfig
```kconfig
#
# EFUSE infrastructure and drivers
#

config EFUSE_BALONG
	tristate "Hisi Balong EFUSE Read/Write support"
	default n
	help
	  Support for the Hisi Balong SoC read or write.

config EFUSE_BALONG_AGENT
	tristate "Hisi Balong EFUSE Read/Write Agent"
	default n
	help
	  Support for the Hisi Balong SoC read or write Agent.
```

## drivers/hisi/modem/drv/ipf/Kconfig
```kconfig
#
# Balong ipf configuration
#

config IPF_SUPPORT
	tristate "ipf support"
	default n
	help
	  balong ipf driver
```

## drivers/hisi/modem/drv/mem/Kconfig
```kconfig
#
# mem driver
#
comment "mem driver"

config MEM_BALONG
	bool "mem balong"
	default n
	help
	  mem blaong

config MEM_BALONG_TEST
	bool "mem blaong test"
	depends on MEM_BALONG
	default y
	help
	  mem blaong test
```

## drivers/hisi/modem/drv/nvim/Kconfig
```kconfig
#
# nv driver
#

comment "nv driver"

config NVIM
	tristate "support nv"
	default n
	help
	  NVIM driver

config NVIM_TEST
    tristate "nv test"
    default n
    help 
      NVIM test	
	  
```

## drivers/hisi/modem/drv/ocp/Kconfig
```kconfig
config PMIC_OCP
	bool "balong pmic ocp"
	default n
	help
	support for pmic ocp of balong
```

## drivers/hisi/modem/drv/onoff/Kconfig
```kconfig
#
# balong onoff management
#

comment "balong onoff management"

config BALONG_ONOFF
	tristate "balong onoff management"
	default n
	help
	  balong onoff management

config BALONG_MODEM_ONOFF
	tristate "balong modem onoff management"
	default n
	help
	  balong modem state
```

## drivers/hisi/modem/drv/pm_om/Kconfig
```kconfig
config PM_OM_BALONG
	bool "balong pm om"
	default n
	help
	support for pm om of balong
```

## drivers/hisi/modem/drv/psam/Kconfig
```kconfig
#
# Balong psam configuration
#

config PSAM_SUPPORT
	tristate "psam support"
	default n
	help
	  balong psam driver
```

## drivers/hisi/modem/drv/sec_call/Kconfig
```kconfig
#
# linux kernel call secure func
#

comment "linux kernel call secure func"

config SEC_CALL
	tristate "support sec_call"
	default n
	help
	  sec_call interface
	
```

## drivers/hisi/modem/drv/sim_hotplug/Kconfig
```kconfig
#
#Hisilicon HI3xxx SIM hotplug support.
#
config HI3XXX_SIM_HOTPLUG
	bool "support sim hotplug function"
	default n
	help
	  Say 'Y' here if you want to support the SIM HOTPLUG.
```

## drivers/hisi/modem/drv/sync/Kconfig
```kconfig
#
# sync
#
comment "sync"

config SYNC_BALONG
	tristate "sync adaption"
	default n
	help
	  sync adaption for v7r1
```
