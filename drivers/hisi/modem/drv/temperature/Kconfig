## drivers/hisi/modem/drv/temperature/Kconfig
```kconfig
#
# TEMPERATURE SYS infrastructure and drivers
#

config TEMPERATURE_SYS_BALONG
	tristate "Hisi Balong Temperature Sys support"
	help
	  Support for the Hisi balong soc Temperature Sys.
	  
```

## drivers/hisi/mutex_service/Kconfig
```kconfig
config HISILICON_PLATFORM_MUTEX_SERVICE
	bool "Hisilicon platform mutex service support"
	default n
	help
	  Say yes here to support the hisilicon platform mutex service
```

## drivers/hisi/noc/Kconfig
```kconfig
config HISI_NOC
	bool "Support HiSilicon NOC"
	default n
	help
	  This driver supports HiSilicon HiXXX NOC,
	  including hisilicon noc driver.
	   
config HISI_NOC_HI3650_PLATFORM
	depends on HISI_NOC
	bool "Support HiSilicon Hi3650 NOC"
	default n
	help
	   NoC platform Define -Hi3650(Austin)

config HISI_NOC_HI3660_PLATFORM
	depends on HISI_NOC
	bool "Support HiSilicon Hi3660 NOC"
	default n
	help
	   NoC platform Define -Hi3660(Chicago)
	   
config HISI_NOC_HI6250_PLATFORM
	depends on HISI_NOC
	bool "Support HiSilicon Hi6250 NOC"
	default n
	help
	   NoC platform Define -Hi6250(Dallas)	   
```

## drivers/hisi/perf_stat/Kconfig
```kconfig
config HISI_PERF_STAT
	bool "Hisilicon perf_stat driver 32bit driver"
	default n
	help
	Hi3650 perf_stat driver support
config HISI_PERF_STAT64
	bool "Hisilicon perf_stat driver 64bit driver"
	default n
	help
	Hi3660 perf_stat driver support
```

## drivers/hisi/pm_common/Kconfig
```kconfig
#
#Hisilicon suspend optimization support.
#
comment "kernel/driver/hisi/pm_common/suspend.c"
config HISI_SR_SYNC
	bool "Hisilicon suspend optimization"
	depends on SUSPEND
	default n
	help
	  Driver for suspend optimization
```

## drivers/hisi/slimbus/Kconfig
```kconfig
menu "hisilicon slimbus driver"

config HISILICON_PLATFORM_SLIMBUS
     bool "slimbus device support"
     default y
     help
          slimbus driver.

endmenu
```

## drivers/hisi/socp/Kconfig
```kconfig
#
# socp driver layer
#

comment "socp driver layer"

config HISI_SOCP
	tristate "support socp"
	default n
	help
	  socp driver

comment "socp test"
config HISI_SOCP_TEST
	tristate "Turn off socp test module by default"
	depends on HISI_SOCP
	default n
	help
	  socp test unit test module

comment "socp adapt layer"
config HISI_SOCP_ADP
	tristate "Turn off socp adapt layer by default"
	depends on HISI_SOCP
	default n
	help
	  socp test unit test module
```

## drivers/hisi/soundtrigger/Kconfig
```kconfig
config SOUND_TRIGGER
	tristate "Support for sound trigger"
	default n
	---help---
	 Say Y here if you want to support sound trigger
```

## drivers/hisi/tele_mntn/Kconfig
```kconfig
config HISILICON_PLATFORM_TELE_MNTN
	bool "Hisilicon platform tele_mntn support"
	default n
	help
	  Say yes here to support the hisilicon platform tele_mntn 
```

## drivers/hisi/tzdriver/Kconfig
```kconfig
config SECURE_EXTENSION
        bool "security extension support"
        default n
        help
          Include Security Extension.

config  TZDRIVER
    tristate "Secure Execution Communicator driver"
    default n
    depends on SECURE_EXTENSION
    help
      Provides a communication interface between userspace and
      TrustZone Operating Environment.

config TEELOG
       tristate "Secure Execution Communicator driver"
       default n
       depends on TZDRIVER
       help
       TEEOS log

config TEE_TUI
       tristate "Trusted user interface driver"
       default n
       depends on TZDRIVER
       help
       Trusted user interface diver
config HISI_SPI_SMC
	bool "hisi spi smc"
	default n
config HISI_SPI1_SMC
	bool "hisi spi1 smc"
	default n
```

## drivers/hisi/watchpoint/Kconfig
```kconfig
config HISI_WATCHPOINT_CB
	bool "Hisilicon watchpoint callback support"
	depends on HAVE_HW_BREAKPOINT
	default n
	help
	  Say yes here to support the hisilicon watchpoint callback module 
```

## drivers/hisi_pilot/Kconfig.pilot
```kconfig
source "drivers/hisi_pilot/touchscreen/synaptics_dsx/Kconfig"
source "drivers/hisi_pilot/sensor/Kconfig"
source "drivers/hisi_pilot/usb/Kconfig"
source "drivers/hisi_pilot/camera_legacy/Kconfig"
```

## drivers/huawei_platform/Kconfig
```kconfig
source "drivers/huawei_platform/camera_legacy/Kconfig"
source "drivers/huawei_platform/connectivity/Kconfig"
#source "drivers/huawei_platform/dsm/Kconfig"

config SENSORHUB_FEATURE_SUPPORT
    bool "Huawei sensorhub support, for onetrack"
    default n
    help
      Say yes here to support the huawei platform


menu "huawei linux device driver support"
source "drivers/huawei_platform/sensor/Kconfig"
source "drivers/huawei_platform/inputhub/iom7/Kconfig"
source "drivers/huawei_platform/inputhub/iom3/Kconfig"
source "drivers/huawei_platform/touthscreen/Kconfig"
source "drivers/huawei_platform/irda/Kconfig"
source "drivers/huawei_platform/log/Kconfig"
source "drivers/huawei_platform/nfc/Kconfig"
source "drivers/huawei_platform/usb/Kconfig"
source "drivers/huawei_platform/ext_modem/Kconfig"
source "drivers/huawei_platform/storage/Kconfig"
source "drivers/huawei_platform/chipverification/Kconfig"
source "drivers/huawei_platform/chr/Kconfig"
source "drivers/huawei_platform/lcd/Kconfig"
source "drivers/huawei_platform/devdetect/Kconfig"
source "drivers/huawei_platform/ocp/Kconfig"
source "drivers/huawei_platform/madapt/Kconfig"
endmenu

source "drivers/huawei_platform/audio/Kconfig"
source "drivers/huawei_platform/antenna_fpga/Kconfig"

source "drivers/huawei_platform/power/Kconfig"
source "drivers/huawei_platform/uid_iostats/Kconfig"
source "drivers/huawei_platform/antenna_board_match/Kconfig"
source "drivers/huawei_platform/antenna_board_gpio_match/Kconfig"
```

## drivers/huawei_platform/antenna_board_gpio_match/Kconfig
```kconfig
source "drivers/huawei_platform/antenna_board_gpio_match/antenna_boardid_detect/Kconfig"
```

## drivers/huawei_platform/antenna_board_gpio_match/antenna_boardid_detect/Kconfig
```kconfig
config ANTENNA_BOARDID_GPIO_DETECT
    bool "antenna_boardid_gpio_detect support"
    default n
```

## drivers/huawei_platform/antenna_board_match/Kconfig
```kconfig
config HW_ANTENNA_BOARD_MATCH
     bool "antenna_board_match support"
	 default n

source "drivers/huawei_platform/antenna_board_match/antenna_board_adc_match/Kconfig"
```

## drivers/huawei_platform/antenna_board_match/antenna_board_adc_match/Kconfig
```kconfig
config HW_ANTENNA_BOARD_ADC_MATCH
     bool "antenna_board_adc_match support"
	 default n
```

## drivers/huawei_platform/antenna_fpga/Kconfig
```kconfig
#
# 
#
config  ANTENNA_FPGA
	bool "antenna fpga Support"
	default n
	help
	  This allows antenna fpga.
	  If unsure, say n.
```

## drivers/huawei_platform/audio/Kconfig
```kconfig
source "drivers/huawei_platform/audio/maxim/Kconfig"
source "drivers/huawei_platform/audio/deviceboxID/Kconfig"
source "drivers/huawei_platform/audio/tfa9895/Kconfig"
source "drivers/huawei_platform/audio/earpiece_pa/Kconfig"
source "drivers/huawei_platform/audio/invert_hs/Kconfig"
source "drivers/huawei_platform/audio/anc_hs_module/Kconfig"
source "drivers/huawei_platform/audio/tps65133/Kconfig"
```

## drivers/huawei_platform/audio/anc_hs/Kconfig
```kconfig
config ANC_HS
	tristate "Support for ANC headset"
	default n
	---help---
	 Say Y here if you want to support ANC headset
```

## drivers/huawei_platform/audio/anc_hs_module/Kconfig
```kconfig
config ANC_HS_INTERFACE
	tristate "Support for ANC_HS_INTERFACE"
	default n
	---help---
	 Say Y here if you want to support ANC_HS_INTERFACE
config ANC_HS
	tristate "Support for ANC headset"
	default n
	---help---
	 Say Y here if you want to support ANC headset
config ANC_MAX14744
	tristate "Support for ANC MAX14744"
	default n
	---help---
	 Say Y here if you want to support ANC MAX14744
```

## drivers/huawei_platform/audio/deviceboxID/Kconfig
```kconfig
config DEVICEBOXID
	tristate "deviceboxID driver"
	default n
	help
		Say Y to enable deviceboxID driver support
```

## drivers/huawei_platform/audio/earpiece_pa/Kconfig
```kconfig
config EARPA
	tristate "earpice PA driver"
	default y
	help
		Say Y to enable earpice PA driver support
```
