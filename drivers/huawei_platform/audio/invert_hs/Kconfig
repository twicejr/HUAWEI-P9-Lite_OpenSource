## drivers/huawei_platform/audio/invert_hs/Kconfig
```kconfig
config INVERT_HS
	tristate "Support for invert headset"
	default n
	---help---
	 Say Y here if you want to support invert headset
```

## drivers/huawei_platform/audio/maxim/Kconfig
```kconfig
config MAX98925
	tristate "max98925 i2c driver"
	default n
	help
		Say Y to enable max98925 i2c driver support

config MAXIM
	tristate "maxim ioctl driver"
	default n
	help
		Say Y to enable maxim driver support
```

## drivers/huawei_platform/audio/tfa9895/Kconfig
```kconfig
config TFA9895
	tristate "tfa9895 i2c driver"
	default n
	help
		Say Y to enable tfa9895 i2c driver support
```

## drivers/huawei_platform/audio/tps65133/Kconfig
```kconfig
config TPS65133
	tristate "Support for TPS65133"
	default n
	---help---
	 Say Y here if you want to support TPS65133
```

## drivers/huawei_platform/camera_legacy/hi6220/Kconfig
```kconfig
menuconfig VIDEO_HI6210_CAMERA_SENSOR
    tristate "Support HI6210 Camera Sensor&Flash Drivers"
    default n
    ---help---
      This is the camera sensor&flash driver based on hi6210.

if VIDEO_HI6210_CAMERA_SENSOR

config HI6210_CAMERA_FLASH
	tristate "Hisilicon K3 flash"
	depends on VIDEO_HI6210_CAMERA && VIDEO_HIK3_ISP_CAMERA
	default n
	---help---
	Hisilicon K3 flash driver
	

config HI6210_CAMERA_FLASH_LM3642
	tristate "lm3642 flash"
	depends on VIDEO_HIK3_ISP_CAMERA && HI6210_CAMERA_FLASH
	default n
	---help---
	Hisilicon K3 flash driver
	

config HI6210_CAMERA_FLASH_TPS61310
	tristate "tps61310 flash"
	depends on VIDEO_HIK3_ISP_CAMERA && HI6210_CAMERA_FLASH
	default n
	---help---
	Hisilicon K3 flash driver

config HI6210_CAMERA_FLASH_SCHARGER
	tristate "scharger flash"
	depends on VIDEO_HIK3_ISP_CAMERA && HI6210_CAMERA_FLASH
	default n
	---help---
	Hisilicon K3 flash driver
	
config HI6210_CAMERA_OV5642
    tristate "OV5642 camera"
    depends on VIDEO_HI6210_CAMERA && VIDEO_HIK3_ISP_CAMERA
    default n
    ---help---
        HiOV5642 camera driver

config HI6210_CAMERA_OV8830
    tristate "OV8830 camera"
    depends on VIDEO_HI6210_CAMERA && VIDEO_HIK3_ISP_CAMERA
    default n
    ---help---
        HiOV8830 camera driver

config HI6210_CAMERA_OV8850
    tristate "OV8850 camera"
    depends on VIDEO_HI6210_CAMERA && VIDEO_HIK3_ISP_CAMERA
    default n
    ---help---
        HiOV8850 camera driver

config HI6210_CAMERA_OV5648_SUNNY
    tristate "OV5648_SUNNY camera"
    depends on VIDEO_HI6210_CAMERA && VIDEO_HIK3_ISP_CAMERA
    default n
    ---help---
        OV5648_SUNNY camera driver

config HI6210_CAMERA_OV5648_FOXCONN
    tristate "OV5648_foxconn camera"
    depends on VIDEO_HI6210_CAMERA && VIDEO_HIK3_ISP_CAMERA
    default n
    ---help---
        OV5648_FOXCONN camera driver

config HI6210_CAMERA_SONYIMX134
    tristate "SONYIMX134 camera"
    depends on VIDEO_HI6210_CAMERA && VIDEO_HIK3_ISP_CAMERA
    default n
    ---help---
        HiSONYIMX134 camera driver

config HI6210_CAMERA_SONYIMX135
    tristate "SONYIMX135 camera"
    depends on VIDEO_HI6210_CAMERA && VIDEO_HIK3_ISP_CAMERA
    default n
    ---help---
        HiSONYIMX135 camera driver

config HI6210_CAMERA_SONYIMX179
    tristate "SONYIMX179 camera"
    depends on VIDEO_HI6210_CAMERA && VIDEO_HIK3_ISP_CAMERA
    default n
    ---help---
        HiSONYIMX179 camera driver

config HI6210_CAMERA_SONYIMX214
    tristate "SONYIMX214 camera"
    depends on VIDEO_HI6210_CAMERA && VIDEO_HIK3_ISP_CAMERA
    default n
    ---help---
        HiSONYIMX214 camera driver

config HI6210_CAMERA_S5K4E1GA_FOXCONN
    tristate "S5K4E1GA_FOXCONN camera"
    depends on VIDEO_HI6210_CAMERA && VIDEO_HIK3_ISP_CAMERA
    default n
    ---help---
        S5K4E1GA_FOXCONN camera driver
	
config HI6210_CAMERA_S5K4E1GX_FOXCONN
    tristate "S5K4E1GX_FOXCONN camera"
    depends on VIDEO_HI6210_CAMERA && VIDEO_HIK3_ISP_CAMERA
    default n
    ---help---
        S5K4E1GX_FOXCONN camera driver

config HI6210_CAMERA_S5K4E1GA_SUNNY
    tristate "S5K4E1GA_SUNNY camera"
    depends on VIDEO_HI6210_CAMERA && VIDEO_HIK3_ISP_CAMERA
    default n
    ---help---
        S5K4E1GA_SUNNY camera driver

config HI6210_CAMERA_OV13850
    tristate "OV13850 camera"
    depends on VIDEO_HI6210_CAMERA && VIDEO_HIK3_ISP_CAMERA
    default n
    ---help---
        OV13850 camera driver
        
config HI6210_CAMERA_OV13850_LITEON_171
    tristate "OV13850_LITEON_171 camera"
    depends on VIDEO_HI6210_CAMERA && VIDEO_HIK3_ISP_CAMERA
    default n
    ---help---
        OV13850_LITEON_171 camera driver        

config HI6210_CAMERA_SONYIMX328
    tristate "SONYIMX328 camera"
    depends on VIDEO_HI6210_CAMERA && VIDEO_HIK3_ISP_CAMERA
    default n
    ---help---
        SONYIMX328 camera driver

config HI6210_CAMERA_SONYIMX328_171
    tristate "SONYIMX328_171 camera"
    depends on VIDEO_HI6210_CAMERA && VIDEO_HIK3_ISP_CAMERA
    default n
    ---help---
        SONYIMX328_171 camera driver

config HI6210_CAMERA_OV5648_OFILM
    tristate "OV5648_OFILM camera"
    depends on VIDEO_HI6210_CAMERA && VIDEO_HIK3_ISP_CAMERA
    default n
    ---help---
        OV5648_OFILM camera driver

config HI6210_CAMERA_OV13850_OFILM
    tristate "OV13850_OFILM camera"
    depends on VIDEO_HI6210_CAMERA && VIDEO_HIK3_ISP_CAMERA
    default n
    ---help---
        OV13850_OFILM camera driver

endif
```

## drivers/huawei_platform/camera_legacy/hi6220/flash/Kconfig
```kconfig
#
# Flash Thermal protect configuration
#

config FLASH_THERMAL_PROTECT
	bool "hi6210 flash thermal protect"
	default n
	help
	  close flash when the temperature is too high one time.

config FLASH_THERMAL_PROTECT_CONTINUE
	bool "hi6210 flash thermal protect continuely"
	depends on FLASH_THERMAL_PROTECT
	help
	  close flash when the temperature is too high continuely.
```

## drivers/huawei_platform/chipverification/Kconfig
```kconfig
#sensor unification for differ platform
config HUAWEI_CHIPVERIFICATION_INFO
	bool "huawei chip verification info"
	default n
	help
		get the huawei chip verification information.
```

## drivers/huawei_platform/chr/Kconfig
```kconfig
config CHR_NETLINK_MODULE
	tristate "kernel space communicate with user space use chr netlink socket."
    default y
    help
	  This module adds support for data speed slow detecting funtion based on
	  Balong V3R3 chipset.
```

## drivers/huawei_platform/connectivity/Kconfig
```kconfig
source "drivers/huawei_platform/connectivity/bcm/Kconfig"
source "drivers/huawei_platform/connectivity/hw_connectivity/Kconfig"
source "drivers/huawei_platform/connectivity/hw_gps/Kconfig"
```

## drivers/huawei_platform/connectivity/bcm/Kconfig
```kconfig
source "drivers/huawei_platform/connectivity/bcm/bluetooth/Kconfig"
source "drivers/huawei_platform/connectivity/bcm/gps/Kconfig"
source "drivers/huawei_platform/connectivity/bcm/wifi/Kconfig"
```

## drivers/huawei_platform/connectivity/bcm/bluetooth/Kconfig
```kconfig
menu "Bluetooth device drivers"
	depends on BT

config BT_POWER
    tristate "BCM4334 Bluetooth Power Control"
    depends on RFKILL
    default n
    help
      Provides a parameter to switch on/off power from PMIC
      to Bluetooth device.

config BT_SLEEP
	tristate "BCM4334 Bluesleep driver"
	depends on BT_HCIUART
	default n
	help
	  BCM4334 bluesleep driver.
	  This driver provides support for BTS sleep.

endmenu
```

## drivers/huawei_platform/connectivity/bcm/gps/Kconfig
```kconfig
menuconfig BCMGPS
    tristate "Bcm gps support"
    default n
    help
      Say Y here to enable bcm47531 gps support. This allows
      ap to control this module.

source "drivers/huawei_platform/connectivity/bcm/gps/bcm4752/Kconfig"
source "drivers/huawei_platform/connectivity/bcm/gps/bcm47531/Kconfig"
source "drivers/huawei_platform/connectivity/bcm/gps/bcm4774/Kconfig"
```

## drivers/huawei_platform/connectivity/bcm/gps/bcm4752/Kconfig
```kconfig
menuconfig BCMGPS
	tristate "Bcm4752 gps support"
	default n
	help
	  Say Y here to enable bcm4752 gps support. This allows
	  ap to control this module.
```

## drivers/huawei_platform/connectivity/bcm/gps/bcm47531/Kconfig
```kconfig
menuconfig BCMGPS
	tristate "Bcm47531 gps support"
	default n
	help
	  Say Y here to enable bcm47531 gps support. This allows
	  ap to control this module.
```

## drivers/huawei_platform/connectivity/bcm/gps/lhd/Kconfig
```kconfig
menuconfig BCMGPS
	tristate "Bcm4774 gps support"
	default n
	help
	  Say Y here to enable bcm4774 gps support. This allows
	  ap to control this module.
```

## drivers/huawei_platform/connectivity/bcm/wifi/Kconfig
```kconfig
menu "huawei wifi linux driver"

source "drivers/huawei_platform/connectivity/bcm/wifi/driver/Kconfig"
endmenu
```

## drivers/huawei_platform/connectivity/bcm/wifi/driver/Kconfig
```kconfig
menu "huawei wifi linux driver"

source "drivers/huawei_platform/connectivity/bcm/wifi/driver/bcmdhd/Kconfig"
endmenu
```

## drivers/huawei_platform/connectivity/bcm/wifi/driver/bcmdhd/Kconfig
```kconfig
config BCMDHD
	tristate "Broadcom FullMAC wireless cards support"
	select WIRELESS_EXT
	select WEXT_PRIV
	select WEXT_SPY
	---help---
	  This module adds support for wireless adapters based on
	  Broadcom FullMAC chipset.

	  If you choose to build a module, it'll be called dhd. Say M if
	  unsure.

config BCM4330
	tristate "Broadcom 4330 wireless cards support"
	depends on WLAN
	---help---
	  This module adds support for wireless adapters based on
	  Broadcom 4330 chipset.

config BCM4334
	tristate "Broadcom 4334 wireless cards support"
	depends on WLAN
	---help---
	  This module adds support for wireless adapters based on
	  Broadcom 4334 chipset.

config BCM4335
	tristate "Broadcom 4335 wireless cards support"
	depends on WLAN
	---help---
	  This module adds support for wireless adapters based on
	  Broadcom 4335 chipset.

config BCM4339
	tristate "Broadcom 4339 wireless cards support"
	depends on WLAN
	---help---
	  This module adds support for wireless adapters based on
	  Broadcom 4339 chipset.

config BCM4354
	tristate "Broadcom 4354 wireless cards support"
	depends on WLAN
	---help---
	  This module adds support for wireless adapters based on
	  Broadcom 4354 chipset.

config BCM4343
	tristate "Broadcom 4343 wireless cards support"
	depends on WLAN
	---help---
	  This module adds support for wireless adapters based on
	  Broadcom 4343 chipset.
	  
config BCM43455
	tristate "Broadcom 43455 wireless cards support"
	depends on WLAN
	---help---
	  This module adds support for wireless adapters based on
	  Broadcom 43455 chipset.


config BCM4359
        tristate "Broadcom 4359 wireless cards support"
        depends on WLAN
        ---help---
          This module adds support for wireless adapters based on
          Broadcom 4359 chipset.


config BCMDHD_SDIO
	bool "SDIO bus interface support"
	depends on BCMDHD && MMC
	default y

config BCMDHD_PCIE
	bool "PCIe bus interface support"
	depends on BCMDHD && PCI && !BCMDHD_SDIO

config BCM4354
	tristate "BCM4354 support"
	depends on BCMDHD

config BCM4356
	tristate "BCM4356 support"
	depends on BCMDHD
	default n

config BCM4358
	tristate "BCM4358 support"
	depends on BCMDHD
	default n

config BCMDHD_FW_PATH
	depends on BCMDHD
	string "Firmware path"
	default "/system/vendor/firmware/fw_bcmdhd.bin"
	---help---
	  Path to the firmware file.

config BCMDHD_NVRAM_PATH
	depends on BCMDHD
	string "NVRAM path"
	default "/system/etc/wifi/bcmdhd.cal"
	---help---
	  Path to the calibration file.

config BCMDHD_WEXT
	bool "Enable WEXT support"
	depends on BCMDHD && CFG80211 = n
	select WIRELESS_EXT
	select WEXT_PRIV
	help
	  Enables WEXT support

config DHD_USE_STATIC_BUF
	bool "Enable memory preallocation"
	depends on BCMDHD
	default n
	---help---
	  Use memory preallocated in platform

config DHD_USE_SCHED_SCAN
	bool "Use CFG80211 sched scan"
	depends on BCMDHD && CFG80211
	default n
	---help---
	  Use CFG80211 sched scan

config DHD_SET_RANDOM_MAC_VAL
	hex "Vendor OUI"
	depends on BCMDHD
	default 0x001A11
	---help---
	  Set vendor OUI for SoftAP


config DHD_OF_SUPPORT
	bool "Use in-drive platform device"
	depends on BCMDHD
	default n
config BCM_VIO
	tristate "BCM VIO support"
	depends on BCMDHD

config HW_WIFI_FREQ_CTRL_FLAG
	tristate "wifi dynamic frequency adjust support"
	depends on BCMDHD
```

## drivers/huawei_platform/connectivity/hw_connectivity/Kconfig
```kconfig
menuconfig HWCONNECTIVITY
	tristate "Huawei connectivity OneTrack support"
	default n
	help
	  Say Y here to enable Huawei connectivity OneTrack support. This allows
	  ap to control this module.
```

## drivers/huawei_platform/connectivity/hw_gps/Kconfig
```kconfig
menuconfig HWGPS
    tristate "Huawei gps common driver"
    default y
    help
      Say Y here to enable Huawei gps common driver. This allows
      ap to control this module.
```

## drivers/huawei_platform/devdetect/Kconfig
```kconfig
#
# detect devices
#

config HUAWEI_HW_DEV_DCT
    default y
    bool "HUAWEI DEVICE DETECT"
    help
      Say yes if you want i2c device detect driver.
      This is for i2c connected version. If unsure, say N here.
```

## drivers/huawei_platform/ext_modem/Kconfig
```kconfig
#
# via cbp 8.2 driver configuration
#
config VIACBP82D_3RD_MODEM
	bool "misc via Support"
	default n
	help
	  This allows misc via.
	  If unsure, say n.
```

## drivers/huawei_platform/inputhub/iom7/Kconfig
```kconfig
menuconfig INPUTHUB
	tristate "InputHub feature support"
	depends on SENSORHUB_FEATURE_SUPPORT
	help
	  Say Y here to enable input hub feature support. This allows
	  mcu to manage all sensors.
config IOM3_RECOVERY
	bool "iom3 recovery feature support"
	default n

	help
	  Say 'Y' here if you want to support the cmdline parse
config CYPRESS_PSOC4000
	bool "cypress capsense support"
	default n

	help
	  Say 'Y' here if you want to configure cypress capsense
```

## drivers/huawei_platform/irda/Kconfig
```kconfig
config MAXQ616_POWER_SWITCH
	tristate "CONFIG_MAXQ616_POWER_SWITCH feature support"
	default n
	help
	  Say Y here to enable Infrared remote control feature support.
```
