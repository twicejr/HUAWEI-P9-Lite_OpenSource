## drivers/huawei_platform/lcd/Kconfig
```kconfig
#
# huawei lcd panel driver configuration
#

config HUAWEI_LCD_PANEL
	bool "huawei lcd panel"
	default n
	help
	  If you say yes here you get support for huawei lcd panel.
```

## drivers/huawei_platform/log/Kconfig
```kconfig
#
# Logger extend configuration
#
source "drivers/huawei_platform/log/goldeneye/Kconfig"
source "drivers/huawei_platform/log/boot_log/Kconfig"
source "drivers/huawei_platform/log/log_usertype/Kconfig"

menu "Logger extend configuration"

config LOGGER_EXTEND
	bool "Logger extend support"
	depends on ANDROID_LOGGER
	default n
	---help---
	  Enable support for logger extend

if LOGGER_EXTEND

config LOG_SWITCH
	tristate "log switch feature support"
	depends on HISI_NVE
	default n
	---help---
	  Say Y here to enable log switch feature support. This allows
	  user to control log.

config LOG_EXCEPTION
	bool "log exception feature support"
	default n
	---help---
	  Say Y here to enable log exception feature support. This allows
	  user to send log to remote server by net.

config LOG_JANK
	bool "log jank feature support"
	default n
	---help---
	  Say Y here to enable log jank feature support. This allows
	  user to send log to remote server by net.

endif # if LOGGER_EXTEND

endmenu
```

## drivers/huawei_platform/log/goldeneye/Kconfig
```kconfig
config HUAWEI_GOLDENEYE
	bool "huawei goldeneye watchpoints feature support"
	default n
```

## drivers/huawei_platform/log/log_usertype/Kconfig
```kconfig
config PROC_LOGUSERTYPE
       bool "/proc/log-usertype support"
       default y
       help
       set beta or commercial version to kernel.
```

## drivers/huawei_platform/nfc/Kconfig
```kconfig
menuconfig NFC_DEVICES
	bool "Near Field Communication (NFC) devices"
	default n
	---help---
	  You'll have to say Y if your computer contains an NFC device that
	  you wtant to use under Linux.

	  You can say N here if you don't have any Near Field Communication
	  devices connected to your computer.


source "drivers/huawei_platform/nfc/NXP_PN547_64/Kconfig"
source "drivers/huawei_platform/nfc/nfc_bcm20793/Kconfig"
```

## drivers/huawei_platform/nfc/NXP_PN547_64/Kconfig
```kconfig
#
# Near Field Communication (NFC) devices
#
config PN547_NFC_64
	tristate "PN547 NFC driver"
	depends on I2C
	select CRC_CCITT
	default n
	---help---
	  Say yes if you want PN547 Near Field Communication driver.
	  This is for i2c connected version. If unsure, say N here.

	  To compile this driver as a module, choose m here. The module will
	  be called pn547.

config FIFA_NFC_CLK
	tristate "PN547 NFC driver clock"
	default n
	---help---
	  JUST on k3v3+ product board

config V8R2_NFC
	tristate "PN547 NFC VEN USE GPIO_CTL"
	default n
	---help---
	  JUST on V8R2 product board
```

## drivers/huawei_platform/nfc/nfc_bcm20793/Kconfig
```kconfig
#
# Near Field Communication (NFC) devices
#

config BCM20793_NFC
	tristate "BCM20793 NFC driver"
	depends on I2C
	default n 
	---help---
	  Say yes if you want BCM20791 Near Field Communication driver.
	  This is for i2c connected version. If unsure, say N here.

	  To compile this driver as a module, choose m here. The module will
	  be called bcm2079x.
```

## drivers/huawei_platform/ocp/Kconfig
```kconfig
#
# huawei device ocp configuration
#

config HUAWEI_OCP
	bool "huawei ocp"
	default n
	help
	  If you say yes here you get support for huawei ocp.
```

## drivers/huawei_platform/power/Kconfig
```kconfig
source "drivers/huawei_platform/power/charger/Kconfig"
source "drivers/huawei_platform/power/hw_kstate/Kconfig"
source "drivers/huawei_platform/power/ate/Kconfig"
source "drivers/huawei_platform/power/bastet/Kconfig"
source "drivers/huawei_platform/power/smpl/Kconfig"
source "drivers/huawei_platform/power/msgnotify/Kconfig"
source "drivers/huawei_platform/power/usb_short_circuit_protect/Kconfig"
source "drivers/huawei_platform/power/cpu_buck/Kconfig"
source "drivers/huawei_platform/power/water_check/Kconfig"
```

## drivers/huawei_platform/power/ate/Kconfig
```kconfig
config INPUT_HW_ATE
        tristate "huawei automatic test engine"
        help
          Say Y here if you want use the funtion of huawei automatic test engine.

          If unsure, say N.

          To compile this driver as a module, choose M here: the
          module will be called ate.
```

## drivers/huawei_platform/power/bastet/Kconfig
```kconfig
menu "Huawei Bastet Support"
	depends on INET && NETFILTER

config HUAWEI_BASTET
	tristate "Huawei Bastet support"
	default n
	---help---
	  This driver provides TCP sequence sync, traffic flow correction, etc. for Huawei Bastet.

config BASTET_BALONG_COMM
	bool "Bastet Balong comm driver support"
	depends on HUAWEI_BASTET && (HISI_BALONG_MODEM_HI3XXX || HISI_BALONG_MODEM_HI6XXX || HISI_BALONG_MODEM_HI3650)
	default y
	---help---
	  This driver provides Balong modem comm interface for Huawei Bastet.

endmenu
```

## drivers/huawei_platform/power/charger/Kconfig
```kconfig
config HUAWEI_CHARGER
	bool "huawei charger"
	default n
config BQ2419X_CHARGER
	bool "bq2419x charger"
	default n
config BQ2429X_CHARGER
	bool "bq2429x charger"
	default n
config BQ25892_CHARGER
	bool "bq25892 charger"
	default n
config DUAL_CHARGER
	bool "dual charger"
	default n
```

## drivers/huawei_platform/power/cpu_buck/Kconfig
```kconfig
config HUAWEI_CPU_BUCK
	bool "huawei cpu_buck"
	default n
config HUAWEI_LP8758
	bool "huawei lp8758"
	default n
config HI6422V100
	bool "hi6422v100"
	default n
```

## drivers/huawei_platform/power/hw_kstate/Kconfig
```kconfig
config HUAWEI_KSTATE
    tristate "Huawei Kernel State"
    help
        Huawei kernel state, please choose it.
```

## drivers/huawei_platform/power/msgnotify/Kconfig
```kconfig
config HUAWEI_MSG_POLICY
	bool "Huawei msg policy"
	default n
	help
	   huawei msg policy
```

## drivers/huawei_platform/power/usb_short_circuit_protect/Kconfig
```kconfig
config HUAWEI_USB_SHORT_CIRCUIT_PROTECT
	bool "huawei usb short circuit protect"
	default n
```

## drivers/huawei_platform/sensor/Kconfig
```kconfig
#sensor unification for differ platform
config HUAWEI_SENSORS_INPUT_INFO
	bool "huawei sensor input info"
	depends on !SENSORHUB_FEATURE_SUPPORT
	default n
	help
		get the huawei sensor input information.

source "drivers/huawei_platform/sensor/accelerometer/Kconfig"
source "drivers/huawei_platform/sensor/light/Kconfig"
source "drivers/huawei_platform/sensor/compass/Kconfig"
source "drivers/huawei_platform/sensor/hall/Kconfig"
source "drivers/huawei_platform/sensor/hall_inputhub/Kconfig"
source "drivers/huawei_platform/sensor/fingerprint/Kconfig"
```

## drivers/huawei_platform/sensor/accelerometer/Kconfig
```kconfig
#
# accelerometer driver configuration
#

menuconfig INPUT_ACCELEROMETER
	bool "Accelerometer"
	depends on !SENSORHUB_FEATURE_SUPPORT
	select HUAWEI_SENSORS_INPUT_INFO
	default n
	help
		Say Y here, and a list of supported ACCELEROMETERs will be displayed.
		This option doesn't affect the kernel.



if INPUT_ACCELEROMETER

config HUAWEI_FEATURE_SENSORS_ACCELEROMETER_ST_LIS3XH
	tristate "ST LIS3DH and LIS331DLH accelerometer"
	select SERIO
	default n
	help
		Say Y here if you have the ST LIS3DH and LIS331DLH accelerometer.
config HUAWEI_FEATURE_SENSORS_ACCELEROMETER_ROHM_KX023
	tristate "ROHM KX023 accelerometer"
	select SERIO
	default n
	help
		Say Y here if you have the ROHM KX023 accelerometer.
config GSENSOR_DEBUG
	bool "gsensor debugging messages"
	default n
	help
		Say Y here if you want the gsensor to produce a bunch of debug
		messages to the system log.  Select this if you are having a
		problem with gsensor and want to see more of what is going on.

endif
```

## drivers/huawei_platform/sensor/compass/Kconfig
```kconfig
#
# compass driver configuration
#
menuconfig INPUT_COMPASS
	bool "Compass"
	depends on !SENSORHUB_FEATURE_SUPPORT
	select HUAWEI_SENSORS_INPUT_INFO
	default n
	help
		Say Y here, and a list of supported COMPASSs will be displayed.
		This option doesn't affect the kernel.



if INPUT_COMPASS

config HUAWEI_FEATURE_SENSORS_AKM09911
	tristate "AKM09911"
	default n
	depends on I2C
	help
		If you say yes here you get support for Asahi Kasei's
		orientation sensor AKM09911.

config COMPASS_DEBUG
	bool "compass debugging messages"
	default n
	help
		Say Y here if you want the compass to produce a bunch of debug
		messages to the system log.  Select this if you are having a
		problem with compass and want to see more of what is going on.

endif
```
