## drivers/huawei_platform/sensor/fingerprint/Kconfig
```kconfig
config FINGERPRINT
	tristate "fingerprint"
	default n
	help
		If you say yes here you get support for fingerprint.
```

## drivers/huawei_platform/sensor/hall/Kconfig
```kconfig
#
# hall sensor driver configuration
#
config HUAWEI_FEATURE_AK8789
	tristate "ak8789_hall"
	depends on !SENSORHUB_FEATURE_SUPPORT
	default n
	help
	  If you say yes here you get support for light hall ak8789.
```

## drivers/huawei_platform/sensor/hall_inputhub/Kconfig
```kconfig
#
# hall sensor driver configuration
#
config HUAWEI_HALL_INPUTHUB
	tristate "ak8789_hall"
	default n 
	help
	  If you say yes here you get support for light hall ak8789.
```

## drivers/huawei_platform/sensor/light/Kconfig
```kconfig
#
# light sensor driver configuration
#
menuconfig INPUT_LIGHT_SENSOR
	bool "light sensor"
	depends on !SENSORHUB_FEATURE_SUPPORT
	select HUAWEI_SENSORS_INPUT_INFO
	default n
	help
		Say Y here, and a list of supported light sensors will be displayed.
		This option doesn't affect the kernel.


if INPUT_LIGHT_SENSOR

config HUAWEI_FEATURE_PROXIMITY_APDS990X
	tristate "apds990x"
	default n
	help
		If you say yes here you get support for light sensor apds990x.
config HUAWEI_FEATURE_PROXIMITY_RPR0521
	tristate "rpr0521"
	depends on !SENSORHUB_FEATURE_SUPPORT
	default n
	help
		If you say yes here you get support for light sensor rpr0521.
config PROXIMITY_LIGHT_DEBUG
	bool "proximity and light debugging messages"
	default n
	help
		Say Y here if you want the proximity and the light to produce a bunch of debug
		messages to the system log.  Select this if you are having a
		problem with proximity or light and want to see more of what is going on.
endif
```

## drivers/huawei_platform/storage/ddrinfo/Kconfig
```kconfig
config DDR_INFORMATION
	bool "DDR Information"
	default n
	help
		get ddr information.
```

## drivers/huawei_platform/touthscreen/Kconfig
```kconfig
#
# huawei touchscreen driver configuration
#

config HUAWEI_TS
	bool "huawei touchscreen"
	default n
	help
	  If you say yes here you get support for huawei touchscreen.
	  
config HUAWEI_TS_TEST
	bool "huawei touchscreen test"
	default n
	help
	  If you say yes here you get support for huawei touchscreen.

source "drivers/huawei_platform/touthscreen/panel/Kconfig"
source "drivers/huawei_platform/touthscreen/panel/cyttsp5/Kconfig"

#sensor unification for differ platform
menu "huawei linux device driver support package"
config HUAWEI_TP_COLOR_INFO
	bool "huawei tp color info"
	default n
	help
		get the huawei tp color information.
endmenu
#different product firmware
config VIE_TOUCH_FW
	bool "vie touchscreen firmware"
	default n
	help
	  If you say yes here you get support for huawei touchscreen.
config EVA_TOUCH_FW
	bool "eva touchscreen firmware"
	default n
	help
	  If you say yes here you get support for huawei touchscreen.
config NEXT_TOUCH_FW
	bool "next touchscreen firmware"
	default n
	help
	  If you say yes here you get support for huawei touchscreen.
config KNIGHT_TOUCH_FW
	bool "knight touchscreen firmware"
	default n
	help
	  If you say yes here you get support for huawei touchscreen.
config NEMO_TOUCH_FW
        bool "nemo touchscreen firmware"
        default n
        help
          If you say yes here you get support for huawei touchscreen.
config VENUS_TOUCH_FW
        bool "venus touchscreen firmware"
        default n
        help
          If you say yes here you get support for huawei touchscreen.
config FRD_TOUCH_FW
	bool "frd touchscreen firmware"
	default n
	help
	  If you say yes here you get support for huawei touchscreen.
config EDISON_TOUCH_FW
	bool "edison touchscreen firmware"
	default n
	help
	  If you say yes here you get support for huawei touchscreen.
```

## drivers/huawei_platform/touthscreen/panel/Kconfig
```kconfig
#
# huawei touchscreen driver configuration
#

config SYNAPTICS_TS
	bool "synaptics touchscreen"
	default n
	help
	  If you say yes here you get support for synaptics touchscreen.
config SYNAPTICS_LCD_TYPE
	bool "synaptics touchscreen"
	default n
	help
	  If you say yes here you get support for synaptics touchscreen.
config CYPRESS_TS
	bool "cypress touchscreen"
	default n
	help
	  If you say yes here you get support for cypress touchscreen.
config ATMEL_TS
	bool "atmel touchscreen"
	default n
	help
	  If you say yes here you get support for atmel touchscreen.
config HIDEEP_TS
	bool "hideep crimson touchscreen"
	default n
	help
	  If you say yes here you get support for hideep touchscreen.
```

## drivers/huawei_platform/uid_iostats/Kconfig
```kconfig
#
# HUAWEI UID IOSTATS
#

config HUAWEI_UID_IO_STATS
	tristate "Per-UID io account statistics"
	default n
	depends on PROFILING && TASK_IO_ACCOUNTING
	help
	  Per UID based io account statistics exported to /proc/uid_iostats
```

## drivers/huawei_platform/usb/Kconfig
```kconfig
source "drivers/huawei_platform/usb/switch/Kconfig" 
source "drivers/huawei_platform/usb/otg_gpio_switch/Kconfig"
source "drivers/huawei_platform/usb/typec/Kconfig"
```

## drivers/huawei_platform/usb/otg_gpio_switch/Kconfig
```kconfig
menuconfig SWITCH
	tristate "Switch class support"
	help
	  Say Y here to enable switch class support. This allows
	  monitoring switches by userspace via sysfs and uevent.

if SWITCH

config SWITCH_OTGID_GPIO
	tristate "SWITCH_OTGID_GPIO"
	depends on GPIOLIB
	help
	  Say Y here to enable GPIO based switch support.

endif # SWITCH
```

## drivers/huawei_platform/usb/switch/Kconfig
```kconfig
menuconfig SWITCH
	tristate "Switch class support"
	help
	  Say Y here to enable switch class support. This allows
	  monitoring switches by userspace via sysfs and uevent.

if SWITCH

config SWITCH_GPIO
	tristate "GPIO Swith support"
	depends on GPIOLIB
	help
	  Say Y here to enable GPIO based switch support.

# I2C SWITCH_CHIP driver configuration
config SWITCH_FSA9685
	tristate "SWITCH_FSA9685"
	depends on GPIOLIB && I2C
	help
	  If you say yes here you get support for SWITCH_FSA9685.
endif # SWITCH

menuconfig SWITCH_USB
	tristate "Switch usb support"
	help
	  Say Y here to enable switch usb class support. This allows
	  monitoring usb switches by userspace via sysfs.

config SWITCH_USB_CLS
	tristate "USB Switch class support"
	depends on GPIOLIB
	help
	  Say Y here to enable USB based switch class support.

config FSA9685_DEBUG_FS
	tristate "FSA9685_DEBUG_FS"
	default y
	help
	  If you say yes here you get support for SWITCH_FSA9685.
```

## drivers/huawei_platform/usb/typec/Kconfig
```kconfig
config HUAWEI_TYPEC
	tristate "typec connector"
	depends on GPIOLIB && I2C
	default n
	help
	  Say Y here to enable Type C Connector support.

config DUAL_ROLE_USB_INTF
	bool "Generic DUAL ROLE sysfs interface"
	depends on SYSFS && USB_PHY
	help
		A generic sysfs interface to track and change the state of
		dual role usb phys. The usb phy drivers can register to
		this interface to expose it capabilities to the userspace
		and thereby allowing userspace to change the port mode.

source "drivers/huawei_platform/usb/typec/pericom30216/Kconfig"
source "drivers/huawei_platform/usb/typec/tusb320/Kconfig"
source "drivers/huawei_platform/usb/typec/fusb301/Kconfig"
source "drivers/huawei_platform/usb/typec/ptn5150h/Kconfig"
```

## drivers/huawei_platform/usb/typec/fusb301/Kconfig
```kconfig
# Fairchild Type C Connector

config HUAWEI_TYPEC_FUSB301
	tristate "fusb301 typec connector"
	depends on GPIOLIB && I2C
	default n
	help
	  Say Y here to enable fusb301 Type C Connector support.
```

## drivers/huawei_platform/usb/typec/pericom30216/Kconfig
```kconfig
# Pericom Type C Connector

config HUAWEI_TYPEC_PERICOM30216
	tristate "pericom30216 typec connector"
	depends on GPIOLIB && I2C
	default n
	help
	  Say Y here to enable Pericom30216 Type C Connector support.
```

## drivers/huawei_platform/usb/typec/ptn5150h/Kconfig
```kconfig
# Nxp Type C Connector

config HUAWEI_TYPEC_PTN5150H
	tristate "ptn5150h typec connector"
	depends on GPIOLIB && I2C
	default n
	help
	  Say Y here to enable ptn5150h Type C Connector support.
```

## drivers/huawei_platform/usb/typec/tusb320/Kconfig
```kconfig
# TI Type C Connector

config HUAWEI_TYPEC_TUSB320
	tristate "tusb320 typec connector"
	depends on GPIOLIB && I2C
	default n
	help
	  Say Y here to enable tusb320 Type C Connector support.
```

## drivers/hwtc/Kconfig
```kconfig
#
# huawei trace counter configuration
#

config HWTC
	bool "hwtc"
	default n
	help
	  If you say yes here you get support for huawei trace counter.
```

## drivers/hwusb/hw_gadget/Kconfig
```kconfig
menuconfig HW_GADGET
	tristate "huawei gadget class support"
	default y
	help
	  Say Y here to enable hw gadget feature. 
```

## drivers/input/touchscreen/shtsc/Kconfig
```kconfig
config TOUCHSCREEN_SHTSC
	tristate "SHARP touchscreen controllers"
	help
	  SHARP touchscreen controller driver.
	  Do not forget to define either TOUCHSCREEN_SHTSC_I2C or TOUCHSCREEN_SHTSC_SPI
	  (now supports LR388K5 i2c mode only)

config TOUCHSCREEN_SHTSC_I2C
	tristate "SHARP touchscreen driver for I2C"
	depends on I2C
	help
	  SHARP I2C touchscreen driver

config TOUCHSCREEN_SHTSC_SPI
	tristate "SHARP touchscreen driver for SPI"
	depends on SPI_MASTER
	help
	  SHARP SPI touchscreen driver
```

## drivers/iommu/hisi/Kconfig
```kconfig
# Hisilicon IOMMU support

config HISI_IODOMAIN_API
	bool

config HISI_IOMMU
	bool "Hisilicon IOMMU Support"
	select IOMMU_API
	help
	  Hisilicon IOMMU Support.

config HISI_IOMMU_LPAE
	bool "Hisilicon IOMMU LPAE Support"
	select IOMMU_API
	help
	  Hisilicon IOMMU Support.

config HISI_IOMMU_TEST
	bool "Hisilicon IOMMU TEST Support"
	depends on HISI_IOMMU_LPAE
	select IOMMU_API
	help
	  Hisilicon IOMMU Support.
```

## drivers/media/huawei/Kconfig
```kconfig
comment "Huawei Multimedia"

menuconfig HUAWEI_CAMERA
    bool "Huawei camera and video capture support"
    default y
    select ION
    select MEDIA_CONTROLLER 
    select VIDEOBUF2_CORE
    select VIDEO_V4L2
    help
        Say Y here to enable selecting the video adapters for
        Huawei camera
	
menuconfig ION_FOR_EMULATOR
     bool "Huawei camera and video support for emulator"	
     default n
     select ION
     help
        Say Y here to enable selecting the video adapters for
        Huawei camera emulator

config USE_CAMERA3_ARCH
    tristate "Support Camera3 driver"
    depends on HUAWEI_CAMERA
    default n
    ---help---
        Hisilicon K3 camera3 driver.

	
if HUAWEI_CAMERA
source "drivers/media/huawei/camera/Kconfig"
endif
```

## drivers/media/huawei/camera/Kconfig
```kconfig
comment "Huawei Camera"

# source "drivers/media/huawei/camera/isp/Kconfig"
source "drivers/media/huawei/camera/hisp/Kconfig"
source "drivers/media/huawei/camera/sensor/Kconfig"

source "drivers/media/huawei/camera/platform/hi3650/Kconfig"
source "drivers/media/huawei/camera/platform/hi3635/Kconfig"
source "drivers/media/huawei/camera/platform/hi6250/Kconfig"

menuconfig HUAWEI_CAMERA_USE_EXTISP
    bool "Huawei external ISP support"
    default n
    select SPI
    help
        Say Y here to enable external ISP for Huawei camera

config HISI_CAMERA_HISTAR_ISPV100
    tristate "Support histar ispv100 driver"
    depends on HUAWEI_CAMERA
    default n
    ---help---
        Hisilicon histar ispv100 driver.

config HISI_CAMERA_HISTAR_ISPV110
    tristate "Support histar ispv110 driver"
    depends on HUAWEI_CAMERA
    default n
    ---help---
        Hisilicon histar ispv110 driver.

if HUAWEI_CAMERA_USE_EXTISP
source "drivers/media/huawei/camera/extisp/Kconfig"
endif
```
