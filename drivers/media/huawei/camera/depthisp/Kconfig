## drivers/media/huawei/camera/depthisp/Kconfig
```kconfig
comment "Huawei External Depth ISP"

choice
	prompt "External Depth ISP"
	default HUAWEI_CAMERA_USE_ALD2
	depends on HUAWEI_CAMERA && HUAWEI_CAMERA_USE_DEPTHISP
	help
        Select external ISP version. 

config HUAWEI_CAMERA_USE_ALTEK6045
    bool "Huawei external Depth ISP support"
    select SPI

endchoice
```

## drivers/media/huawei/camera/extisp/Kconfig
```kconfig
comment "Huawei External ISP"

choice
	prompt "External ISP Version"
	default HUAWEI_CAMERA_USE_ALTEK6045
	depends on HUAWEI_CAMERA && HUAWEI_CAMERA_USE_EXTISP
	help
        Select external ISP version. 

config HUAWEI_CAMERA_USE_ALTEK6045
    bool "Huawei external ISP support"
    select SPI

endchoice
```

## drivers/media/huawei/camera/hisp/Kconfig
```kconfig
comment "HISI ISP"


if HISI_CAMERA_HISTAR_ISPV100
source "drivers/media/huawei/camera/hisp/hisp100/Kconfig"
endif

if HISI_CAMERA_HISTAR_ISPV110
source "drivers/media/huawei/camera/hisp/hisp110/Kconfig"
endif
```

## drivers/media/huawei/camera/hisp/hisp110/Kconfig
```kconfig
comment "HISI ISP"

choice
	prompt "HISP Version"
	default HUAWEI_CAMERA_USE_HISP110
	depends on HUAWEI_CAMERA
	help
        Select ISP version.

config HUAWEI_CAMERA_USE_HISP110
	bool "HISP110"
	depends on HUAWEI_CAMERA

endchoice
```

## drivers/media/huawei/camera/isp/Kconfig
```kconfig
comment "Huawei ISP"

choice
	prompt "ISP Version"
	default HUAWEI_CAMERA_USE_OVISP23
	depends on HUAWEI_CAMERA
	help
        Select ISP version. 

config HUAWEI_CAMERA_USE_FAKE_ISP
	bool "fake isp for emulator"
	depends on HUAWEI_CAMERA

config HUAWEI_CAMERA_USE_OVISP23
	bool "OVISP2.3"
	depends on HUAWEI_CAMERA

config HUAWEI_CAMERA_USE_OVISP22
	bool "OVISP2.2"
	depends on HUAWEI_CAMERA

config HUAWEI_CAMERA_USE_OVISP20
	bool "OVISP2.0"
	depends on HUAWEI_CAMERA

endchoice
```

## drivers/media/huawei/camera/laser/Kconfig
```kconfig
if HISI_CAMERA_LASER

menu "st camera laser driver support"

config HISI_CAMERA_VL53L0
    tristate "vl53l0 camera laser driver"
    depends on HISI_CAMERA_LASER
    default n
    ---help---
        vl53l0 camera laser driver

endmenu

endif
```

## drivers/media/huawei/camera/platform/hi3635/Kconfig
```kconfig
comment "Huawei Sensor"

source "drivers/media/huawei/camera/sensor/vcm/Kconfig"
source "drivers/media/huawei/camera/sensor/flash/Kconfig"
source "drivers/media/huawei/camera/sensor/ois/Kconfig"

config HUAWEI_CAMERA_USE_FAKE_SENSOR
	bool "fake sensor for emulator"
    default n
	depends on HUAWEI_CAMERA

config HUAWEI_CAMERA_USE_IMX135
	bool "imx135"
    default n
	depends on HUAWEI_CAMERA

config HUAWEI_CAMERA_USE_IMX214
	bool "imx214"
    default y
	depends on HUAWEI_CAMERA

config HUAWEI_CAMERA_USE_IMX278
	bool "imx278"
    default y
	depends on HUAWEI_CAMERA
	
config HUAWEI_CAMERA_USE_IMX278_DAVINCE
	bool "imx278_davince"
    default y
	depends on HUAWEI_CAMERA

config HUAWEI_CAMERA_USE_IMX278_CARRERA
	bool "imx278_carrera"
    default y
	depends on HUAWEI_CAMERA

config HUAWEI_CAMERA_USE_IMX179
	bool "imx179"
    default y
	depends on HUAWEI_CAMERA

config HUAWEI_CAMERA_USE_IMX179_CARRERA
	bool "imx179_carrera"
    default y
	depends on HUAWEI_CAMERA

config HUAWEI_CAMERA_USE_OV8865
	bool "ov8865"
    default y
	depends on HUAWEI_CAMERA
	
config HUAWEI_CAMERA_USE_OV8865_CARRERA
	bool "ov8865_carrera"
    default y
	depends on HUAWEI_CAMERA

config HUAWEI_CAMERA_USE_IMX214_SUNNY
	bool "imx214_sunny"
    default y
	depends on HUAWEI_CAMERA


config HUAWEI_CAMERA_USE_OV5648
	bool "ov5648"
    default y
	depends on HUAWEI_CAMERA

config HUAWEI_CAMERA_USE_OV5648_X1S
	bool "ov5648_x1s"
    default y
	depends on HUAWEI_CAMERA

config HUAWEI_CAMERA_USE_IMX179_REAR
	bool "imx179_rear"
    default y
	depends on HUAWEI_CAMERA

config HUAWEI_CAMERA_USE_IMX179_FRONT
	bool "imx179_front"
    default y
	depends on HUAWEI_CAMERA

config HUAWEI_CAMERA_USE_OV8865_REAR
	bool "ov8865_rear"
    default y
	depends on HUAWEI_CAMERA

config HUAWEI_CAMERA_USE_IMX328
	bool "imx328"
    default y
	depends on HUAWEI_CAMERA
	
config HUAWEI_CAMERA_USE_OV13850
	bool "ov13850"
    default y
	depends on HUAWEI_CAMERA

config HUAWEI_CAMERA_USE_S5K4E1GA
	bool "s5k4e1ga"
    default y
	depends on HUAWEI_CAMERA

config HUAWEI_CAMERA_USE_OV2680
	bool "ov2680"
    default y
	depends on HUAWEI_CAMERA

config HUAWEI_CAMERA_USE_MT9D015
	bool "mt9d015"
    default y
	depends on HUAWEI_CAMERA

config HUAWEI_CAMERA_USE_IMX219
	bool "imx219"
    default y
	depends on HUAWEI_CAMERA

config HUAWEI_CAMERA_USE_OV8858
	bool "ov8858"
    default y
	depends on HUAWEI_CAMERA

config HISI_CAMERA_FLASH
	tristate "hisi_flash"
    default y
	depends on HUAWEI_CAMERA

config HUAWEI_CAMERA_USE_IMX179_PLK
	bool "imx179_plk"
    default y
	depends on HUAWEI_CAMERA

config HUAWEI_CAMERA_USE_IMX230_PLK
	bool "imx230_plk"
    default y
	depends on HUAWEI_CAMERA
```

## drivers/media/huawei/camera/platform/hi3650/Kconfig
```kconfig
comment "Huawei Sensor"

source "drivers/media/huawei/camera/sensor/vcm/Kconfig"
source "drivers/media/huawei/camera/sensor/flash/Kconfig"
source "drivers/media/huawei/camera/sensor/ois/Kconfig"

config HUAWEI_CAMERA_USE_IMX230
	bool "imx230"
    default y
	depends on HUAWEI_CAMERA

config HUAWEI_CAMERA_USE_IMX278
	bool "imx278"
    default y
	depends on HUAWEI_CAMERA

config HUAWEI_CAMERA_USE_IMX214
	bool "imx214"
    default y
	depends on HUAWEI_CAMERA

config HUAWEI_CAMERA_USE_IMX179
	bool "imx179"
    default y
	depends on HUAWEI_CAMERA

config HUAWEI_CAMERA_USE_IMX298
	bool "imx298"
    default y
	depends on HUAWEI_CAMERA

config HUAWEI_CAMERA_USE_OV8865
	bool "ov8865"
    default y
	depends on HUAWEI_CAMERA

config HUAWEI_CAMERA_USE_HI843
        bool "hi843"
    default y
        depends on HUAWEI_CAMERA

config HUAWEI_CAMERA_USE_OV8856
        bool "ov8856"
    default y
        depends on HUAWEI_CAMERA

config HUAWEI_CAMERA_USE_IMX219
        bool "imx219"
    default y
        depends on HUAWEI_CAMERA
config CONFIG_HUAWEI_CAMERA_USE_IMX286DUAL_GAL
        bool "imx286dualgal"
    default y
        depends on HUAWEI_CAMERA
```

## drivers/media/huawei/camera/platform/hi6250/Kconfig
```kconfig
comment "Huawei Sensor"

source "drivers/media/huawei/camera/sensor/vcm/Kconfig"
source "drivers/media/huawei/camera/sensor/flash/Kconfig"
source "drivers/media/huawei/camera/sensor/ois/Kconfig"

config HUAWEI_CAMERA_USE_IMX214
	bool "imx214"
    default y
	depends on HUAWEI_CAMERA

config HUAWEI_CAMERA_USE_IMX219
	bool "imx219"
    default y
	depends on HUAWEI_CAMERA

config HUAWEI_CAMERA_USE_OV13850
	bool "ov13850"
    default y
	depends on HUAWEI_CAMERA

config HUAWEI_CAMERA_USE_OV8856
	bool "ov8856"
    default y
	depends on HUAWEI_CAMERA

config HUAWEI_CAMERA_USE_HI843
	bool "hi843"
    default y
	depends on HUAWEI_CAMERA

config HUAWEI_CAMERA_USE_T4KA3
	bool "t4ka3"
    default y
	depends on HUAWEI_CAMERA

config HUAWEI_CAMERA_USE_AR1335
	bool "ar1335"
    default y
	depends on HUAWEI_CAMERA
```

## drivers/media/huawei/camera/sensor/Kconfig
```kconfig
comment "Huawei Sensor"

source "drivers/media/huawei/camera/sensor/vcm/Kconfig"
source "drivers/media/huawei/camera/sensor/flash/Kconfig"
source "drivers/media/huawei/camera/sensor/ois/Kconfig"
```

## drivers/media/huawei/camera/sensor/flash/Kconfig
```kconfig
if HISI_CAMERA_FLASH

menu "Hisilicon camera flash driver support"

config HISI_CAMERA_TPS61310
    tristate "TPS61310 camera flash driver"
    depends on HISI_CAMERA_FLASH
    default n
    ---help---
        TPS61310 camera flash driver

config HISI_CAMERA_LM3642
    tristate "LM3642 camera flash driver"
    depends on HISI_CAMERA_FLASH
    default n
    ---help---
        LM3642 camera flash driver

config HISI_CAMERA_LM3646_FRONT
    tristate "LM3646 FRONT control camera flash driver"
    depends on HISI_CAMERA_FLASH
    default n
    ---help---
        LM3646 front camera flash driver

config HISI_CAMERA_LM3646
    bool "LM3642 camera flash driver"    
    default n
    depends on HISI_CAMERA_FLASH    

config HISI_CAMERA_PMU_LED
    tristate "PMU LED camera flash driver"
    depends on HISI_CAMERA_FLASH
    default n
    ---help---
        PMU LED camera flash driver

config HISI_CAMERA_SCHARGER
    bool "LM3642 camera flash driver"
    default n
    depends on HISI_CAMERA_FLASH

endmenu

endif
```

## drivers/media/huawei/camera/sensor/ois/Kconfig
```kconfig
if HISI_CAMERA_OIS

menu "Hisilicon camera ois driver support"

config HISI_CAMERA_LC8981
    tristate "LC8981 camera OIS driver"
    depends on HISI_CAMERA_OIS
    default y
    ---help---
        LC8981 camera ois driver

endmenu

endif
```

## drivers/media/platform/ovisp22/capture/Kconfig
```kconfig
if VIDEO_HI6210_CAMERA

config VIDEO_HIK3_ISP_CAMERA
    tristate "Support Camera ISP"
    depends on VIDEO_HI6210_CAMERA
    default n
    ---help---
        Hisilicon K3 ISP driver.

config CAMERA_MINI_ISP
    tristate "Support Camera Mini ISP"
    depends on VIDEO_HI6210_CAMERA && VIDEO_HIK3_ISP_CAMERA
    default n
    ---help---
        HI6210 camera driver for mini isp

endif
```

## drivers/media/platform/ovisp22/fake_capture/Kconfig
```kconfig
config VIDEO_HIK3_FAKE_CAMERA
    tristate "Hisilicon K3 FAKE CAMERA"
    depends on VIDEO_HI6210_CAMERA && VIDEO_HIK3_ISP_CAMERA
    default m
    ---help---
        Hisilicon K3 Fake Camera driver.
```

## drivers/media/platform/ovisp23/Kconfig
```kconfig
if VIDEO_HISI_CAMERA

menu "Hisilicon Camera/V4L2 Features support"

source "drivers/media/platform/ovisp23/sensor/Kconfig"
source "drivers/media/platform/ovisp23/vcm/Kconfig"
source "drivers/media/platform/ovisp23/isp/Kconfig"
source "drivers/media/platform/ovisp23/flash/Kconfig"

config HISI_CAMERA_SENSOR
	tristate "Hisilicon Camera Sensor driver"
	depends on VIDEO_HISI_CAMERA
	default n
	---help---
		Hisilicon Camera Sensor driver.

config HISI_CAMERA_OVISP23
	tristate "Hisilicon Camera ISP driver"
	depends on VIDEO_HISI_CAMERA
	default n
	---help---
		Hisilicon Camera ISP driver.

config HISI_CAMERA_VCM
	tristate "Hisilicon Camera VCM driver"
	depends on VIDEO_HISI_CAMERA
	default n
	---help---
		Hisilicon Camera VCM driver.

config HISI_CAMERA_VIDEO
	tristate "Hisilicon Camera video device driver"
	depends on VIDEO_HISI_CAMERA
	default n
	---help---
		Hisilicon Camera video device driver.

config HISI_CAMERA_FLASH
	tristate "Hisilicon Camera Flash driver"
	depends on VIDEO_HISI_CAMERA
	default n
	---help---
		Hisilicon Camera Flash driver.

endmenu

endif
```

## drivers/media/platform/ovisp23/flash/Kconfig
```kconfig
if HISI_CAMERA_FLASH

menu "Hisilicon camera flash driver support"

config HISI_CAMERA_TPS61310
    tristate "TPS61310 camera flash driver"
    depends on HISI_CAMERA_FLASH
    default n
    ---help---
        TPS61310 camera flash driver

config HISI_CAMERA_LM3642
    tristate "LM3642 camera flash driver"
    depends on HISI_CAMERA_FLASH
    default n
    ---help---
        LM3642 camera flash driver

config HISI_CAMERA_PMU_LED
    tristate "LM3642 camera flash driver"
    depends on HISI_CAMERA_FLASH
    default n
    ---help---
        LM3642 camera flash driver

endmenu

endif
```

## drivers/media/platform/ovisp23/isp/Kconfig
```kconfig
if HISI_CAMERA_OVISP23

menu "Hisilicon Camera ISP Driver support"


endmenu

endif
```

## drivers/media/platform/ovisp23/sensor/Kconfig
```kconfig
if HISI_CAMERA_SENSOR

menu "Hisilicon camera sensor driver support"

config HISI_CAMERA_IMX214
	tristate "IMX214  camera sensor driver"
	depends on HISI_CAMERA_SENSOR
	default n
	---help---
		IMX214  camera sensor driver

config HISI_CAMERA_OV8830
	tristate "OV8830 camera sensor driver"
	depends on HISI_CAMERA_SENSOR
	default n
	---help---
		OV8830 camera sensor driver

config HISI_CAMERA_IMX135
	tristate "IMX135  camera sensor driver"
	depends on HISI_CAMERA_SENSOR
	default n
	---help---
		IMX135  camera sensor driver

config HISI_CAMERA_OV5648
	tristate "OV5648 camera sensor driver"
	depends on HISI_CAMERA_SENSOR
	default n
	---help---
		OV5648 camera sensor driver

config HISI_CAMERA_S5K4E1GA
	tristate "S5K4E1GA camera sensor driver"
	depends on HISI_CAMERA_SENSOR
	default n
	---help---
		S5K4E1GA camera sensor driver

config HISI_CAMERA_MT9M114
	tristate "MT9M114  camera sensor driver"
	depends on HISI_CAMERA_SENSOR
	default n
	---help---
		MT9M114  camera sensor driver
endmenu

endif
```

## drivers/media/platform/ovisp23/vcm/Kconfig
```kconfig
if HISI_CAMERA_VCM

menu "Hisilicon camera vcm driver support"

config HISI_CAMERA_AD5823
    tristate "AD5823 camera vcm driver"
    depends on HISI_CAMERA_VCM
    default n
    ---help---
        AD5823 camera vcm driver

config HISI_CAMERA_DW9714
    tristate "DW9714 camera vcm driver"
    depends on HISI_CAMERA_VCM
    default n
    ---help---
        DW9714 camera vcm driver

config HISI_CAMERA_AD5816
    tristate "AD5816 camera vcm driver"
    depends on HISI_CAMERA_VCM
    default n
    ---help---
        AD5823 camera vcm driver

endmenu

endif
```

## drivers/misc/drv2605/Kconfig
```kconfig
config DRV2605
    tristate "DRV2605 Driver"
	default y
	help
		Say Y to enable DRV2605
```

## drivers/misc/hilog/Kconfig
```kconfig
menu "Hisi log support"

config HISI_LOG
    tristate "Support for hisi log"
    help
		Support for Hisi log
endmenu
```

## drivers/misc_via/Kconfig
```kconfig
#
# via cbp 8.2 driver configuration
#
config MISC_VIA
	bool "misc via Support"
	default y
	help
	  This allows misc via.
	  If unsure, say n.
```

## drivers/mmc/Kconfig
```kconfig
#
# MMC subsystem configuration
#

menuconfig MMC
	tristate "MMC/SD/SDIO card support"
	depends on HAS_IOMEM
	help
	  This selects MultiMediaCard, Secure Digital and Secure
	  Digital I/O support.

	  If you want MMC/SD/SDIO support, you should say Y here and
	  also to your specific host controller driver.

config MMC_DEBUG
	bool "MMC debugging"
	depends on MMC != n
	help
	  This is an option for use by developers; most people should
	  say N here.  This enables MMC core and driver debugging.

config HISI_MMC_SECURE_RPMB
       bool "MMC RPMB Security Solution"
       depends on MMC != n
       help
         Enable this config will change the default behavior of RPMB
         HMAC calucation will be done in secure wolrd.
 config HUAWEI_SDCARD_DSM
	bool "Listen sdcard kernel err"
	depends on MMC != n
	default n
	help
	   use huawei sdcard log radar
config HUAWEI_EMMC_DSM
	bool "Listen eMMC kernel err"
	depends on MMC != n
	default n
	help
	   use huawei emmc log radar

config HUAWEI_EMMC_DSM_ONLY_VDET
	bool "Listen eMMC low voltage err"
	depends on MMC != n
	default n
	help
	   use device radar only to record emmc vdet log

config HISI_PARTITION_HI3650
	bool "hi3650 partition"
	default n
	help
	   config partition for hi3650 platform

config HISI_PARTITION_HI6250
	bool "hi6250 partition"
	default n
	help
	   config partition for hi6250 platform

config HISI_PARTITION_HI3660
	bool "hi3660 partition"
	default n
	help
	   config partition for hi3660 platform

if MMC

source "drivers/mmc/core/Kconfig"

source "drivers/mmc/card/Kconfig"

source "drivers/mmc/host/Kconfig"

endif # MMC
```
