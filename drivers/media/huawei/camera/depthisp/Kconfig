## drivers/mmc/core/Kconfig
```kconfig
#
# MMC core configuration
#

config MMC_CLKGATE
	bool "MMC host clock gating"
	help
	  This will attempt to aggressively gate the clock to the MMC card.
	  This is done to save power due to gating off the logic and bus
	  noise when the MMC card is not in use. Your host driver has to
	  support handling this in order for it to be of any use.

	  If unsure, say N.

config MMC_EMBEDDED_SDIO
	boolean "MMC embedded SDIO device support (EXPERIMENTAL)"
	help
	  If you say Y here, support will be added for embedded SDIO
	  devices which do not contain the necessary enumeration
	  support in hardware to be properly detected.

config MMC_PARANOID_SD_INIT
	bool "Enable paranoid SD card initialization (EXPERIMENTAL)"
	help
	  If you say Y here, the MMC layer will be extra paranoid
	  about re-trying SD init requests. This can be a useful
	  work-around for buggy controllers and hardware. Enable
	  if you are experiencing issues with SD detection.
config MMC_PASSWORDS
	boolean "MMC card lock/unlock passwords (EXPERIMENTAL)"
	select KEYS
	default y
	help
	  Say Y here to enable the use of passwords to lock and unlock
	  MMC cards.  This uses the access key retention support, using
	  request_key to look up the key associated with each card.
	  For example, if you have an MMC card that was locked using
	  Symbian OS on your cell phone, you won't be able to read it
	  on Linux without this support.
```

## drivers/power/hisi/Kconfig
```kconfig
config HISI_BATTERY_DATA
	bool "hisi battery data"
	default n
	
config HISI_BCI_BATTERY
        bool "hisi bci battery"
        default n

source "drivers/power/hisi/charger/Kconfig"
source "drivers/power/hisi/coul/Kconfig"
```
