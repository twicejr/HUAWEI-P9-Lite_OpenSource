## drivers/power/hisi/charger/Kconfig
```kconfig
config HISI_CHARGER
	bool "hisi charger"
	default n
config HISI_CHARGER_ARCH
	bool "hisi charger arch"
	default n
config BQ25892_CHARGER
	bool "bq25892 charger"
	default n
config SCHARGER_V200
	bool "schargerV200"
	default n
config SCHARGER_V300
	bool "schargerV300"
	default n
```

## drivers/power/hisi/coul/Kconfig
```kconfig
config HISI_COUL
        bool "hisi coul"
        default n
config HISI_COUL_HI6421V500
        bool "hisi hi6421v500 coul"
        default n
config HISI_COUL_HI6555V100
        bool "hisi hi6555v100 coul"
        default n
config HISI_COUL_TEST
        bool "hisi coul test"
        default n
```

## drivers/rpmsg/Kconfig
```kconfig
menu "Rpmsg drivers"

# RPMSG always gets selected by whoever wants it
config RPMSG
	tristate
	select VIRTIO
	select VIRTUALIZATION

config HISTAR_ISP
	tristate "Histar ISP rpmsg client"
	depends on RPMSG
	depends on ARCH_HI3XXX
	help

endmenu
```

## drivers/srecorder/Kconfig
```kconfig
menuconfig SRECORDER
	bool "SRecorder"
	help
		SRecorder is used to save panic log when kernel crash

if SRECORDER
config SRECORDER_LOG_BUF_LEN
	hex "Length of SRecorder's reserved memory"
	default 0x40000

if !HISI_3635 && !HISI_3635_FPGA && !HISI_3635_EMULATOR
config SRECORDER_RESERVED_MEM_PHYS_ADDR
    hex "srecorder DDR"
    default 0x39200000
config SRECORDER_RESERVED_MEM_SIZE
    hex "srecorder DDR SIZE"
    default 0x00200000
endif

config SRECORDER_TEMPBUF_ADDR_FROM_PHYS_OFFSET
	hex "Temporary buffer addr for SRecorder "
	default 0x4000000

config KERNEL_LOAD_PHYS_OFFSET
	hex "Kernel load phys offset "

config SRECORDER_SPECIAL_MEM_ADDR_FROM_PHYS_OFFSET
	hex "Special buffer addr for SRecorder and NFF Log"
	default 0x6000000

config SRECORDER_DUMP_LOG_TO_STORAGECARD
	bool "Dump log captured by SRecorder to storage card"
	
config DUMP_CRASH_TIME
	bool "Save crash reason and time"
	default n

config DUMP_DMESG
	bool "Save dmesg"
	default n

config DUMP_SYS_INFO
	bool "Save sys info "

config DUMP_ALLCPU_STACK
	bool "Save all cpu's stack"

config DUMP_ALLPS_INFO
	bool "Save all process' basic info"

config DUMP_CURRENT_PS_BACKTRACE
	bool "Save the current process' backtace"

config DUMP_SLAB_INFO
	bool "Save slab info"

config DUMP_MODEM_LOG
	bool "Save modem log"

config DUMP_MODEM_LOG_BY_FIQ
	bool "Save modem log by FIQ"
	depends on DUMP_MODEM_LOG

config DUMP_MODEM_LOG_DELAY_MAX_MS
	int "The millisecond to delay before dump modem log"
	depends on DUMP_MODEM_LOG_BY_FIQ
	default 10

config CPU_FREQ_DEFAULT_VALUE
	int "CPU's working frequency"
	depends on DUMP_MODEM_LOG_BY_FIQ
	default 1150000000

config POWERCOLLAPSE
	bool "Save dmesg after power collapse"
if POWERCOLLAPSE
config DUMP_LOGCAT
	bool "Save logcat after power collapse"
endif

config SRECORDER_VERSION
	string "SRecorder's version"
	default "0.0.0.1"

config DEBUG_SRECORDER
	bool "Debug srecorder"

endif # SRECORDER
```

## drivers/staging/pasr/Kconfig
```kconfig
config ARCH_HAS_PASR
	bool

config PASR
	bool "DDR Partial Array Self-Refresh"
	depends on ARCH_HAS_PASR
	---help---
	  PASR consists on masking the refresh of unused segments or banks
	  when DDR is in self-refresh state.

config PASR_DEBUG
	bool "Add PASR debug prints"
	def_bool y
	depends on PASR

config HISI_PASR
	bool "HISI PASR driver"
	def_bool n
	depends on (PASR)
	---help---
	  PASR support for Hisi board.
```

## drivers/thermal/hisi/Kconfig
```kconfig
config HISI_IPA_THERMAL
	tristate "Temperature sensor on ARM SoC based on HISI_THERMAL_TSENSOR interface"
	depends on HISI_THERMAL_TSENSOR
	depends on CPU_FREQ
	depends on OF
	select THERMAL_POWER_ACTOR_CPU
	help
	  Support for the HISI thermal sensor driver in the Linux thermal
	  framework.
config HISI_THERMAL_TSENSOR
	tristate "Hisi thermal sensor driver"
	default n
	help
	  Enable this to plug the thermal sensor driver into the Linux
	  thermal framework

config HISI_THERMAL_PERIPHERAL
	tristate "Hisi peripheral thermal driver"
	default n
	help
	  Enable this to plug the peripheral thermal sensor driver into the Linux
	  thermal framework
```

## drivers/usb/susb/Kconfig
```kconfig
#
# USB Dual Role (OTG-ready) Controller Drivers
# for silicon based on Synopsys designs
#

comment "Enable Host or Gadget support to see Synopsys options"
	depends on !USB && USB_GADGET=n

# (S)HDRC = (Synopsys) DWC
config USB_SUSB_HDRC
	depends on (USB || USB_GADGET)
	select USB_OTG_UTILS
	tristate 'Synopsys Highspeed Dual Role Controller '
	help
	  Say Y here if your system has a dual role high speed USB
	  controller based on the Synopsis USB2.0 OTG silicon IP.

config HI6250_USB
	depends on USB_SUSB_HDRC
	bool 'USB for hi6250'
	default n
```

## drivers/vcodec/hi_vcodec/vdec/Kconfig
```kconfig
menuconfig HI_VCODEC
    tristate "Support Hisi Video Decoder Driver"
    default n
    ---help---
      This is the hisilicon decoder driver.

if HI_VCODEC
source "drivers/vcodec/hi_vcodec/vdec/omxvdec/Kconfig"
source "drivers/vcodec/hi_vcodec/vdec/vfmw/Kconfig"
endif
```

## drivers/vcodec/hi_vcodec/vdec/omxvdec/Kconfig
```kconfig
config OMXVDEC
    tristate "hisilicon omx video decoder support"
    default n
    ---help---
        This is the omxvdec driver
```

## drivers/vcodec/hi_vcodec/vdec/vfmw/Kconfig
```kconfig
config VFMW
    tristate "hisilicon video firmware support"
    default n
    ---help---
        This is the vfmw driver
```

## drivers/vcodec/hi_vcodec/venc/drv/venc/Kconfig
```kconfig
menu "Driver test support"

config DRIVER_TEST
    #depends on ANDROID_PMEM
    tristate "Support for venc"
    default y
    help
        The decode device provides venc function
endmenu
```

## drivers/vcodec/imagination/D5500/Kconfig
```kconfig
menuconfig IMAGINATION_D5500_VCODEC
    tristate "Hi3xxx Support IMG Video Codec Drivers"
    default n
    ---help---
      This is the codec driver based on hi3xxx.

if IMAGINATION_D5500_VCODEC      
source "drivers/vcodec/imagination/D5500/imgvideo/Kconfig"
source "drivers/vcodec/imagination/D5500/vdec/Kconfig"
source "drivers/vcodec/imagination/D5500/encode/Kconfig"
endif
```

## drivers/vcodec/imagination/D5500/imgvideo/Kconfig
```kconfig
#menu "img decode support"

config IMG_VIDEO
#    depends on ANDROID_PMEM
    tristate "Support for hisi k3 video dec processor"
    default n
    help
        The decode device provides decode function for H.264/MPEG4/VC1
#endmenu
```

## drivers/vendor/hisi/modem/drv/acore/kernel/drivers/hisi/modem/drv/Kconfig
```kconfig
menu "Modem Drivers"

source "drivers/hisi/modem/drv/ipc/Kconfig"
source "drivers/hisi/modem/drv/icc/Kconfig"
source "drivers/hisi/modem/drv/sec_call/Kconfig"
source "drivers/hisi/modem/drv/balong_timer/Kconfig"
source "drivers/hisi/modem/drv/reset/Kconfig"
source "drivers/hisi/modem/drv/rfile/Kconfig"
source "drivers/hisi/modem/drv/nvim/Kconfig"
source "drivers/hisi/modem/drv/s_memory/Kconfig"
source "drivers/hisi/modem/drv/hwadp/Kconfig"
source "drivers/hisi/modem/drv/onoff/Kconfig"
source "drivers/hisi/modem/drv/efuse/Kconfig"
source "drivers/hisi/modem/drv/loadm/Kconfig"
source "drivers/hisi/modem/drv/udi/Kconfig"
source "drivers/hisi/modem/drv/sysctrl/Kconfig"
source "drivers/hisi/modem/drv/mem/Kconfig"
source "drivers/hisi/modem/drv/sync/Kconfig"
source "drivers/hisi/modem/drv/sc/Kconfig"
source "drivers/hisi/modem/drv/ipf/Kconfig"
source "drivers/hisi/modem/drv/psam/Kconfig"
source "drivers/hisi/modem/drv/om/Kconfig"
source "drivers/hisi/modem/drv/pm_om/Kconfig"
source "drivers/hisi/modem/drv/temperature/Kconfig"
source "drivers/hisi/modem/drv/ocp/Kconfig"
source "drivers/hisi/modem/drv/sim_hotplug/Kconfig"
endmenu
```

## drivers/vendor/hisi/modem/drv/acore/kernel/drivers/hisi/modem/drv/hwadp/Kconfig
```kconfig
#
# get ip base addr
#
comment "get ip base addr"

config HW_IP_BASE_ADDR
	tristate "hw ip adaption"
	default n
	help
	  ipc adaption for v7r1
```

## drivers/vendor/hisi/modem/drv/acore/kernel/drivers/hisi/modem/drv/icc/Kconfig
```kconfig
#
# multicore communication driver
#

comment "multicore communication driver"

config ICC_BALONG
	tristate "support icc"
	depends on IPC_DRIVER
	default n
	help
	  ICC driver
	  
config ICC_BALONG_TEST
	tristate "icc test"
	depends on ICC_BALONG
	default n
	help
	  ICC test
```

## drivers/vendor/hisi/modem/drv/acore/kernel/drivers/hisi/modem/drv/ipc/Kconfig
```kconfig
#
# ipc driver
#
comment "ipc driver"

config IPC_DRIVER
	tristate "ipc driver"
	default n
	help
	  ipc interface

config IPC_TEST
	tristate "ipc test"
	default n
	help
	  ipc test
	  
		
```

## drivers/vendor/hisi/modem/drv/acore/kernel/drivers/hisi/modem/drv/loadm/Kconfig
```kconfig
#
# ccore image load
#

comment "ccore image load driver"

config IMAGE_LOAD
	tristate "ccore image load"
	default n
	help
	  ccore image load driver
```

## drivers/vendor/hisi/modem/drv/acore/kernel/drivers/hisi/modem/drv/om/Kconfig
```kconfig
#
# Balong dump configuration
#

config HISI_DUMP
	tristate "hisi dump"
	default n
	help
		balong dump for kernel
	  
config BALONG_EASY_SHELL
	bool "balong easy shell(ecall) support"
	default n
	help
		Support for the Hisilicon Balong easy shell.
```

## drivers/vendor/hisi/modem/drv/acore/kernel/drivers/hisi/modem/drv/reset/Kconfig
```kconfig
#
# balong modem reset driver
#

comment "balong modem reset"

config BALONG_MODEM_RESET
	tristate "support balong modem reset feature"
	default n
	help
	  balong modem reset

config BALONG_MODEM_RESET_TEST
	tristate "test code of balong modem reset feature"
	default n
	help
	  balong modem reset test program
	  
config BALONG_MODEM_POWER_MANAGE
	tristate "the interface of balong modem power manage"
	default n
	help
	  balong modem state
```

## drivers/vendor/hisi/modem/drv/acore/kernel/drivers/hisi/modem/drv/rfile/Kconfig
```kconfig
#
# acore image load
#s

comment "acore image load driver"

config RFILE_SUPPORT
	tristate "support rfile"
	default n
	help
	  RFILE driver
	  
config RFILE_TEST
	tristate "rfile test"
	default n
	help
	  RFILE test
	  
config RFILE_MEM_OPTIMISE
	bool "rfile mem optimise"
	default n
	help
	  RFILE mem optimise
```

## drivers/vendor/hisi/modem/drv/acore/kernel/drivers/hisi/modem/drv/s_memory/Kconfig
```kconfig
#
# shared memory
#

comment "shared memory"

config S_MEMORY_TEST
	tristate "support shared memory test"
	default n
	help
	  shared memory test
```

## drivers/vendor/hisi/modem/drv/acore/kernel/drivers/hisi/modem/drv/sysctrl/Kconfig
```kconfig
#
# sysctrl
#

comment "sysctrl"

config SYSCTRL_TEST
	tristate "support sysctrl test"
	default n
	help
	  sysctrl test
```

## drivers/vendor/hisi/modem/drv/acore/kernel/drivers/hisi/modem/drv/udi/Kconfig
```kconfig
#
# udi adaption layer
#

comment "udi adaption layer"

config UDI_SUPPORT
	tristate "support udi"
	default n
	help
	  udi driver
```

## drivers/videocom/Kconfig
```kconfig
source "drivers/videocom/mntn/Kconfig"
source "drivers/videocom/videoharden/Kconfig"
source "drivers/videocom/videoconfig/Kconfig"
```
